AUTOSAR XML (schema 4-0-3)
standard types defined: float32_DataConstr, float64_DataConstr, sint16_DataConstr, sint32_DataConstr, sint8_DataConstr, uint16_DataConstr, uint32_DataConstr, uint8_DataConstr, boolean, float32, float64, sint16, sint32, sint8, uint16, uint32, uint8
package /DataDictionary/ComponentTypes/DataTypeMappingSets
  data type mapping set Cals
    data-type-maps:
      application-data-type=GateDrvCtrlNtcNr0x050FailStepDataType, implementation-data-type=uint16
      application-data-type=GateDrvCtrlUnit1Cfg3WrValDataType, implementation-data-type=uint16
      application-data-type=CurrMeasCorrlnErrPstepDataType, implementation-data-type=uint16
      application-data-type=MotCtrlPrmEstimnMotInduDaxLoLimDataType, implementation-data-type=float32
      application-data-type=GateDrvCtrlUnit1Cfg7WrValDataType, implementation-data-type=uint16
      application-data-type=VehSigCdngDftYawRateDataType, implementation-data-type=float32
      application-data-type=DampgHydBasCoeff1DataType, implementation-data-type=float32
      application-data-type=VehSigCdngYawRateDifThdDataType, implementation-data-type=float32
      application-data-type=GateDrvCtrlNtcNr0x060FailStepDataType, implementation-data-type=uint16
      application-data-type=CurrMeasNtc0x1EDPassStepDataType, implementation-data-type=uint16
      application-data-type=CurrMeasMinRqrdPhaOnTiDataType, implementation-data-type=uint32
      application-data-type=CurrMeasMotAgCompuDlyDataType, implementation-data-type=uint32
      application-data-type=HwAg1MeasNtc0x098PassStepDataType, implementation-data-type=uint16
      application-data-type=HwTqArbnMaxStallTqCDataType, implementation-data-type=uint8
      application-data-type=MotRefMdlCurrIterTolDataType, implementation-data-type=float32
      application-data-type=VehSigCdngLtgASlewRateDataType, implementation-data-type=float32
      application-data-type=MotCurrRegCfgMotDampgRatQaxDataType, implementation-data-type=float32
      application-data-type=MotRefMdlVltgOvrRThdScaDataType, implementation-data-type=float32
      application-data-type=CurrMeasCorrlnMaxErrCurrDataType, implementation-data-type=float32
      application-data-type=MotCurrRegCfgCtrlrDynGainVehSpdCutOffDataType, implementation-data-type=float32
      application-data-type=AssiSumLimPullCmpLimDataType, implementation-data-type=float32
      application-data-type=HwAg1MeasNtc0x099FailStepDataType, implementation-data-type=uint16
      application-data-type=MotCtrlPrmEstimnMotInduQaxLoLimDataType, implementation-data-type=float32
      application-data-type=MotCurrRegVltgLimrIvtrLoaScarSlewRateDataType, implementation-data-type=float32
      application-data-type=GateDrvCtrlUnit0Cfg2WrValDataType, implementation-data-type=uint16
      application-data-type=CurrMeasEolOffsHiCmuOffsDataType, implementation-data-type=uint32
      application-data-type=DampgQuadMotVelLpFilFrqDataType, implementation-data-type=float32
      application-data-type=CurrMeasMotCurrAdcVlyWrmIninMinDataType, implementation-data-type=float32
      application-data-type=MotCtrlPrmEstimnMotRNomDataType, implementation-data-type=float32
      application-data-type=MotCurrRegCfgMotDampgRatDaxDataType, implementation-data-type=float32
      application-data-type=HwAg0MeasNtc0x095PassStepDataType, implementation-data-type=uint16
      application-data-type=HwAg1MeasVrnrErrThdDataType, implementation-data-type=uint8
      application-data-type=HwAg0MeasNtc0x093FailStepDataType, implementation-data-type=uint16
      application-data-type=CurrMeasNtc0x1EDFailStepDataType, implementation-data-type=uint16
      application-data-type=CurrMeasEolMaxMotVelDataType, implementation-data-type=float32
      application-data-type=MotRefMdlTqIterTolDataType, implementation-data-type=float32
      application-data-type=SinVltgGennDitherLpfCoeffDataType, implementation-data-type=float32
      application-data-type=HwAg1MeasNtc0x098FailStepDataType, implementation-data-type=uint16
      application-data-type=SysGlbPrmTorsBarStfnDataType, implementation-data-type=float32
      application-data-type=HwTq0MeasNtc0x073FailStepDataType, implementation-data-type=uint16
      application-data-type=SysGlbPrmSysKineRatDataType, implementation-data-type=float32
      application-data-type=SysGlbPrmMotPoleCntDataType, implementation-data-type=uint8
      application-data-type=EcuTMeasRngDiagcMinDataType, implementation-data-type=float32
      application-data-type=MotCtrlPrmEstimnFetThermCoeffDataType, implementation-data-type=float32
      application-data-type=MotCtrlPrmEstimnMotRLoLimDataType, implementation-data-type=float32
      application-data-type=RtnHwAuthySlewDataType, implementation-data-type=float32
      application-data-type=VehSigCdngVehSpdDifThdDataType, implementation-data-type=float32
      application-data-type=MotCurrRegVltgLimrQaxAntiWdupScagDiDataType, implementation-data-type=uint8
      application-data-type=VehSigCdngLtgADifThdDataType, implementation-data-type=float32
      application-data-type=BattVltgCorrlnAllwdVltgDifDataType, implementation-data-type=float32
      application-data-type=CurrMeasEolGainMaxDataType, implementation-data-type=float32
      application-data-type=CurrMeasMotCurrAdcVlyEnadMinDataType, implementation-data-type=float32
      application-data-type=CurrMeasCorrlnMaxStallCntrDataType, implementation-data-type=uint8
      application-data-type=EcuTMeasScagDataType, implementation-data-type=float32
      application-data-type=CurrMeasEolGainNumerDataType, implementation-data-type=float32
      application-data-type=EcuTMeasNtc0x045PassStepDataType, implementation-data-type=uint16
      application-data-type=MotCtrlPrmEstimnMotBackEmfConLoLimDataType, implementation-data-type=float32
      application-data-type=MotRefMdlVltgModDynCmpEnaDataType, implementation-data-type=uint8
      application-data-type=MotCtrlPrmEstimnFetRNomDataType, implementation-data-type=float32
      application-data-type=MotRefMdlIvtrDeadTiBrdgVltgScaDataType, implementation-data-type=float32
      application-data-type=DampgQuadHwTqLpFilFrqDataType, implementation-data-type=float32
      application-data-type=CurrMeasNtc0x1ECFailStepDataType, implementation-data-type=uint16
      application-data-type=MotCurrRegCfgMotRVirtDaxDataType, implementation-data-type=float32
      application-data-type=CurrMeasArbnDaxQaxScagFacDataType, implementation-data-type=float32
      application-data-type=VehSigCdngDftVehSpdDataType, implementation-data-type=float32
      application-data-type=PwrDiscnctNtc0x042PassStepDataType, implementation-data-type=uint16
      application-data-type=CurrMeasMotCurrAdcVlyEnadMaxDataType, implementation-data-type=float32
      application-data-type=GateDrvCtrlUnit1Cfg4WrValDataType, implementation-data-type=uint16
      application-data-type=MotQuadDetnMotDirHysInstsDataType, implementation-data-type=s18p13
      application-data-type=CurrMeasCorrlnErrNstepDataType, implementation-data-type=uint16
      application-data-type=GateDrvCtrlUnit0Cfg4WrValDataType, implementation-data-type=uint16
      application-data-type=RtnOffsRngDataType, implementation-data-type=float32
      application-data-type=VehSigCdngLatASlewRateDataType, implementation-data-type=float32
      application-data-type=CurrMeasEolGainNrOfSampleDataType, implementation-data-type=uint16
      application-data-type=GateDrvCtrlUnit0Cfg3WrValDataType, implementation-data-type=uint16
      application-data-type=EcuTMeasDftTDataType, implementation-data-type=float32
      application-data-type=CurrMeasEolGainMinDataType, implementation-data-type=float32
      application-data-type=MotCurrRegVltgLimrDaxAntiWdupCoeffDataType, implementation-data-type=float32
      application-data-type=DampgHydBasCoeff4DataType, implementation-data-type=float32
      application-data-type=BattVltgCorrlnNtc0x03C0x0440x04CPassStepDataType, implementation-data-type=uint16
      application-data-type=SysGlbPrmSysTqRatDataType, implementation-data-type=float32
      application-data-type=AssiSumLimNtc0x0C4PassStepDataType, implementation-data-type=uint16
      application-data-type=EcuTMeasFilTauDataType, implementation-data-type=float32
      application-data-type=VehSigCdngLatAFilFrqDataType, implementation-data-type=float32
      application-data-type=CurrMeasEolOffsHiBrdgVltgMinDataType, implementation-data-type=uint32
      application-data-type=CurrMeasNtc0x05DPassStepDataType, implementation-data-type=uint16
      application-data-type=MotRefMdlTqIterLimDataType, implementation-data-type=uint8
      application-data-type=DampgHydBasCoeff2DataType, implementation-data-type=float32
      application-data-type=GateDrvCtrlUnit0Cfg7WrValDataType, implementation-data-type=uint16
      application-data-type=MotRefMdlFbCtrlDiDataType, implementation-data-type=uint8
      application-data-type=VehSigCdngVehYawSlewRateDataType, implementation-data-type=float32
      application-data-type=CurrMeasNtc0x05DFailStepDataType, implementation-data-type=uint16
      application-data-type=MotCtrlPrmEstimnMotBackEmfConNomDataType, implementation-data-type=float32
      application-data-type=CurrMeasNtc0x1ECPassStepDataType, implementation-data-type=uint16
      application-data-type=PwrDiscnctOpenThdDataType, implementation-data-type=float32
      application-data-type=MotRefMdlMinCurrIterLimDataType, implementation-data-type=uint8
      application-data-type=TSG31CfgAndUseAdcStrtOfCnvnMotCtrlPeakOffsDataType, implementation-data-type=uint32
      application-data-type=AssiPahSumHysCmpLimDataType, implementation-data-type=float32
      application-data-type=MotRefMdlRefLocnIterLimDataType, implementation-data-type=uint8
      application-data-type=TSG31CfgAndUseAdcStrtOfCnvn2OffsDataType, implementation-data-type=uint32
      application-data-type=TSG31CfgAndUsePwmDbndDataType, implementation-data-type=uint32
      application-data-type=HwTqArbnMaxStallTqBDataType, implementation-data-type=uint8
      application-data-type=CurrMeasEolOffsMaxDataType, implementation-data-type=float32
      application-data-type=MotRefMdlMotCurrDaxMaxScaDataType, implementation-data-type=float32
      application-data-type=MotCurrRegVltgLimrQaxAntiWdupCoeffDataType, implementation-data-type=float32
      application-data-type=CurrMeasArbnMaxStallCntrDataType, implementation-data-type=uint8
      application-data-type=RtnOffsSlewDataType, implementation-data-type=float32
      application-data-type=MotCtrlPrmEstimnMagThermCoeffDataType, implementation-data-type=float32
      application-data-type=EcuTMeasScagOffsDataType, implementation-data-type=float32
      application-data-type=VehSigCdngDftLatADataType, implementation-data-type=float32
      application-data-type=MotCurrRegCfgCurrLoopSecOrderTrfFcnEnaDataType, implementation-data-type=uint8
      application-data-type=CurrMeasEolOffsNrOfSampleDataType, implementation-data-type=uint16
      application-data-type=CurrMeasMotCurrAdcVlyWrmIninMaxDataType, implementation-data-type=float32
      application-data-type=MotCurrRegCfgIntgrlGainSampleTiDataType, implementation-data-type=float32
      application-data-type=HwAg0MeasNtc0x094PassStepDataType, implementation-data-type=uint16
      application-data-type=DampgQuadHwTqBacklshDataType, implementation-data-type=float32
      application-data-type=AssiSumLimNtc0x0C4FailStepDataType, implementation-data-type=uint16
      application-data-type=BattVltgCorrlnNtc0x03C0x0440x04CFailStepDataType, implementation-data-type=uint16
      application-data-type=MotCurrRegVltgLimrCurrLoaScarSlewRateDataType, implementation-data-type=float32
      application-data-type=HwAg0MeasNtc0x095FailStepDataType, implementation-data-type=uint16
      application-data-type=TSG31CfgAndUseMtrAg0SPIStartDataType, implementation-data-type=uint32
      application-data-type=EcuTMeasNtc0x045FailStepDataType, implementation-data-type=uint16
      application-data-type=CurrMeasEolFixdPwmPerdDataType, implementation-data-type=uint32
      application-data-type=MotRefMdlMotVltgDerivtvTiConDataType, implementation-data-type=float32
      application-data-type=GateDrvCtrlUnit1Cfg2WrValDataType, implementation-data-type=uint16
      application-data-type=PwrDiscnctNtc0x04AFailStepDataType, implementation-data-type=uint16
      application-data-type=HwAg1MeasNtc0x097PassStepDataType, implementation-data-type=uint16
      application-data-type=MotCurrRegCfgMotVelFilFrqDataType, implementation-data-type=float32
      application-data-type=CurrMeasEolTranCntrThdDataType, implementation-data-type=uint8
      application-data-type=HwAg0MeasNtc0x094FailStepDataType, implementation-data-type=uint16
      application-data-type=CurrMeasEolOffsLoCmuOffsDataType, implementation-data-type=uint32
      application-data-type=TSG31CfgAndUseAdcStrtOfCnvnMotCtrlVlyOffsDataType, implementation-data-type=uint32
      application-data-type=HwTqArbnMaxStallTqDDataType, implementation-data-type=uint8
      application-data-type=HwAg1MeasNtc0x099PassStepDataType, implementation-data-type=uint16
      application-data-type=DampgHydOutpLimDataType, implementation-data-type=float32
      application-data-type=MotRefMdlMotVelLpFilFrqDataType, implementation-data-type=float32
      application-data-type=DampgHydBasCoeff3DataType, implementation-data-type=float32
      application-data-type=MotCtrlPrmEstimnMotInduDaxNomDataType, implementation-data-type=float32
      application-data-type=DampgMotVelLpFilFrqDataType, implementation-data-type=float32
      application-data-type=MotRefMdlCurrDaxBoostGainDataType, implementation-data-type=float32
      application-data-type=VehSigCdngDftLgtADataType, implementation-data-type=float32
      application-data-type=CurrMeasEolOffsMinDataType, implementation-data-type=float32
      application-data-type=MotCurrRegCfgMotRVirtQaxDataType, implementation-data-type=float32
      application-data-type=MotCtrlPrmEstimnMotWidgThermCoeffDataType, implementation-data-type=float32
      application-data-type=MotCtrlPrmEstimnMotInduQaxNomDataType, implementation-data-type=float32
      application-data-type=DampgQuadScaLpFilFrqDataType, implementation-data-type=float32
      application-data-type=VehSigCdngVehSpdSlewRateDataType, implementation-data-type=float32
      application-data-type=EcuTMeasRngDiagcMaxDataType, implementation-data-type=float32
      application-data-type=MotCtrlPrmEstimnMotInduDaxHiLimDataType, implementation-data-type=float32
      application-data-type=CmnMfgSrvCal0RelNrDataType, implementation-data-type=uint32
      application-data-type=HwTq0MeasNtc0x073PassStepDataType, implementation-data-type=uint16
      application-data-type=DampgQuadMotVelBacklshDataType, implementation-data-type=float32
      application-data-type=MotCtrlPrmEstimnMotInduQaxHiLimDataType, implementation-data-type=float32
      application-data-type=HwAg1MeasNtc0x097FailStepDataType, implementation-data-type=uint16
      application-data-type=DampgQuad24MplrDataType, implementation-data-type=float32
      application-data-type=HwAg0MeasVrnrErrThdDataType, implementation-data-type=uint8
      application-data-type=VehSigCdngLatADifThdDataType, implementation-data-type=float32
      application-data-type=MotCtrlPrmEstimnMotRHiLimDataType, implementation-data-type=float32
      application-data-type=CurrMeasNtc0x06DFailStepDataType, implementation-data-type=uint16
      application-data-type=DampgQuad13MplrDataType, implementation-data-type=float32
      application-data-type=PwrDiscnctNtc0x042FailStepDataType, implementation-data-type=uint16
      application-data-type=MotCtrlPrmEstimnTNomDataType, implementation-data-type=float32
      application-data-type=MotCtrlPrmEstimnMotBackEmfConHiLimDataType, implementation-data-type=float32
      application-data-type=MotCurrRegCfgMotAgCompuDlyDataType, implementation-data-type=float32
      application-data-type=CurrMeasNtc0x06DPassStepDataType, implementation-data-type=uint16
      application-data-type=HwTqArbnMaxStallTqADataType, implementation-data-type=uint8
      application-data-type=HwAg0MeasNtc0x093PassStepDataType, implementation-data-type=uint16
      application-data-type=PwrDiscnctNtc0x04APassStepDataType, implementation-data-type=uint16
      application-data-type=BattVltgSwdMaxDataType, implementation-data-type=float32
package /DataDictionary/DataTypes
  169 x app type, all with category=VALUE, sw-calibration-access=READ-ONLY:
    AssiPahSumHysCmpLimDataType: range phys 0..0.3, unit=MotNwtMtr
    AssiSumLimNtc0x0C4FailStepDataType: range phys 0..65535, unit=Cnt
    AssiSumLimNtc0x0C4PassStepDataType: range phys 0..65535, unit=Cnt
    AssiSumLimPullCmpLimDataType: range phys 0..8.8, unit=MotNwtMtr
    BattVltgCorrlnAllwdVltgDifDataType: range phys 0..1, unit=Volt
    BattVltgCorrlnNtc0x03C0x0440x04CFailStepDataType: range phys 0..65535, unit=Cnt
    BattVltgCorrlnNtc0x03C0x0440x04CPassStepDataType: range phys 0..65535, unit=Cnt
    BattVltgSwdMaxDataType: range phys 6..26.5, unit=Volt
    CmnMfgSrvCal0RelNrDataType: range phys 0..4294967295, unit=Cnt
    CurrMeasArbnDaxQaxScagFacDataType: range phys 0.5..1, unit=Uls
    CurrMeasArbnMaxStallCntrDataType: range phys 0..255, unit=Cnt
    CurrMeasCorrlnErrNstepDataType: range phys 0..65535, unit=Cnt
    CurrMeasCorrlnErrPstepDataType: range phys 0..65535, unit=Cnt
    CurrMeasCorrlnMaxErrCurrDataType: range phys 0..50, unit=Ampr
    CurrMeasCorrlnMaxStallCntrDataType: range phys 0..255, unit=Cnt
    CurrMeasEolFixdPwmPerdDataType: range phys 55555..71429, unit=NanoSec
    CurrMeasEolGainMaxDataType: range phys 70..76, unit=AmprPerVolt
    CurrMeasEolGainMinDataType: range phys 56..60, unit=AmprPerVolt
    CurrMeasEolGainNrOfSampleDataType: range phys 1..1000, unit=Cnt
    CurrMeasEolGainNumerDataType: range phys 10..100, unit=Ampr
    CurrMeasEolMaxMotVelDataType: range phys 0..1350, unit=MotRadPerSec
    CurrMeasEolOffsHiBrdgVltgMinDataType: range phys 233330..1325008, unit=VoltNanoSec
    CurrMeasEolOffsHiCmuOffsDataType: range phys 0..71429, unit=NanoSec
    CurrMeasEolOffsLoCmuOffsDataType: range phys 0..71429, unit=NanoSec
    CurrMeasEolOffsMaxDataType: range phys 2.8..3, unit=Volt
    CurrMeasEolOffsMinDataType: range phys 2..2.3, unit=Volt
    CurrMeasEolOffsNrOfSampleDataType: range phys 1..10000, unit=Cnt
    CurrMeasEolTranCntrThdDataType: range phys 0..255, unit=Cnt
    CurrMeasMinRqrdPhaOnTiDataType: range phys 6666..8572, unit=NanoSec
    CurrMeasMotAgCompuDlyDataType: range phys 0..30000, unit=NanoSec
    CurrMeasMotCurrAdcVlyEnadMaxDataType: range phys 2.5..4.8, unit=Volt
    CurrMeasMotCurrAdcVlyEnadMinDataType: range phys 0.3..2.5, unit=Volt
    CurrMeasMotCurrAdcVlyWrmIninMaxDataType: range phys 2.5..3, unit=Volt
    CurrMeasMotCurrAdcVlyWrmIninMinDataType: range phys 2..2.5, unit=Volt
    CurrMeasNtc0x05DFailStepDataType: range phys 0..65535, unit=Cnt
    CurrMeasNtc0x05DPassStepDataType: range phys 0..65535, unit=Cnt
    CurrMeasNtc0x06DFailStepDataType: range phys 0..65535, unit=Cnt
    CurrMeasNtc0x06DPassStepDataType: range phys 0..65535, unit=Cnt
    CurrMeasNtc0x1ECFailStepDataType: range phys 0..65535, unit=Cnt
    CurrMeasNtc0x1ECPassStepDataType: range phys 0..65535, unit=Cnt
    CurrMeasNtc0x1EDFailStepDataType: range phys 0..65535, unit=Cnt
    CurrMeasNtc0x1EDPassStepDataType: range phys 0..65535, unit=Cnt
    DampgHydBasCoeff{1..4}DataType: range phys 0..0.1, unit=MotNwtMtrPerMotRadPerSec
    DampgHydOutpLimDataType: range phys -8.8..8.8, unit=MotNwtMtr
    DampgMotVelLpFilFrqDataType: range phys 5..100, unit=Hz
    DampgQuad13MplrDataType: range phys 0..2, unit=Uls
    DampgQuad24MplrDataType: range phys 0..2, unit=Uls
    DampgQuadHwTqBacklshDataType: range phys 0..10, unit=HwNwtMtr
    DampgQuadHwTqLpFilFrqDataType: range phys 5..31.25, unit=Hz
    DampgQuadMotVelBacklshDataType: range phys 0..128, unit=MotRadPerSec
    DampgQuadMotVelLpFilFrqDataType: range phys 5..31.25, unit=Hz
    DampgQuadScaLpFilFrqDataType: range phys 0.0039..100, unit=Hz
    EcuTMeasDftTDataType: range phys -50..150, unit=DegCgrd
    EcuTMeasFilTauDataType: range phys 0.1..10, unit=Hz
    EcuTMeasNtc0x045FailStepDataType: range phys 0..65535, unit=Cnt
    EcuTMeasNtc0x045PassStepDataType: range phys 0..65535, unit=Cnt
    EcuTMeasRngDiagcMaxDataType: range phys -50..200, unit=DegCgrd
    EcuTMeasRngDiagcMinDataType: range phys -50..200, unit=DegCgrd
    EcuTMeasScagDataType: range phys 0..200, unit=DegCgrdPerVolt
    EcuTMeasScagOffsDataType: range phys -100..150, unit=DegCgrd
    GateDrvCtrlNtcNr0x050FailStepDataType: range phys 0..65535, unit=Cnt
    GateDrvCtrlNtcNr0x060FailStepDataType: range phys 0..65535, unit=Cnt
    GateDrvCtrlUnit0Cfg{2..4}WrValDataType: range phys 0..65535, unit=Cnt
    GateDrvCtrlUnit0Cfg7WrValDataType: range phys 0..65535, unit=Cnt
    GateDrvCtrlUnit1Cfg{2..4}WrValDataType: range phys 0..65535, unit=Cnt
    GateDrvCtrlUnit1Cfg7WrValDataType: range phys 0..65535, unit=Cnt
    HwAg0MeasNtc0x093FailStepDataType: range phys 0..65535, unit=Cnt
    HwAg0MeasNtc0x093PassStepDataType: range phys 0..65535, unit=Cnt
    HwAg0MeasNtc0x094FailStepDataType: range phys 0..65535, unit=Cnt
    HwAg0MeasNtc0x094PassStepDataType: range phys 0..65535, unit=Cnt
    HwAg0MeasNtc0x095FailStepDataType: range phys 0..65535, unit=Cnt
    HwAg0MeasNtc0x095PassStepDataType: range phys 0..65535, unit=Cnt
    HwAg0MeasVrnrErrThdDataType: range phys 0..20, unit=Cnt
    HwAg1MeasNtc0x097FailStepDataType: range phys 0..65535, unit=Cnt
    HwAg1MeasNtc0x097PassStepDataType: range phys 0..65535, unit=Cnt
    HwAg1MeasNtc0x098FailStepDataType: range phys 0..65535, unit=Cnt
    HwAg1MeasNtc0x098PassStepDataType: range phys 0..65535, unit=Cnt
    HwAg1MeasNtc0x099FailStepDataType: range phys 0..65535, unit=Cnt
    HwAg1MeasNtc0x099PassStepDataType: range phys 0..65535, unit=Cnt
    HwAg1MeasVrnrErrThdDataType: range phys 0..20, unit=Cnt
    HwTq0MeasNtc0x073FailStepDataType: range phys 0..65535, unit=Cnt
    HwTq0MeasNtc0x073PassStepDataType: range phys 0..65535, unit=Cnt
    HwTqArbnMaxStallTqADataType: range phys 0..255, unit=Cnt
    HwTqArbnMaxStallTqBDataType: range phys 0..255, unit=Cnt
    HwTqArbnMaxStallTqCDataType: range phys 0..255, unit=Cnt
    HwTqArbnMaxStallTqDDataType: range phys 0..255, unit=Cnt
    MotCtrlPrmEstimnFetRNomDataType: range phys 0..0.1, unit=Ohm
    MotCtrlPrmEstimnFetThermCoeffDataType: range phys 0..0.006, unit=OhmPerDegCgrd
    MotCtrlPrmEstimnMagThermCoeffDataType: range phys -0.0015..0, unit=VoltPerMotRadPerSecPerDegCgrd
    MotCtrlPrmEstimnMotBackEmfConHiLimDataType: range phys 0.025..0.075, unit=VoltPerMotRadPerSec
    MotCtrlPrmEstimnMotBackEmfConLoLimDataType: range phys 0.025..0.075, unit=VoltPerMotRadPerSec
    MotCtrlPrmEstimnMotBackEmfConNomDataType: range phys 0.025..0.075, unit=VoltPerMotRadPerSec
    MotCtrlPrmEstimnMotInduDaxHiLimDataType: range phys 3e-05..0.00041, unit=Henry
    MotCtrlPrmEstimnMotInduDaxLoLimDataType: range phys 3e-05..0.00041, unit=Henry
    MotCtrlPrmEstimnMotInduDaxNomDataType: range phys 3e-05..0.00041, unit=Henry
    MotCtrlPrmEstimnMotInduQaxHiLimDataType: range phys 3e-05..0.00041, unit=Henry
    MotCtrlPrmEstimnMotInduQaxLoLimDataType: range phys 3e-05..0.00041, unit=Henry
    MotCtrlPrmEstimnMotInduQaxNomDataType: range phys 3e-05..0.00041, unit=Henry
    MotCtrlPrmEstimnMotRHiLimDataType: range phys 0.005..0.12565, unit=Ohm
    MotCtrlPrmEstimnMotRLoLimDataType: range phys 0.005..0.12565, unit=Ohm
    MotCtrlPrmEstimnMotRNomDataType: range phys 0.005..0.12565, unit=Ohm
    MotCtrlPrmEstimnMotWidgThermCoeffDataType: range phys 0..0.0045, unit=OhmPerDegCgrd
    MotCtrlPrmEstimnTNomDataType: range phys -40..150, unit=DegCgrd
    MotCurrRegCfgCtrlrDynGainVehSpdCutOffDataType: range phys 0..255, unit=Kph
    MotCurrRegCfgCurrLoopSecOrderTrfFcnEnaDataType: range phys 0..1, unit=Cnt
    MotCurrRegCfgIntgrlGainSampleTiDataType: range phys 9.1e-05..0.000143, unit=Sec
    MotCurrRegCfgMotAgCompuDlyDataType: range phys 0..0.0002, unit=Sec
    MotCurrRegCfgMotDampgRatDaxDataType: range phys 0..20, unit=Uls
    MotCurrRegCfgMotDampgRatQaxDataType: range phys 0..20, unit=Uls
    MotCurrRegCfgMotRVirtDaxDataType: range phys 0..0.2, unit=Ohm
    MotCurrRegCfgMotRVirtQaxDataType: range phys 0..0.2, unit=Ohm
    MotCurrRegCfgMotVelFilFrqDataType: range phys 1..200, unit=Hz
    MotCurrRegVltgLimrCurrLoaScarSlewRateDataType: range phys 0..1000, unit=UlsPerSec
    MotCurrRegVltgLimrDaxAntiWdupCoeffDataType: range phys -25..25, unit=Uls
    MotCurrRegVltgLimrIvtrLoaScarSlewRateDataType: range phys 0..1000, unit=UlsPerSec
    MotCurrRegVltgLimrQaxAntiWdupCoeffDataType: range phys -25..25, unit=Uls
    MotCurrRegVltgLimrQaxAntiWdupScagDiDataType: range phys 0..1, unit=Cnt
    MotQuadDetnMotDirHysInstsDataType: range phys 0..6.25, unit=MotDeg
    MotRefMdlCurrDaxBoostGainDataType: range phys 0..1, unit=Uls
    MotRefMdlCurrIterTolDataType: range phys 0.01..20, unit=Ampr
    MotRefMdlFbCtrlDiDataType: range phys 0..1, unit=Cnt
    MotRefMdlIvtrDeadTiBrdgVltgScaDataType: range phys 0.98..1, unit=Uls
    MotRefMdlMinCurrIterLimDataType: range phys 1..5, unit=Cnt
    MotRefMdlMotCurrDaxMaxScaDataType: range phys 1..2, unit=Uls
    MotRefMdlMotVelLpFilFrqDataType: range phys 1..200, unit=Hz
    MotRefMdlMotVltgDerivtvTiConDataType: range phys 0..0.05, unit=Sec
    MotRefMdlRefLocnIterLimDataType: range phys 1..20, unit=Cnt
    MotRefMdlTqIterLimDataType: range phys 1..5, unit=Cnt
    MotRefMdlTqIterTolDataType: range phys 0.001..0.1, unit=MotRad
    MotRefMdlVltgModDynCmpEnaDataType: range phys 0..1, unit=Cnt
    MotRefMdlVltgOvrRThdScaDataType: range phys 0..1, unit=Uls
    PwrDiscnctNtc0x042FailStepDataType: range phys 0..65535, unit=Cnt
    PwrDiscnctNtc0x042PassStepDataType: range phys 0..65535, unit=Cnt
    PwrDiscnctNtc0x04AFailStepDataType: range phys 0..65535, unit=Cnt
    PwrDiscnctNtc0x04APassStepDataType: range phys 0..65535, unit=Cnt
    PwrDiscnctOpenThdDataType: range phys 0..26.5, unit=Volt
    RtnHwAuthySlewDataType: range phys 0.1..10, unit=UlsPerSec
    RtnOffsRngDataType: range phys 0..20, unit=HwDeg
    RtnOffsSlewDataType: range phys 0..0.5, unit=HwDegPerSec
    SinVltgGennDitherLpfCoeffDataType: range phys 0..1, unit=Uls
    SysGlbPrmMotPoleCntDataType: range phys 2..12, unit=Cnt
    SysGlbPrmSysKineRatDataType: range phys 10..40, unit=MotDegPerHwDeg
    SysGlbPrmSysTqRatDataType: range phys 10..40, unit=HwNwtMtrPerMotNwtMtr
    SysGlbPrmTorsBarStfnDataType: range phys 0.5..10, unit=HwNwtMtrPerHwDeg
    TSG31CfgAndUseAdcStrtOfCnvn2OffsDataType: range phys 0..25000, unit=NanoSec
    TSG31CfgAndUseAdcStrtOfCnvnMotCtrlPeakOffsDataType: range phys 0..25000, unit=NanoSec
    TSG31CfgAndUseAdcStrtOfCnvnMotCtrlVlyOffsDataType: range phys 0..25000, unit=NanoSec
    TSG31CfgAndUseMtrAg0SPIStartDataType: range phys 0..71429, unit=NanoSec
    TSG31CfgAndUsePwmDbndDataType: range phys 1..1000, unit=NanoSec
    VehSigCdngDftLatADataType: range phys -10..10, unit=MtrPerSecSqd
    VehSigCdngDftLgtADataType: range phys -50..50, unit=KphPerSec
    VehSigCdngDftVehSpdDataType: range phys 0..511, unit=Kph
    VehSigCdngDftYawRateDataType: range phys -120..120, unit=VehDegPerSec
    VehSigCdngLatADifThdDataType: range phys 0.1..10, unit=MtrPerSecSqd
    VehSigCdngLatAFilFrqDataType: range phys 1..100, unit=Hz
    VehSigCdngLatASlewRateDataType: range phys 0.1..400, unit=MtrPerSecSqd
    VehSigCdngLtgADifThdDataType: range phys 0.1..10, unit=KphPerSec
    VehSigCdngLtgASlewRateDataType: range phys 0.1..500, unit=KphPerSecSqd
    VehSigCdngVehSpdDifThdDataType: range phys 0.1..511, unit=Kph
    VehSigCdngVehSpdSlewRateDataType: range phys 1..50, unit=KphPerSec
    VehSigCdngVehYawSlewRateDataType: range phys 1..1200, unit=VehDegPerSecSqd
    VehSigCdngYawRateDifThdDataType: range phys 0.1..120, unit=VehDegPerSec
  impl type s18p13: compu {raw=phys*8192 for phys >0..<255; unit FixdPt}, implementation-data-type=sint32, type-emitter=RTE
package /DataDictionary/Units
  35 x unit, all with factor-si-to-unit=1, offset-si-to-unit=0:
    Ampr: display-name=Ampr
    AmprPerVolt: display-name=AmprPerVolt
    Cnt: display-name=Cnt
    DegCgrd: display-name=DegCgrd
    DegCgrdPerVolt: display-name=DegCgrdPerVolt
    FixdPt: display-name=FixdPt
    Henry: display-name=Henry
    HwDeg: display-name=HwDeg
    HwDegPerSec: display-name=HwDegPerSec
    HwNwtMtr: display-name=HwNwtMtr
    HwNwtMtrPerHwDeg: display-name=HwNwtMtrPerHwDeg
    HwNwtMtrPerMotNwtMtr: display-name=HwNwtMtrPerMotNwtMtr
    Hz: display-name=Hz
    Kph: display-name=Kph
    KphPerSec: display-name=KphPerSec
    KphPerSecSqd: display-name=KphPerSecSqd
    MotDeg: display-name=MotDeg
    MotDegPerHwDeg: display-name=MotDegPerHwDeg
    MotNwtMtr: display-name=MotNwtMtr
    MotNwtMtrPerMotRadPerSec: display-name=MotNwtMtrPerMotRadPerSec
    MotRad: display-name=MotRad
    MotRadPerSec: display-name=MotRadPerSec
    MtrPerSecSqd: display-name=MtrPerSecSqd
    NanoSec: display-name=NanoSec
    Ohm: display-name=Ohm
    OhmPerDegCgrd: display-name=OhmPerDegCgrd
    Sec: display-name=Sec
    Uls: display-name=Uls
    UlsPerSec: display-name=UlsPerSec
    VehDegPerSec: display-name=VehDegPerSec
    VehDegPerSecSqd: display-name=VehDegPerSecSqd
    Volt: display-name=Volt
    VoltNanoSec: display-name=VoltNanoSec
    VoltPerMotRadPerSec: display-name=VoltPerMotRadPerSec
    VoltPerMotRadPerSecPerDegCgrd: display-name=VoltPerMotRadPerSecPerDegCgrd
package /Nexteer/DataTypes
  4 x impl type, all with category=TYPE_REFERENCE, implementation-data-type=uint8, type-emitter=RTE:
    AdrMpgReqTyp1: compu {phys=raw for raw 0, phys=raw for raw 1}
    CalCopySts1: compu {0=CALCOPYSTS_NOTRDY, 1=CALCOPYSTS_COPYPNDING, 2=CALCOPYSTS_COPYCMPL, 3=CALCOPYSTS_PROCERR}
    GetSegMod1: compu {0=GETSEGMOD_ADRINFO, 1=GETSEGMOD_STDINFO, 2=GETSEGMOD_ADRMPG}
    MfgEnaSt1: compu {0=MFGENAST_PRDNMOD, 1=MFGENAST_MFGMOD, 2=MFGENAST_TESTMOD}
