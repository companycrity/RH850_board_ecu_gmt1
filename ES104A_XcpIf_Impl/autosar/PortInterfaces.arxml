AUTOSAR XML (schema 4-0-3)
package /Nexteer/PortInterfaces
  5 x client server interface:
    ActvTunStsReq_PortIf1
      operation Oper
        5 x arg, all with type=uint8, direction=INOUT:
          ActvRtIdx_Arg
          ActvIninIdx_Arg
          CalChgAllwd_Arg
          ActvGroup_Arg
          CalCopyCmpl_Arg
    CopyCalPageReq_PortIf1
      operation Oper: possible-error=CopyCalPageReq_PortIf1/E_NOT_OK
        arg Seg_Arg: type=uint8, direction=IN
      error E_NOT_OK: error-code=1
    GetCalPageReq_PortIf1
      operation Oper
        4 x arg, all with type=uint8:
          Seg_Arg: direction=IN
          Mod_Arg: direction=IN
          Page_Arg: direction=INOUT
          Rtn_Arg: direction=OUT
    GetSegInfoReq_PortIf2
      operation Oper
        7 x arg:
          Mod_Arg: type=GetSegMod1, direction=IN
          Seg_Arg: type=uint8, direction=IN
          SegInfo_Arg: type=uint8, direction=IN
          MpgIdx_Arg: type=uint8, direction=IN
          Resp_Arg: type=uint8, direction=INOUT
          RespLen_Arg: type=uint8, direction=INOUT
          Rtn_Arg: type=uint8, direction=OUT
    OnlineTunRamAdrMpg_PortIf1
      operation Oper: possible-error=OnlineTunRamAdrMpg_PortIf1/E_NOT_OK
        arg ReqAdr_Arg: type=uint32, direction=IN
        arg CorrdAdr_Arg: type=uint32, direction=INOUT
        arg ReqTyp_Arg: type=AdrMpgReqTyp1, direction=IN
      error E_NOT_OK: error-code=1
  4 x sender receiver interface:
    ActvGroup_PortIf1: invalidation-policy{data-element=ActvGroup_PortIf1/Val, handle-invalid=DONT-INVALIDATE}
      data Val: type=uint8
    CalCopySts_PortIf1: invalidation-policy{data-element=CalCopySts_PortIf1/Val, handle-invalid=DONT-INVALIDATE}
      data Val: type=CalCopySts1
    MfgEnaSt1_PortIf1: invalidation-policy{data-element=MfgEnaSt1_PortIf1/Val, handle-invalid=DONT-INVALIDATE}
      data Val: type=MfgEnaSt1
    uint8_PortIf1: invalidation-policy{data-element=uint8_PortIf1/Val, handle-invalid=DONT-INVALIDATE}
      data Val: sw-calibration-access=READ-ONLY, type=uint8
package /PortInterfaces
  client server interface SetCalPageReq_PortIf1
    operation Oper
      arg Seg_Arg: type=uint8, direction=IN
      arg Mod_Arg: type=uint8, direction=IN
      arg Page_Arg: type=uint8, direction=IN
  client server interface XcpCalChgReq_PortIf1
    operation Oper: possible-error=XcpCalChgReq_PortIf1/E_NOT_OK
    error E_NOT_OK: error-code=1
