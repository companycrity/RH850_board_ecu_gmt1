AUTOSAR XML (schema 4-0-3)
package /Nexteer/NvMProxy_swc/Interfaces
  client server interface NvMService_AC3_SRBS: is-service=true
    6 x operation, all with possible-error=NvMService_AC3_SRBS/E_NOT_OK:
      EraseBlock
      GetErrorStatus
        arg ErrorStatus: type=NvM_RequestResultType, direction=OUT
      InvalidateNvBlock
      ReadBlock
        arg DstPtr: type=dtRef_VOID, direction=IN
      SetRamBlockStatus
        arg RamBlockStatus: type=Boolean, direction=IN
      WriteBlock
        arg SrcPtr: type=dtRef_const_VOID, direction=IN
    error E_NOT_OK: error-code=1
package /Nexteer/PortInterfaces
  client server interface PolarityCfgRead1
    operation Oper: possible-error=PolarityCfgRead1/E_NOT_OK
      arg PolarityCfgSaved: type=Cnt15, direction=OUT
    error E_NOT_OK: error-code=1
  client server interface PolarityCfgWr1
    operation Oper: possible-error=PolarityCfgWr1/E_NOT_OK
      arg PolarityCfgSaved: type=Cnt15, direction=IN
    error E_NOT_OK: error-code=1
  sender receiver interface Uls3: invalidation-policy{data-element=Val, handle-invalid=DONT-INVALIDATE}
    data Val: sw-calibration-access=READ-ONLY, type=Uls3
