AUTOSAR XML (schema 4-0-3)
package /MICROSAR/Dem_swc/Interfaces
  19 x client server interface, all with is-service=true, service-kind=DIAGNOSTIC-EVENT-MANAGER:
    CSDataServices_BattVltgEcu
      operation ReadData: possible-error=CSDataServices_BattVltgEcu/E_NOT_OK
        arg Data: type=DataArray_Type_1, direction=OUT
      error E_NOT_OK: error-code=1
    CSDataServices_EcuIntT
      operation ReadData: possible-error=CSDataServices_EcuIntT/E_NOT_OK
        arg Data: type=DataArray_Type_1, direction=OUT
      error E_NOT_OK: error-code=1
    CSDataServices_EngSpd
      operation ReadData: possible-error=CSDataServices_EngSpd/E_NOT_OK
        arg Data: type=DataArray_Type_2, direction=OUT
      error E_NOT_OK: error-code=1
    CSDataServices_EpdMotOvldProtnCntr
      operation ReadData: possible-error=CSDataServices_EpdMotOvldProtnCntr/E_NOT_OK
        arg Data: type=DataArray_Type_1, direction=OUT
      error E_NOT_OK: error-code=1
    CSDataServices_EpsAgOvrlSts
      operation ReadData: possible-error=CSDataServices_EpsAgOvrlSts/E_NOT_OK
        arg Data: type=DataArray_Type_1, direction=OUT
      error E_NOT_OK: error-code=1
    CSDataServices_EpsApaAgOvrlReq
      operation ReadData: possible-error=CSDataServices_EpsApaAgOvrlReq/E_NOT_OK
        arg Data: type=DataArray_Type_2, direction=OUT
      error E_NOT_OK: error-code=1
    CSDataServices_EpsMotCurr
      operation ReadData: possible-error=CSDataServices_EpsMotCurr/E_NOT_OK
        arg Data: type=DataArray_Type_2, direction=OUT
      error E_NOT_OK: error-code=1
    CSDataServices_EpsMotCurrFb
      operation ReadData: possible-error=CSDataServices_EpsMotCurrFb/E_NOT_OK
        arg Data: type=DataArray_Type_2, direction=OUT
      error E_NOT_OK: error-code=1
    CSDataServices_EpsStopStrtSts
      operation ReadData: possible-error=CSDataServices_EpsStopStrtSts/E_NOT_OK
        arg Data: type=DataArray_Type_1, direction=OUT
      error E_NOT_OK: error-code=1
    CSDataServices_EpsTqOvrlReq
      operation ReadData: possible-error=CSDataServices_EpsTqOvrlReq/E_NOT_OK
        arg Data: type=DataArray_Type_2, direction=OUT
      error E_NOT_OK: error-code=1
    CSDataServices_EpsTqOvrlSts
      operation ReadData: possible-error=CSDataServices_EpsTqOvrlSts/E_NOT_OK
        arg Data: type=DataArray_Type_1, direction=OUT
      error E_NOT_OK: error-code=1
    CSDataServices_IgnCycCntr
      operation ReadData: possible-error=CSDataServices_IgnCycCntr/E_NOT_OK
        arg Data: type=DataArray_Type_2, direction=OUT
      error E_NOT_OK: error-code=1
    CSDataServices_SplrIntDtcInfo
      operation ReadData: possible-error=CSDataServices_SplrIntDtcInfo/E_NOT_OK
        arg Data: type=DataArray_Type_4, direction=OUT
      error E_NOT_OK: error-code=1
    CSDataServices_SteerInpTq
      operation ReadData: possible-error=CSDataServices_SteerInpTq/E_NOT_OK
        arg Data: type=DataArray_Type_2, direction=OUT
      error E_NOT_OK: error-code=1
    CSDataServices_SteerOutpTq
      operation ReadData: possible-error=CSDataServices_SteerOutpTq/E_NOT_OK
        arg Data: type=DataArray_Type_2, direction=OUT
      error E_NOT_OK: error-code=1
    CSDataServices_SteerWhlAg
      operation ReadData: possible-error=CSDataServices_SteerWhlAg/E_NOT_OK
        arg Data: type=DataArray_Type_2, direction=OUT
      error E_NOT_OK: error-code=1
    CSDataServices_SysPwrMod
      operation ReadData: possible-error=CSDataServices_SysPwrMod/E_NOT_OK
        arg Data: type=DataArray_Type_1, direction=OUT
      error E_NOT_OK: error-code=1
    CSDataServices_TiIgnOn
      operation ReadData: possible-error=CSDataServices_TiIgnOn/E_NOT_OK
        arg Data: type=DataArray_Type_4, direction=OUT
      error E_NOT_OK: error-code=1
    CSDataServices_VehSpd
      operation ReadData: possible-error=CSDataServices_VehSpd/E_NOT_OK
        arg Data: type=DataArray_Type_1, direction=OUT
      error E_NOT_OK: error-code=1
package /Nexteer/Calibrations
  parameter interface Ary1D_u32_512_CalPortIf1
    parameter data prototype Ary1D: sw-calibration-access=READ-WRITE, type=Ary1D_u32_512
  parameter interface boolean_CalPortIf1
    parameter data prototype Logl: sw-calibration-access=READ-WRITE, type=boolean
  parameter interface float32_CalPortIf1
    parameter data prototype Val: sw-calibration-access=READ-WRITE, type=float32
package /Nexteer/NvMProxy_swc/Interfaces
  client server interface NvMService_AC3_SRBS: is-service=true
    6 x operation, all with possible-error=NvMService_AC3_SRBS/E_NOT_OK:
      EraseBlock
      GetErrorStatus
        arg ErrorStatus: type=NvM_RequestResultType, direction=OUT
      InvalidateNvBlock
      ReadBlock
        arg DstPtr: type=dtRef_VOID, direction=IN
      SetRamBlockStatus
        arg RamBlockStatus: type=Boolean, direction=IN
      WriteBlock
        arg SrcPtr: type=dtRef_const_VOID, direction=IN
    error E_NOT_OK: error-code=1
package /Nexteer/PortInterfaces
  45 x client server interface:
    ClrAllDiagc_PortIf1
      operation Oper
    ClrHwAgTrimVal_PortIf1
      operation Oper
    CustDiagcClrGmIgnCntr_PortIf1
      operation Oper
    GetGpio1
      operation Oper: possible-error=GetGpio1/E_NOT_OK
        arg PinSt: type=Logl1, direction=OUT
      error E_NOT_OK: error-code=1
    GetNtcActv_PortIf1
      operation Oper: possible-error=GetNtcActv_PortIf1/E_NOT_OK
        arg NtcNr_Arg: type=NtcNr1, direction=IN
        arg NtcActv_Arg: type=boolean, direction=OUT
      error E_NOT_OK: error-code=1
    GetNtcSts_PortIf1
      operation Oper: possible-error=GetNtcSts_PortIf1/E_NOT_OK
        arg NtcNr_Arg: type=NtcNr1, direction=IN
        arg NtcInfoSts_Arg: type=uint8, direction=OUT
      error E_NOT_OK: error-code=1
    GetRefTmr100MicroSec32bit_PortIf1
      operation Oper
        arg RefTmr_Arg: type=uint32, direction=OUT
    GetSigStcHlthData_PortIf3
      operation Oper: possible-error=GetSigStcHlthData_PortIf3/E_NOT_OK
        arg SigId_Arg: type=StHlthMonSig3, direction=IN
        arg BufPtr_Arg: type=uint32, direction=OUT
      error E_NOT_OK: error-code=1
    GetTiSpan100MicroSec32bit_PortIf1
      operation Oper
        arg RefTmr_Arg: type=uint32, direction=IN
        arg TiSpan_Arg: type=uint32, direction=OUT
    GmFctDiReq_PortIf1
      operation Oper
    PartNrBasMdlPartNrAlphaCodRd1
      operation Oper
        arg BasMdlPartNrAlphaCod: type=Ary1D_u8_2, direction=OUT
    PartNrBasMdlPartNrRd1
      operation Oper
        arg BasMdlPartNr: type=Ary1D_u8_4, direction=OUT
    PartNrCalProgdStsRd1
      operation Oper
        arg CalProgdSts: type=uint8, direction=OUT
    PartNrCalProgdStsWr1
      operation Oper: possible-error=InvldVal
        arg CalProgdSts: type=uint8, direction=IN
      error InvldVal: error-code=1
    PartNrCcaMfgTrakgRd1
      operation Oper
        arg CcaMfgTrakg: type=Ary1D_u8_9, direction=OUT
    PartNrCmpdVehPartnProdtStructRd1
      operation Oper
        arg CmpdVehPartnProdtStruct: type=Ary1D_u8_14, direction=OUT
    PartNrCtrlPidKeyChk1
      operation Oper: possible-error=PartNrCtrlPidKeyChk1/InvldKey
        arg CtrlPidKey: type=Ary1D_u8_5, direction=IN
      error InvldKey: error-code=1
    PartNrCtrlPidKeyWr1
      operation Oper
        arg CtrlPidKey: type=Ary1D_u8_5, direction=IN
    PartNrCtrlPidSeedRd1
      operation Oper
        arg CtrlPidSeed: type=Ary1D_u8_5, direction=OUT
    PartNrCtrlPidSeedUpprByteWr1
      operation Oper: possible-error=MfgEnaCntrNotZero
        arg CtrlPidSeedUpprByte: type=uint8, direction=IN
      error MfgEnaCntrNotZero: error-code=1
    PartNrCustMfgEnaCntrRd1
      operation Oper
        arg CustMfgEnaCntr: type=uint8, direction=OUT
    PartNrCustMfgEnaCntrWr1
      operation Oper: possible-error=CustMfgEnaCntrZero
        arg CustMfgEnaCntr: type=uint8, direction=IN
      error CustMfgEnaCntrZero: error-code=1
    PartNrDataUniversalNrSysIdRd1
      operation Oper
        arg DataUniversalNrSysId: type=Ary1D_u8_9, direction=OUT
    PartNrEcuIdRd_PortIf1
      operation Oper
        arg EcuId_Arg: type=Ary1D_u8_16, direction=OUT
    PartNrEndMdlPartNrAlphaCodRd1
      operation Oper
        arg EndMdlPartNrAlphaCod: type=Ary1D_u8_2, direction=OUT
    PartNrEndMdlPartNrRd1
      operation Oper
        arg EndMdlPartNr: type=Ary1D_u8_4, direction=OUT
    PartNrGmLanIdRd1
      operation Oper
        arg GmLanId: type=Ary1D_u8_12, direction=OUT
    PartNrLstRepairShopCodRd1
      operation Oper
        arg RepairShopCod: type=Ary1D_u8_10, direction=OUT
    PartNrNxtrMfgTrakgRd1
      operation Oper
        arg NxtrMfgTrakg: type=Ary1D_u8_7, direction=OUT
    PartNrProgmDateRd1
      operation Oper
        arg ProgmDate: type=Ary1D_u8_4, direction=OUT
    PartNrProgmDateWr1
      operation Oper: possible-error=OutOfRange
        arg ProgmDate: type=Ary1D_u8_4, direction=IN
      error OutOfRange: error-code=1
    PartNrProgmSessionKeyChk1
      operation Oper: possible-error=PartNrProgmSessionKeyChk1/InvldKey
        arg ProgmSessionKey: type=Ary1D_u8_5, direction=IN
      error InvldKey: error-code=1
    PartNrProgmSessionSeedRd1
      operation Oper
        arg ProgmSessionSeed: type=Ary1D_u8_5, direction=OUT
    PartNrRepairShopCodRd1
      operation Oper
        arg RepairShopCod: type=Ary1D_u8_20, direction=OUT
    PartNrRepairShopCodWr1
      operation Oper
        arg RepairShopCod: type=Ary1D_u8_10, direction=IN
    PartNrSecuBypAuthnRd_PortIf1
      operation Oper
        arg SecuBypAuthn_Arg: type=Ary1D_u8_822, direction=OUT
    PartNrSecuBypAuthnWr_PortIf1
      operation Oper
        arg SecuBypAuthn_Arg: type=Ary1D_u8_822, direction=IN
    PartNrSysCodVersNrRd1
      operation Oper
        arg SysCodVersNr: type=Ary1D_u8_2, direction=OUT
    PartNrSysCodVersNrWr1
      operation Oper
        arg SysCodVersNr: type=Ary1D_u8_2, direction=IN
    PartNrSysNameRd1
      operation Oper
        arg SysName: type=Ary1D_u8_20, direction=OUT
    PartNrSysNameWr1
      operation Oper
        arg SysName: type=Ary1D_u8_20, direction=IN
    PartNrVinDataRd1
      operation Oper
        arg VinData: type=Ary1D_u8_17, direction=OUT
    PartNrVinDataWr1
      operation Oper
        arg VinData: type=Ary1D_u8_17, direction=IN
    RtnMaxHwAgCwAndCcw_PortIf1
      operation Oper
        arg HwAgCcwMax_Arg: type=float32, direction=OUT
        arg HwAgCwMax_Arg: type=float32, direction=OUT
    UpdHwAgTrimVal_PortIf1
      operation Oper
        arg UpdHwAgTrimValSrvResp_Arg: type=uint8, direction=OUT
  8 x sender receiver interface:
    boolean_PortIf1: invalidation-policy{data-element=Logl, handle-invalid=DONT-INVALIDATE}
      data Logl: sw-calibration-access=READ-ONLY, type=boolean
    float32_PortIf1: invalidation-policy{data-element=float32_PortIf1/Val, handle-invalid=DONT-INVALIDATE}
      data Val: sw-calibration-access=READ-ONLY, type=float32
    GmFctDiArbnSts_PortIf1: invalidation-policy{data-element=GmFctDiArbnSts_PortIf1/Val, handle-invalid=DONT-INVALIDATE}
      data Val: sw-calibration-access=READ-ONLY, type=GmFctDiArbnSts1
    GmSysPwrMod1_PortIf1: invalidation-policy{data-element=GmSysPwrMod1_PortIf1/Val, handle-invalid=DONT-INVALIDATE}
      data Val: type=GmSysPwrMod1
    MfgEnaSt1_PortIf1: invalidation-policy{data-element=MfgEnaSt1_PortIf1/Val, handle-invalid=DONT-INVALIDATE}
      data Val: type=MfgEnaSt1
    SysSt1: invalidation-policy{data-element=SysSt1/Val, handle-invalid=DONT-INVALIDATE}
      data Val: sw-calibration-access=READ-ONLY, type=SysSt1
    uint16_PortIf1: invalidation-policy{data-element=uint16_PortIf1/Val, handle-invalid=DONT-INVALIDATE}
      data Val: sw-calibration-access=READ-ONLY, type=uint16
    uint8_PortIf1: invalidation-policy{data-element=uint8_PortIf1/Val, handle-invalid=DONT-INVALIDATE}
      data Val: sw-calibration-access=READ-ONLY, type=uint8
