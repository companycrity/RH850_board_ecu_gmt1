AUTOSAR XML (schema 4-0-3)
package /Nexteer/Calibrations
  6 x parameter interface:
    Cnt2
      parameter data prototype Val: sw-calibration-access=READ-WRITE, type=uint16
    Frq1
      parameter data prototype Val: sw-calibration-access=READ-WRITE, type=Frq1
    Gain1
      parameter data prototype Val: sw-calibration-access=READ-WRITE, type=Gain1
    T1
      parameter data prototype Val: sw-calibration-access=READ-WRITE, type=T1
    T2
      parameter data prototype Val: sw-calibration-access=READ-WRITE, type=T2
    T3
      parameter data prototype Val: sw-calibration-access=READ-WRITE, type=T4
package /Nexteer/PortInterfaces
  client server interface SetNtcSts1
    operation Oper: possible-error=E_NOT_OK
      4 x arg, all with direction=IN:
        NtcNr: type=NtcNr1
        NtcStInfo: type=uint8
        NtcSts: type=NtcSts1
        DebStep: type=uint16
    error E_NOT_OK: error-code=1
  4 x sender receiver interface:
    boolean_PortIf1: invalidation-policy{data-element=boolean_PortIf1/Logl, handle-invalid=DONT-INVALIDATE}
      data Logl: sw-calibration-access=READ-ONLY, type=boolean
    Logl1: invalidation-policy{data-element=Logl1/Logl, handle-invalid=DONT-INVALIDATE}
      data Logl: sw-calibration-access=READ-ONLY, type=boolean
    T1: invalidation-policy{data-element=T1/Val, handle-invalid=DONT-INVALIDATE}
      data Val: sw-calibration-access=READ-ONLY, type=T1
    Volt3: invalidation-policy{data-element=Volt3/Val, handle-invalid=DONT-INVALIDATE}
      data Val: sw-calibration-access=READ-ONLY, type=Volt3
