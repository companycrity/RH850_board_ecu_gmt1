AUTOSAR XML (schema 4-0-3)
package /Nexteer/PortInterfaces
  client server interface PwrTurnOffCtrl_PortIf1
    operation Oper
      arg PinSt_Arg: type=boolean, direction=IN
  client server interface SetGpio_PortIf1
    operation Oper: possible-error=E_NOT_OK
      arg PinSt_Arg: type=boolean, direction=IN
    error E_NOT_OK: error-code=1
  sender receiver interface Cnt6: invalidation-policy{data-element=Cnt6/Val, handle-invalid=DONT-INVALIDATE}
    data Val: sw-calibration-access=READ-ONLY, type=uint8
  sender receiver interface Logl1: invalidation-policy{data-element=Logl, handle-invalid=DONT-INVALIDATE}
    data Logl: sw-calibration-access=READ-ONLY, type=boolean
  sender receiver interface SysSt1: invalidation-policy{data-element=SysSt1/Val, handle-invalid=DONT-INVALIDATE}
    data Val: sw-calibration-access=READ-ONLY, type=SysSt1
