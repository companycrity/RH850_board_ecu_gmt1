AUTOSAR XML (schema 4.0)
# Copyright (c) 2012 by Vector Informatik GmbH. All rights reserved.
# This software is copyright protected and proprietary to Vector Informatik GmbH.
# Vector Informatik GmbH grants to you only those rights as set out in the license conditions.
package /MICROSAR
  bsw implementation Board_Impl: programming-language=C, sw-version=2.0.0, used-code-generator=cMICROSAR, vendor-id=30, ar-release-version=4.0.0, preconfigured-configuration=Board_Pre, recommended-configuration=Board_Rec, vendor-specific-module-def=Board
  module definition Board: variants pre-compile  # Contains all controller-specific parameters for the generator
    container BoardGeneral  # The general configuration of the controller.
      float BoardOscillator: 16..16, set at pre-compile, origin=Vector Informatik, default-value=16  # Oscillator frequency (in MHz).
      boolean BoardAtomicBitAccessInBitfield [0..1]: set at pre-compile, origin=Vector Informatik  # Enables optimization for single bit read and write accesses in bit-fields if the compiler creates an atomic access in all cases. This is compiler and platform dependent and has to be checked and configured very carefully! Caution Enabling this configuration option requires atomic bit access in bit-fields. This option must only be enabled if the before mentioned access type is supported by the hardware, the compiler and the used compiler options. Enabling this option without verifying those conditions may lead to data consistency issues.
      enumeration BoardAtomicVariableAccess [0..1]: set at pre-compile, origin=Vector Informatik  # Selection of Bit size for atomic read and write accesses of global variables. This configuration switch is compiler and platform dependent and has to be checked and configured very carefully! Caution Setting this configuration option to "Atomic16BitAccess" requires atomic access all global 8 Bit and 16 Bit variables. Setting this configuration option to "Atomic32BitAccess" requires atomic access all global 8 Bit, 16 Bit and 32 Bit variables. The optimization must only be enabled if the before mentioned access types are supported by the hardware, the compiler and the used compiler options. Enabling the optimization without verifying those conditions may lead to data consistency issues.
        Atomic8BitAccess  # Atomic 8 Bit Access
        Atomic16BitAccess  # Atomic 16 Bit Access
        Atomic32BitAccess  # Atomic 32 Bit Access
      integer BoardWidthOfPointer [0..1]: 1..32, set at pre-compile, origin=Vector Informatik  # Width of Pointer in Byte. Depends on the memory model of the controller.
      enumeration BoardStructAlignment [0..1]: {Auto, Byte, Word, DWord}, set at pre-compile, origin=Vector Informatik  # Alignment inside an struct element. Insert padding bytes so that each element of the struct starts at a valid position
      enumeration BoardArrayAlignment [0..1]: {Byte, Word, DWord}, set at pre-compile, origin=Vector Informatik  # Alignment of Arrays. Insert padding bytes so that this array starts at a valid position
      enumeration BoardStructInArrayAlignment [0..1]: {Byte, Word, DWord}, set at pre-compile, origin=Vector Informatik  # Alignment of Structs in an Array. Insert padding bytes so that the struct starts at a valid position. Depends on compiler settings.
      integer BoardAlignmentFillPattern [0..1]: 0..255, set at pre-compile, origin=Vector Informatik  # Alignment Fill Pattern. Byte pattern which is used for the inserted padding bytes.
      enumeration BoardSizeOfPduIdType [0..1]: set at pre-compile, origin=Vector Informatik  # The PduIdType type is declared in ComStackTypes.h (uint8 or uint16) sizeof(PduIdType) [byte]
        One_Byte  # 1 Byte
        Two_Byte  # 2 Byte
      enumeration BoardSizeOfPduLengthType [0..1]: set at pre-compile, origin=Vector Informatik  # The PduIdType type is declared in ComStackTypes.h (uint8, uint16 or uint32) sizeof(PduLengthType) [byte]
        One_Byte  # 1 Byte
        Two_Byte  # 2 Byte
        Four_Byte  # 4 Byte
      enumeration BoardSizeOfEnum [0..1]: set at pre-compile, origin=Vector Informatik  # Size of elements in an enum. Depends on the compiler settings.
        One_Byte  # 1 Byte
        Two_Byte  # 2 Byte
        Four_Byte  # 4 Byte
      enumeration BoardSizeOfIdType [0..1]: set at pre-compile, origin=Vector Informatik  # The byte size used for CAN Identifiers. The IdType type is declared in ComStackTypes.h (uint16 or uint32)
        Two_Byte  # 2 Byte
        Four_Byte  # 4 Byte
      enumeration BoardSizeOfBoolean [0..1]: set at pre-compile, origin=Vector Informatik  # Size of boolean elements. Depends on the compiler settings.
        One_Byte  # 1 Byte
        Two_Byte  # 2 Byte
        Four_Byte  # 4 Byte
      integer BoardMinObjectSize [0..1]: 1..255, set at pre-compile, origin=Vector Informatik  # Min Object Size.
      boolean BoardGlobalGPageBehaviour [0..1]: set at pre-compile, origin=Vector Informatik  # Global GPage Behaviour
      boolean BoardUseExtendedAsrVersionCheck [0..1]: set at pre-compile, origin=Vector Informatik
      boolean BoardPCAndLTCRCCheck [0..1]: set at pre-compile, origin=Vector Informatik  # Precompile And Linktime CRC Check
      string systemVersion: set at pre-compile, origin=Vector Informatik  # systemVersion as found in SystemExtract
      string ecuExtractVersion: set at pre-compile, origin=Vector Informatik  # ecuExtractVersion as found in SystemExtract
      enumeration BoardOsType: {None, OSEK, Autosar}, set at pre-compile, origin=Vector Informatik, default-value=None  # Select Os type
      boolean SilentCheck [0..1]: set at pre-compile, origin=Vector Informatik, default-value=false  # Enables optimization for single bit read and write accesses in bit-fields if the compiler creates an atomic access in all cases. This is compiler and platform dependent and has to be checked and configured very carefully! Caution Enabling this configuration option requires atomic bit access in bit-fields. This option must only be enabled if the before mentioned access type is supported by the hardware, the compiler and the used compiler options. Enabling this option without verifying those conditions may lead to data consistency issues.
      boolean BoardDummyFunction: set at pre-compile, origin=Vector Informatik, default-value=false  # Dummy functions used to avoid NULL pointer entrance in call tables
      boolean BoardDummyStatement: set at pre-compile, origin=Vector Informatik, default-value=false  # Dummy statements used to avoid compiler warnings about e.g. unused parameters
      boolean BoardConditionalGenerating: set at pre-compile, origin=Vector Informatik, default-value=false  # If the conditional generation is enabled, only the files are written to the output directory which are changed in their content. The MagicNumber check is disabled when the conditional generation is enabled.
      boolean BoardEnableSnvPrefixes: set at pre-compile, origin=Vector Informatik, default-value=true  # This switch controls the generation of symbolic name values addresses in [ecuc_sws_2108]. If the switch is set to 'true' the containernames are decorated with the related module's msn-prefixes.
      enumeration BoardCPUType [0..1]: set at pre-compile, origin=Vector Informatik, default-value=CPU16Bit
        CPU8Bit  # CPU 8 Bit
        CPU16Bit  # CPU 16 Bit
        CPU32Bit  # CPU 32 Bit
        CPU64Bit  # CPU 64 Bit
      enumeration BoardByteOrder [0..1]: set at pre-compile, origin=Vector Informatik, default-value=Undefined
        Undefined
        Big_Endian  # Big Endian
        Little_Endian  # Little Endian
      enumeration BoardBitOrder [0..1]: set at pre-compile, origin=Vector Informatik, default-value=Undefined
        Undefined
        LSB_to_MSB  # LSB to MSB
        MSB_to_LSB  # MSB to LSB
    container InterruptFunctionality  # Global interrupt settings used for the ECUC.
      string BoardIncludeIsrList: set at pre-compile, origin=Vector Informatik, default-value=Os.h  # Include File for ISR-Macro
      boolean BoardUseSchm: set at pre-compile, origin=Vector Informatik, default-value=true  # Use BSW Schedule Manager
      string BoardGlobalReEnableCat1: set at pre-compile, origin=Vector Informatik
      string BoardGlobalReEnableCat2: set at pre-compile, origin=Vector Informatik
      container InterruptFunctionSet [0..*]  # A function set consisting of Interrupt Suspend Function, Interrupt Restore Function and Include File for those functions.
        string BoardGlobalSuspend: set at pre-compile, origin=Vector Informatik  # Suspend Function
        string BoardGlobalRestore: set at pre-compile, origin=Vector Informatik  # Restore Function
        string BoardIncludeFile [1..*]: set at pre-compile, origin=Vector Informatik  # Include file for the function set.
  module config Board_Rec: definition=Board
    InterruptFunctionality
      4 x InterruptFunctionSet:
        SuspendAllInterrupts: BoardGlobalSuspend=SuspendAllInterrupts(), BoardGlobalRestore=ResumeAllInterrupts(), BoardIncludeFile=Os.h
        SuspendOSInterrupts: BoardGlobalSuspend=SuspendOSInterrupts(), BoardGlobalRestore=ResumeOSInterrupts(), BoardIncludeFile=Os.h
        DisableAllInterrupts: BoardGlobalSuspend=DisableAllInterrupts(), BoardGlobalRestore=EnableAllInterrupts(), BoardIncludeFile=Os.h
        NoCriticalSectionHandling: BoardGlobalSuspend=(unset), BoardGlobalRestore=(unset), BoardIncludeFile=(unset)
  module config Board_Pre: definition=Board
