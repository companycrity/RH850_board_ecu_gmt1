AUTOSAR XML (schema 4-0-3)
package /TTTECH
  module definition WdgIf [0..1]: refined-module-def=WdgIf, variants pre-compile  # Configuration of the WdgIf (Watchdog Interface) module.
    container WdgIfDevice [1..*]  # It contains the information for the selection of a particular Watchdog device in case multiple Watchdog drivers are connected.
      integer WdgIfDeviceIndex: 0..255, set at pre-compile, symbolic-name-value=true  # Represents the watchdog interface ID so that it can be referenced by the watchdog manager.
      symbolic name reference WdgIfDriverRef: set at pre-compile, destination=WdgGeneral  # Reference to the watchdog drivers that are controlled by the watchdog interface.
    container WdgIfGeneral  # This container collects all generic watchdog interface parameters.
      boolean WdgIfDevErrorDetect: set at pre-compile  # Pre-processor switch for enabling the development error detection and reporting. | true: Development error detection enabled false: Development error detection disabled
      boolean WdgIfVersionInfoApi: set at pre-compile, default-value=false  # Pre-processor switch to enable / disable the service returning the version information. | true: Version information service enabled false: Version information service disabled
      boolean WdgIfUseAutosarDrvApi: set at pre-compile  # Pre-processor switch for enabling the usage of a fully AUTOSAR compliant driver API functions. | true: AUTOSAR compliant driver API functions are utilized. Note: the parameter Window Start (WdgMTriggerWindowStart) of the S-WdgM configuration is then ignored. false: TTTech driver API functions are utilized
      choice reference WdgIfInternalTickCounterRef [0..1]: set at pre-compile, origin=TTTECH, destination=Wdg  # If this parameter references a driver which implements an internal tick counter then the API WdgIf_InternalTickCounter() is compiled and can be used by the Safe Watchdog Manager. Otherwise the API is not compiled. Note: If a driver is selected then it must support internal tick counter and its parameter WdgInternalTickCounter must be set to true.
  bsw implementation WdgIf_Impl: programming-language=C, sw-version=3.3.6, used-code-generator=TTTech, vendor-id=46, ar-release-version=4.00.03, preconfigured-configuration=WdgIf_Pre, recommended-configuration=WdgIf_Rec, vendor-specific-module-def=WdgIf
  module config WdgIf_Pre: definition=WdgIf
  module config WdgIf_Rec: definition=WdgIf_Pre
