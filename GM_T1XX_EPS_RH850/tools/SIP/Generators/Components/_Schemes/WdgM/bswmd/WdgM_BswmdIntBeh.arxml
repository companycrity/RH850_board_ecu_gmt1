AUTOSAR XML (schema 4-0-3)
package /TTTECH
  bsw implementation WdgM_Impl: behavior=WdgMBehavior
