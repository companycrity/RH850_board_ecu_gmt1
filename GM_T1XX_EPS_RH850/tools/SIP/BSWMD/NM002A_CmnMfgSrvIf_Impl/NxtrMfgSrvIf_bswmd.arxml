AUTOSAR XML (schema 4-0-3)
package /Nexteer
  module definition NxtrMfgSrvIf [0..1]: variants pre-compile  # Configuration of Nexteer Common Manufacturing Services Interface (to CAN transport layer).
    container NxtrMfgSrvIfGeneral  # General configuration options for Nexteer Manufacturing Service Interface
      integer BufSize: 8..4095, origin=NEXTEER  # Nexteer manufacturing services buffer size. This needs to be large enough to accommodate all of the data from the largest manufacturing service AND the couple of bytes of overhead for the service including the service type (such as $22, $2E, $31, etc.), two bytes for the service id, and an optional byte for the sub-function (if supported by the corresponding service type).
