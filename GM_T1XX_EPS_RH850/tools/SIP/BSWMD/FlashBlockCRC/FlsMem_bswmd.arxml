AUTOSAR XML (schema 4-0-3)
package /Nexteer
  module definition FlsMem [0..1]: variants pre-compile  # Configuration of the Flash CRC Blocks.
    container FlashCRCRegnConfig [0..255]  # This is the container for the Flash Block Configuration
      integer StartAddress: 0x00000000..0xFFFFFFFF, origin=NEXTEER  # Start Address of the Flash Block.
      integer Length: 0x00000000..0xFFFFFFFF, origin=NEXTEER  # Length of the Flash Block.
      integer PredefinedCrcAddress: 0x00000000..0xFFFFFFFF, origin=NEXTEER  # Start Address of the Flash Block.
