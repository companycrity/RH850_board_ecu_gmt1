AUTOSAR XML (schema 4-0-3)
# COPYRIGHT
# Copyright (c) 2013 by Vector Informatik GmbH. All rights reserved.
# This software is copyright protected and proprietary to Vector Informatik GmbH.
# Vector Informatik GmbH grants to you only those rights as set out in the license conditions.
package /MICROSAR  # NvM Preconfiguration
  module config NvM_Pre: definition=NvM, implementation-config-variant=VARIANT-PRE-COMPILE
  module config NvM_Rec: definition=NvM
    NvMConfigBlock (NvMBlockDescriptor): NvMUseServicePorts=0
    NvMCommon: NvMDevErrorDetect=1, NvMVersionInfoApi=0
    NvMCommonVendorParams: NvMCfgIncludeDem=Dem.h, NvMSeterror=Dem_ReportErrorStatus
      NvMDevErrorChecks: NvMCfgIncludeDet=Det.h, NvMErrorhook=Det_ReportError
  module config NvM_Rec_Class1: definition=NvM
    NvMBlockDescriptor:
      NvMBlockCrcType = NVM_CRC16
      NvMBlockManagementType = NVM_BLOCK_NATIVE
      NvMInitBlockCallback = NULL_PTR
      NvMResistantToChangedSw = 1
      NvMSelectBlockForReadAll = 1
      NvMSelectBlockForWriteAll = 0
      NvMReadRamBlockFromNvCallback = (unset)
      NvMWriteRamBlockToNvCallback = NULL_PTR
      NvMUseInitCallback = 0
      NvMUseJobendCallback = 0
      NvMSingleBlockCallback = NULL_PTR
      NvMBswMBlockStatusInformation = 0
      NvMBlockUseCrc = 1
      NvMBlockUseSyncMechanism = 0
      NvMCalcRamBlockCrc = 0
