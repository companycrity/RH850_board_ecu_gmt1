[part 2 of 2: package /Renesas/EcucDefs_Mcu]
AUTOSAR XML (schema 4-0-3)
# COPYRIGHT
# Copyright(c) 2014-2016 Renesas Electronics Corporation
package /Renesas/EcucDefs_Mcu  (continued)
  module definition Mcu: refined-module-def=Mcu, variants post-build  (continued)
    container McuModuleConfiguration: multiple-configuration-container=true  # This container contains the configuration (parameters) of the MCU driver.
      enumeration McuClockSrcFailureNotification: {DISABLED, ENABLED}, set at post-build, default-value=DISABLED  # This parameter enables or disables clock failure notification. In case this feature is not supported by HW the setting should be disabled. This parameter is not used for implementation. | ENABLED: enables clock failure notification. DISABLED: disables clock failure notification.
      enumeration McuLviDetectionLevel: {DETECTION_LEVEL_0, DETECTION_LEVEL_1, DETECTION_LEVEL_3}, set at post-build, origin=Renesas_v1.0.0, default-value=DETECTION_LEVEL_0  # This parameter contains the Low Voltage Indicator (LVI) detection level. | DETECTION_LEVEL_0: LVI is not active. DETECTION_LEVEL_1: LVI level 1 (4.5 V). DETECTION_LEVEL_3: LVI level 3 (3.1 V).
      boolean McuLviResetMask: set at post-build, origin=Renesas_v1.0.0, default-value=false  # This parameter contains the LVI error mask or un-mask setting. | true: LVI error is masked. false: LVI error is not masked.
      integer McuNumberOfMcuModes: 1..255, set at pre-compile, default-value=1  # This parameter shall represent the number of Modes available for the MCU. Controller is not supporting low power modes hence this parameter is not used for implementation. | calculation Formula = Number of configured McuModeSettingConf
      integer McuRamSectors: 1..4294967295, set at post-build, default-value=1  # This parameter shall represent the number of RAM sectors available for the MCU. Parameter "McuRamSectorSetting" in "McuGeneralConfiguration" container is used instead of this parameter. Hence this parameter is not used for implementation. | calculation Formula = Number of configured McuRamSectorSettingConf
      integer McuResetSetting [0..1]: 1..255, set at pre-compile, default-value=1  # This parameter relates to the MCU specific reset configuration. This applies to the function Mcu_PerformReset, which performs a microcontroller reset using the hardware feature of the microcontroller. Since there is no configuration of reset feature required for performing reset of this microcontroller using Mcu_PerformReset api, hence this parameter is not used for implementation.
      boolean McuCvmOutMaskFbist: set at post-build, origin=Renesas_v1.0.0, default-value=false  # This parameter enables or disables the CVMOUT Output Mask for FBIST Operation. | true: disables the CVMOUT Output Mask for FBIST Operation. false: enables the CVMOUT Output Mask for FBIST Operation.
      boolean McuCvmOutMaskDiag: set at post-build, origin=Renesas_v1.0.0, default-value=false  # This parameter enables or disables the CVMOUT Output Mask for DIAG Operation. | true: disables the CVMOUT Output Mask for DIAG Operation. false: enables the CVMOUT Output Mask for DIAG Operation.
      boolean McuCvmOutputFilter: set at post-build, origin=Renesas_v1.0.0, default-value=false  # This parameter enables or disables the CVMOUT Output Filter Control. | true: disables the 1 micro output filter of CVMOUT. false: enables the 1 micro output filter of CVMOUT.
      boolean McuCvmDiagLockBit: set at post-build, origin=Renesas_v1.0.4, default-value=true  # This parameter lock or unlock the CVM Diagnosis during normal operation. | true: lock the CVM Diagnosis during normal operation. false: unlock the CVM Diagnosis during normal operation. This needs to be set true when using ASIL applications.
      boolean McuCvmResetEnable: set at post-build, origin=Renesas_v1.0.0, default-value=false  # This parameter enables or disables a reset of core voltage operation area upon detection of abnormal in core power supply. The register CVMREN can be set only once after a power-on reset is cancelled. So, it should be taken care while configuring this parameter for multiple configurations. | true: enables a reset of core voltage operation. false: disables a reset of core voltage operation.
      container McuClockSettingConfig [1..255]  # This container contains the configuration (parameters) for the Clock settings of the MCU. Please see MCU031 for more information on the MCU clock settings.
        integer McuClockSettingId: 0..255, set at pre-compile, symbolic-name-value=true, default-value=0  # The Id of this McuClockSettingConfig to be used as argument for the API call "Mcu_InitClock".
        integer McuMainOsciFrequency: 16000000..16000000, set at pre-compile, origin=Renesas_v1.0.0, default-value=16000000  # This parameter holds the main oscillator frequency in Hz.
        integer McuCpuMainSysClk: 160000000..160000000, set at post-build, origin=Renesas_v1.0.0, default-value=160000000  # This parameter contains the CPU main system clock frequency. This parameter does not affect the behavior of the MCU driver. It is a frequency that will be available to other modules for reference. It either needs to be calculated manually or by the configuration editor.
        enumeration McuUnitName: {CLK_CPU}, set at post-build, origin=Renesas_v1.0.0, default-value=CLK_CPU  # This parameter contains the functional unit name for the CPU. | CLK_CPU: CLK_CPU is unit name.
        container McuHighspeedPeriClk [0..1]  # This container contains the parameters related to High Speed Peripheral clock.
          enumeration McuUnitName: {CLK_HSB}, set at post-build, origin=Renesas_v1.0.0, default-value=CLK_HSB  # This parameter contains the functional unit name for the High Speed Peripheral clock. | CLK_HSB: CLK_HSB is unit name.
          integer McuPeripheralClock: 80000000..80000000, set at post-build, origin=Renesas_v1.0.0, default-value=80000000  # This parameter contains the High Speed Peripheral clock value. Unit is in Hertz.
        container McuLowspeedPeriClk [0..1]  # This container contains the parameters related to Low Speed Peripheral clock.
          enumeration McuUnitName: {CLK_LSB}, set at post-build, origin=Renesas_v1.0.0, default-value=CLK_LSB  # This parameter contains the functional unit name for the Low Speed Peripheral clock. | CLK_LSB: CLK_LSB is unit name.
          integer McuPeripheralClock: 40000000..40000000, set at post-build, origin=Renesas_v1.0.0, default-value=40000000  # This parameter contains the Low Speed Peripheral clock value. Unit is in Hertz.
        container McuWdtacounterClk [0..1]  # This container contains the parameters related to Wdta counter Clock.
          enumeration McuWdtCounterDivider: {DIVBY_1_ID_1, DIVBY_32_ID_1}, set at post-build, origin=Renesas_v1.0.0, default-value=DIVBY_1_ID_1  # This parameter contains the divider for the WDTA counter clock. | DIVBY_1_ID_1: WdtacounterClk/1 is selected as clock divider. DIVBY_32_ID_1: WdtacounterClk/32 is selected as clock divider.
          enumeration McuUnitName: {WDTCLKI}, set at post-build, origin=Renesas_v1.0.0, default-value=WDTCLKI  # This parameter contains the functional unit name for the Wdta counter Clock. | WDTCLKI: WDTCLKI is unit name.
          integer McuPeripheralClock: 250000..8000000, set at post-build, origin=Renesas_v1.0.0, default-value=8000000  # This parameter contains the Wdta counter Clock. Unit is in Hertz.
        container McuExternalClkOutSetting  # This container contains the parameters related to External clock output Setting.
          enumeration McuExternalClk0SourceSel: {MCU_NO_OUTPUT, MCU_MAIN_OSCILLATOR, MCU_INTERNAL_OSCILLATION_CLOCK, MCU_HIGH_SPEED_PERI_CLOCK}, set at post-build, origin=Renesas_v1.0.0, default-value=MCU_NO_OUTPUT  # This parameter is to select the external clock 0 source. | MCU_NO_OUTPUT: No clock. MCU_MAIN_OSCILLATOR: 16MHz MainOSC. MCU_INTERNAL_OSCILLATION_CLOCK: 8MHz HS IntOSC. MCU_HIGH_SPEED_PERI_CLOCK: 80MHz High-speed peripheral clock.
          integer McuExternalClk0DividerSel: 1..511, set at post-build, origin=Renesas_v1.0.0, default-value=1  # This parameter is to select the divider for external clock 0 source. The value configured for this parameter will be ignored if parameter 'McuExternalClk0SourceSel' is configured as 'MCU_NO_OUTPUT'.
          integer McuExternalClock0: 0..80000000, set at post-build, origin=Renesas_v1.0.0, default-value=0  # This parameter contains the output of External Clock 0 value.
          enumeration McuExternalClk1SourceSel: {MCU_NO_OUTPUT, MCU_MAIN_OSCILLATOR, MCU_INTERNAL_OSCILLATION_CLOCK, MCU_HIGH_SPEED_PERI_CLOCK}, set at post-build, origin=Renesas_v1.0.0, default-value=MCU_NO_OUTPUT  # This parameter is to select the external clock 1 source. | MCU_NO_OUTPUT: No clock. MCU_MAIN_OSCILLATOR: 16MHz MainOSC. MCU_INTERNAL_OSCILLATION_CLOCK: 8MHz HS IntOSC. MCU_HIGH_SPEED_PERI_CLOCK: 80MHz High-speed peripheral clock.
          integer McuExternalClk1DividerSel: 1..511, set at post-build, origin=Renesas_v1.0.0, default-value=1  # This parameter is to select the divider for external clock 1 source. The value configured for this parameter will be ignored if parameter 'McuExternalClk1SourceSel' is configured as 'MCU_NO_OUTPUT'.
          integer McuExternalClock1: 0..80000000, set at post-build, origin=Renesas_v1.0.0, default-value=0  # This parameter contains the output of External Clock 1 value.
        container McuAdcClk  # This container contains the clock settings for ADC.
          enumeration McuDivClockSel: {CLK_LSB, CLK_LSB_BY_2}, set at post-build, origin=Renesas_v1.0.0, default-value=CLK_LSB  # This parameter contains the Divider selection for ADC clock source. | CLK_LSB: Low-speed peripheral clock. CLK_LSB_BY_2: Low-speed peripheral clock divided by two.
          enumeration McuUnitName: {ADC}, set at post-build, origin=Renesas_v1.0.0, default-value=ADC  # This parameter contains the functional unit name for the ADC. | ADC: ADC is unit name.
          integer McuPeripheralClock: 20000000..40000000, set at post-build, origin=Renesas_v1.0.0, default-value=40000000  # This parameter contains the Peripheral clock value.
        container McuClockReferencePoint [1..*]  # This container defines a reference point in the Mcu Clock tree. It defines the frequency which can be used by other modules as an input value. Lower multiplicity is 1, as even in the simplest case (only one frequency is used), there is one frequency to be defined. This container is not used for implementation.
          float McuClockReferencePointFrequency: 0..160000000, set at post-build, default-value=0  # This is the frequency for the specific instance of the McuClockReferencePoint container. It shall be given in Hz. This parameter is not used for implementation. So if its used for reference frequency then user has to take care for configuration of valid clock domain associated with it.
      container McuEcmErrorSourcesCfg  # This container contains the configuration related to all the error sources which are input to ECM.
        container McuEcmErrorSource0  # This container contains all the supported configuration parameters of the related error source from WDTA module.
          boolean McuEcmErrorMaskableInterrupt: set at post-build, origin=Renesas_v1.0.0, default-value=false  # This parameter enables or disables generation of a maskable interrupt when the error occurs from WDTA module. | true: enables generation of a maskable interrupt when the error occurs from WDTA module. false: disables generation of a maskable interrupt when the error occurs from WDTA module.
          boolean McuEcmErrorNonMaskableInterrupt: set at post-build, origin=Renesas_v1.0.0, default-value=false  # This parameter enables or disables generation of a non-maskable interrupt when the error occurs from WDTA module. | true: enables generation of a non-maskable interrupt when the error occurs from WDTA module. false: disables generation of a non-maskable interrupt when the error occurs from WDTA module.
          boolean McuEcmErrorInternalReset: set at post-build, origin=Renesas_v1.0.0, default-value=false  # This parameter enables or disables generation of an internal reset when the error occurs from WDTA module. | true: enables generation of an internal reset when the error occurs from WDTA module. false: disables generation of an internal reset when the error occurs from WDTA module.
          boolean McuEcmErrorNMIDelayTimer: set at post-build, origin=Renesas_v1.0.0, default-value=false  # This parameter enables or disables delay timer start caused by non-maskable interrupts in response to errors from WDTA module. | true: enables delay timer start caused by non-maskable interrupts in response to errors from WDTA module. false: disables delay timer start caused by non-maskable interrupts in response to errors from WDTA module.
          boolean McuEcmErrorMIDelayTimer: set at post-build, origin=Renesas_v1.0.0, default-value=false  # This parameter enables or disables delay timer start caused by maskable interrupts in response to errors from WDTA module. | true: enables delay timer start caused by maskable interrupts in response to errors from WDTA module. false: disables delay timer start caused by maskable interrupts in response to errors from WDTA module.
          boolean McuEcmErrorOutputMask: set at post-build, origin=Renesas_v1.0.0, default-value=true  # This parameter mask or unmask the individual error sources of the error pin output from WDTA module. | true: mask the individual error sources of the error pin output from WDTA module. false: unmask the individual error sources of the error pin output from WDTA module.
          function name McuMiNotification [0..1]: set at post-build, origin=Renesas_v1.0.0, default-value=NULL_PTR, regular-expression=[a-zA-Z][a-zA-Z0-9_]*  # This parameter contains notification function for MI notification. | The syntax for McuMiNotification should be provided as Mcu_EcmMINotification.
          function name McuNmiNotification [0..1]: set at post-build, origin=Renesas_v1.0.0, default-value=NULL_PTR, regular-expression=[a-zA-Z][a-zA-Z0-9_]*  # This parameter contains notification function for NMI notification. | The syntax for McuNmiNotification should be provided as Mcu_EcmNMINotification.
          function name McuEcmInitialNotification [0..1]: set at post-build, origin=Renesas_v1.0.2, default-value=NULL_PTR, regular-expression=[a-zA-Z][a-zA-Z0-9_]*  # This parameter is used for notify the upper layer, if any ECM error has been already detected at system start-up. | The syntax for McuEcmInitialNotification should be provided as Mcu_EcmInitialNotification.
        container McuEcmErrorSource1  # This container contains all the supported configuration parameters of the related error source from Lock step compare module.
          boolean McuEcmErrorMaskableInterrupt: set at post-build, origin=Renesas_v1.0.0, default-value=false  # This parameter enables or disables generation of a maskable interrupt when the error occurs from Lock step compare module. | true: enables generation of a maskable interrupt when the error occurs from Lock step compare module. false: disables generation of a maskable interrupt when the error occurs from Lock step compare module.
          boolean McuEcmErrorNonMaskableInterrupt: set at post-build, origin=Renesas_v1.0.0, default-value=false  # This parameter enables or disables generation of a non-maskable interrupt when the error occurs from Lock step compare module. | true: enables generation of a non-maskable interrupt when the error occurs from Lock step compare module. false: disables generation of a non-maskable interrupt when the error occurs from Lock step compare module.
          boolean McuEcmErrorInternalReset: set at post-build, origin=Renesas_v1.0.0, default-value=false  # This parameter enables or disables generation of an internal reset when the error occurs from Lock step compare module. | true: enables generation of an internal reset when the error occurs from Lock step compare module. false: disables generation of an internal reset when the error occurs from Lock step compare module.
          boolean McuEcmErrorNMIDelayTimer: set at post-build, origin=Renesas_v1.0.0, default-value=false  # This parameter enables or disables delay timer start caused by non-maskable interrupts in response to errors from Lock step compare module. | true: enables delay timer start caused by non-maskable interrupts in response to errors from Lock step compare module. false: disables delay timer start caused by non-maskable interrupts in response to errors from Lock step compare module.
          boolean McuEcmErrorMIDelayTimer: set at post-build, origin=Renesas_v1.0.0, default-value=false  # This parameter enables or disables delay timer start caused by maskable interrupts in response to errors from Lock step compare module. | true: enables delay timer start caused by maskable interrupts in response to errors from Lock step compare module. false: disables delay timer start caused by maskable interrupts in response to errors from Lock step compare module.
          boolean McuEcmErrorOutputMask: set at post-build, origin=Renesas_v1.0.0, default-value=true  # This parameter mask or unmask the individual error sources of the error pin output from Lock step compare module. | true: mask the individual error sources of the error pin output from Lock step compare module. false: unmask the individual error sources of the error pin output from Lock step compare module.
          function name McuMiNotification [0..1]: set at post-build, origin=Renesas_v1.0.0, default-value=NULL_PTR, regular-expression=[a-zA-Z][a-zA-Z0-9_]*  # This parameter contains notification function for MI notification. | The syntax for McuMiNotification should be provided as Mcu_EcmMINotification.
          function name McuNmiNotification [0..1]: set at post-build, origin=Renesas_v1.0.0, default-value=NULL_PTR, regular-expression=[a-zA-Z][a-zA-Z0-9_]*  # This parameter contains notification function for NMI notification. | The syntax for McuNmiNotification should be provided as Mcu_EcmNMINotification.
          function name McuEcmInitialNotification [0..1]: set at post-build, origin=Renesas_v1.0.2, default-value=NULL_PTR, regular-expression=[a-zA-Z][a-zA-Z0-9_]*  # This parameter is used for notify the upper layer, if any ECM error has been already detected at system start-up. | The syntax for McuEcmInitialNotification should be provided as Mcu_EcmInitialNotification.
        container McuEcmErrorSource4  # This container contains all the supported configuration parameters of the related error source from Clock monitor upper-limit error (MOSC).
          boolean McuEcmErrorMaskableInterrupt: set at post-build, origin=Renesas_v1.0.0, default-value=false  # This parameter enables or disables generation of a maskable interrupt when the error occurs from Clock monitor upper-limit error (MOSC). | true: enables generation of a maskable interrupt when the error occurs from Clock monitor upper-limit error (MOSC). false: disables generation of a maskable interrupt when the error occurs from Clock monitor upper-limit error (MOSC).
          boolean McuEcmErrorNonMaskableInterrupt: set at post-build, origin=Renesas_v1.0.0, default-value=false  # This parameter enables or disables generation of a non-maskable interrupt when the error occurs from Clock monitor upper-limit error (MOSC). | true: enables generation of a non-maskable interrupt when the error occurs from Clock monitor upper-limit error (MOSC). false: disables generation of a non-maskable interrupt when the error occurs from Clock monitor upper-limit error (MOSC).
          boolean McuEcmErrorInternalReset: set at post-build, origin=Renesas_v1.0.0, default-value=false  # This parameter enables or disables generation of an internal reset when the error occurs from Clock monitor upper-limit error (MOSC). | true: enables generation of an internal reset when the error occurs from Clock monitor upper-limit error (MOSC). false: disables generation of an internal reset when the error occurs from Clock monitor upper-limit error (MOSC).
          boolean McuEcmErrorNMIDelayTimer: set at post-build, origin=Renesas_v1.0.0, default-value=false  # This parameter enables or disables delay timer start caused by non-maskable interrupts in response to errors from Clock monitor upper-limit error (MOSC). | true: enables delay timer start caused by non-maskable interrupts in response to errors from Clock monitor upper-limit error (MOSC). false: disables delay timer start caused by non-maskable interrupts in response to errors from Clock monitor upper-limit error (MOSC).
          boolean McuEcmErrorMIDelayTimer: set at post-build, origin=Renesas_v1.0.0, default-value=false  # This parameter enables or disables delay timer start caused by maskable interrupts in response to errors from Clock monitor upper-limit error (MOSC). | true: enables delay timer start caused by maskable interrupts in response to errors from Clock monitor upper-limit error (MOSC). false: disables delay timer start caused by maskable interrupts in response to errors from Clock monitor upper-limit error (MOSC).
          boolean McuEcmErrorOutputMask: set at post-build, origin=Renesas_v1.0.0, default-value=true  # This parameter mask or unmask the individual error sources of the error pin output from Clock monitor upper-limit error (MOSC). | true: mask the individual error sources of the error pin output from Clock monitor upper-limit error (MOSC). false: unmask the individual error sources of the error pin output from Clock monitor upper-limit error (MOSC).
          function name McuMiNotification [0..1]: set at post-build, origin=Renesas_v1.0.0, default-value=NULL_PTR, regular-expression=[a-zA-Z][a-zA-Z0-9_]*  # This parameter contains notification function for MI notification. | The syntax for McuMiNotification should be provided as Mcu_EcmMINotification.
          function name McuNmiNotification [0..1]: set at post-build, origin=Renesas_v1.0.0, default-value=NULL_PTR, regular-expression=[a-zA-Z][a-zA-Z0-9_]*  # This parameter contains notification function for NMI notification. | The syntax for McuNmiNotification should be provided as Mcu_EcmNMINotification.
          function name McuEcmInitialNotification [0..1]: set at post-build, origin=Renesas_v1.0.2, default-value=NULL_PTR, regular-expression=[a-zA-Z][a-zA-Z0-9_]*  # This parameter is used for notify the upper layer, if any ECM error has been already detected at system start-up. | The syntax for McuEcmInitialNotification should be provided as Mcu_EcmInitialNotification.
        container McuEcmErrorSource5  # This container contains all the supported configuration parameters of the related error source from Clock monitor lower-limit error (MOSC).
          boolean McuEcmErrorMaskableInterrupt: set at post-build, origin=Renesas_v1.0.0, default-value=false  # This parameter enables or disables generation of a maskable interrupt when the error occurs from Clock monitor lower-limit error (MOSC). | true: enables generation of a maskable interrupt when the error occurs from Clock monitor lower-limit error (MOSC). false: disables generation of a maskable interrupt when the error occurs from Clock monitor lower-limit error (MOSC).
          boolean McuEcmErrorNonMaskableInterrupt: set at post-build, origin=Renesas_v1.0.0, default-value=false  # This parameter enables or disables generation of a non-maskable interrupt when the error occurs from Clock monitor lower-limit error (MOSC). | true: enables generation of a non-maskable interrupt when the error occurs from Clock monitor lower-limit error (MOSC). false: disables generation of a non-maskable interrupt when the error occurs from Clock monitor lower-limit error (MOSC).
          boolean McuEcmErrorInternalReset: set at post-build, origin=Renesas_v1.0.0, default-value=false  # This parameter enables or disables generation of an internal reset when the error occurs from Clock monitor lower-limit error (MOSC). | true: enables generation of an internal reset when the error occurs from Clock monitor lower-limit error (MOSC). false: disables generation of an internal reset when the error occurs from Clock monitor lower-limit error (MOSC).
          boolean McuEcmErrorNMIDelayTimer: set at post-build, origin=Renesas_v1.0.0, default-value=false  # This parameter enables or disables delay timer start caused by non-maskable interrupts in response to errors from Clock monitor lower-limit error (MOSC). | true: enables delay timer start caused by non-maskable interrupts in response to errors from Clock monitor lower-limit error (MOSC). false: disables delay timer start caused by non-maskable interrupts in response to errors from Clock monitor lower-limit error (MOSC).
          boolean McuEcmErrorMIDelayTimer: set at post-build, origin=Renesas_v1.0.0, default-value=false  # This parameter enables or disables delay timer start caused by maskable interrupts in response to errors from Clock monitor lower-limit error (MOSC). | true: enables delay timer start caused by maskable interrupts in response to errors from Clock monitor lower-limit error (MOSC). false: disables delay timer start caused by maskable interrupts in response to errors from Clock monitor lower-limit error (MOSC).
          boolean McuEcmErrorOutputMask: set at post-build, origin=Renesas_v1.0.0, default-value=true  # This parameter mask or unmask the individual error sources of the error pin output from Clock monitor lower-limit error (MOSC). | true: mask the individual error sources of the error pin output from Clock monitor lower-limit error (MOSC). false: unmask the individual error sources of the error pin output from Clock monitor lower-limit error (MOSC).
          function name McuMiNotification [0..1]: set at post-build, origin=Renesas_v1.0.0, default-value=NULL_PTR, regular-expression=[a-zA-Z][a-zA-Z0-9_]*  # This parameter contains notification function for MI notification. | The syntax for McuMiNotification should be provided as Mcu_EcmMINotification.
          function name McuNmiNotification [0..1]: set at post-build, origin=Renesas_v1.0.0, default-value=NULL_PTR, regular-expression=[a-zA-Z][a-zA-Z0-9_]*  # This parameter contains notification function for NMI notification. | The syntax for McuNmiNotification should be provided as Mcu_EcmNMINotification.
          function name McuEcmInitialNotification [0..1]: set at post-build, origin=Renesas_v1.0.2, default-value=NULL_PTR, regular-expression=[a-zA-Z][a-zA-Z0-9_]*  # This parameter is used for notify the upper layer, if any ECM error has been already detected at system start-up. | The syntax for McuEcmInitialNotification should be provided as Mcu_EcmInitialNotification.
        container McuEcmErrorSource6  # This container contains all the supported configuration parameters of the related error source from Clock monitor upper-limit error (WDT count clock).
          boolean McuEcmErrorMaskableInterrupt: set at post-build, origin=Renesas_v1.0.0, default-value=false  # This parameter enables or disables generation of a maskable interrupt when the error occurs from Clock monitor upper-limit error (WDT count clock). | true: enables generation of a maskable interrupt when the error occurs from Clock monitor upper-limit error (WDT count clock). false: disables generation of a maskable interrupt when the error occurs from Clock monitor upper-limit error (WDT count clock).
          boolean McuEcmErrorNonMaskableInterrupt: set at post-build, origin=Renesas_v1.0.0, default-value=false  # This parameter enables or disables generation of a non-maskable interrupt when the error occurs from Clock monitor upper-limit error (WDT count clock). | true: enables generation of a non-maskable interrupt when the error occurs from Clock monitor upper-limit error (WDT count clock). false: disables generation of a non-maskable interrupt when the error occurs from Clock monitor upper-limit error (WDT count clock).
          boolean McuEcmErrorInternalReset: set at post-build, origin=Renesas_v1.0.0, default-value=false  # This parameter enables or disables generation of an internal reset when the error occurs from Clock monitor upper-limit error (WDT count clock). | true: enables generation of an internal reset when the error occurs from Clock monitor upper-limit error (WDT count clock). false: disables generation of an internal reset when the error occurs from Clock monitor upper-limit error (WDT count clock).
          boolean McuEcmErrorNMIDelayTimer: set at post-build, origin=Renesas_v1.0.0, default-value=false  # This parameter enables or disables delay timer start caused by non-maskable interrupts in response to errors from Clock monitor upper-limit error (WDT count clock). | true: enables delay timer start caused by non-maskable interrupts in response to errors from Clock monitor upper-limit error (WDT count clock). false: disables delay timer start caused by non-maskable interrupts in response to errors from Clock monitor upper-limit error (WDT count clock).
          boolean McuEcmErrorMIDelayTimer: set at post-build, origin=Renesas_v1.0.0, default-value=false  # This parameter enables or disables delay timer start caused by maskable interrupts in response to errors from Clock monitor upper-limit error (WDT count clock). | true: enables delay timer start caused by maskable interrupts in response to errors from Clock monitor upper-limit error (WDT count clock). false: disables delay timer start caused by maskable interrupts in response to errors from Clock monitor upper-limit error (WDT count clock).
          boolean McuEcmErrorOutputMask: set at post-build, origin=Renesas_v1.0.0, default-value=true  # This parameter mask or unmask the individual error sources of the error pin output from Clock monitor upper-limit error (WDT count clock). | true: mask the individual error sources of the error pin output from Clock monitor upper-limit error (WDT count clock). false: unmask the individual error sources of the error pin output from Clock monitor upper-limit error (WDT count clock).
          function name McuMiNotification [0..1]: set at post-build, origin=Renesas_v1.0.0, default-value=NULL_PTR, regular-expression=[a-zA-Z][a-zA-Z0-9_]*  # This parameter contains notification function for MI notification. | The syntax for McuMiNotification should be provided as Mcu_EcmMINotification.
          function name McuNmiNotification [0..1]: set at post-build, origin=Renesas_v1.0.0, default-value=NULL_PTR, regular-expression=[a-zA-Z][a-zA-Z0-9_]*  # This parameter contains notification function for NMI notification. | The syntax for McuNmiNotification should be provided as Mcu_EcmNMINotification.
          function name McuEcmInitialNotification [0..1]: set at post-build, origin=Renesas_v1.0.2, default-value=NULL_PTR, regular-expression=[a-zA-Z][a-zA-Z0-9_]*  # This parameter is used for notify the upper layer, if any ECM error has been already detected at system start-up. | The syntax for McuEcmInitialNotification should be provided as Mcu_EcmInitialNotification.
        container McuEcmErrorSource7  # This container contains all the supported configuration parameters of the related error source from Clock monitor lower-limit error (WDT count clock).
          boolean McuEcmErrorMaskableInterrupt: set at post-build, origin=Renesas_v1.0.0, default-value=false  # This parameter enables or disables generation of a maskable interrupt when the error occurs from Clock monitor lower-limit error (WDT count clock). | true: enables generation of a maskable interrupt when the error occurs from Clock monitor lower-limit error (WDT count clock). false: disables generation of a maskable interrupt when the error occurs from Clock monitor lower-limit error (WDT count clock).
          boolean McuEcmErrorNonMaskableInterrupt: set at post-build, origin=Renesas_v1.0.0, default-value=false  # This parameter enables or disables generation of a non-maskable interrupt when the error occurs from Clock monitor lower-limit error (WDT count clock). | true: enables generation of a non-maskable interrupt when the error occurs from Clock monitor lower-limit error (WDT count clock). false: disables generation of a non-maskable interrupt when the error occurs from Clock monitor lower-limit error (WDT count clock).
          boolean McuEcmErrorInternalReset: set at post-build, origin=Renesas_v1.0.0, default-value=false  # This parameter enables or disables generation of an internal reset when the error occurs from Clock monitor lower-limit error (WDT count clock). | true: enables generation of an internal reset when the error occurs from Clock monitor lower-limit error (WDT count clock). false: disables generation of an internal reset when the error occurs from Clock monitor lower-limit error (WDT count clock).
          boolean McuEcmErrorNMIDelayTimer: set at post-build, origin=Renesas_v1.0.0, default-value=false  # This parameter enables or disables delay timer start caused by non-maskable interrupts in response to errors from Clock monitor lower-limit error (WDT count clock). | true: enables delay timer start caused by non-maskable interrupts in response to errors from Clock monitor lower-limit error (WDT count clock). false: disables delay timer start caused by non-maskable interrupts in response to errors from Clock monitor lower-limit error (WDT count clock).
          boolean McuEcmErrorMIDelayTimer: set at post-build, origin=Renesas_v1.0.0, default-value=false  # This parameter enables or disables delay timer start caused by maskable interrupts in response to errors from Clock monitor lower-limit error (WDT count clock). | true: enables delay timer start caused by maskable interrupts in response to errors from Clock monitor lower-limit error (WDT count clock). false: disables delay timer start caused by maskable interrupts in response to errors from Clock monitor lower-limit error (WDT count clock).
          boolean McuEcmErrorOutputMask: set at post-build, origin=Renesas_v1.0.0, default-value=true  # This parameter mask or unmask the individual error sources of the error pin output from Clock monitor lower-limit error (WDT count clock). | true: mask the individual error sources of the error pin output from Clock monitor lower-limit error (WDT count clock). false: unmask the individual error sources of the error pin output from Clock monitor lower-limit error (WDT count clock).
          function name McuMiNotification [0..1]: set at post-build, origin=Renesas_v1.0.0, default-value=NULL_PTR, regular-expression=[a-zA-Z][a-zA-Z0-9_]*  # This parameter contains notification function for MI notification. | The syntax for McuMiNotification should be provided as Mcu_EcmMINotification.
          function name McuNmiNotification [0..1]: set at post-build, origin=Renesas_v1.0.0, default-value=NULL_PTR, regular-expression=[a-zA-Z][a-zA-Z0-9_]*  # This parameter contains notification function for NMI notification. | The syntax for McuNmiNotification should be provided as Mcu_EcmNMINotification.
          function name McuEcmInitialNotification [0..1]: set at post-build, origin=Renesas_v1.0.2, default-value=NULL_PTR, regular-expression=[a-zA-Z][a-zA-Z0-9_]*  # This parameter is used for notify the upper layer, if any ECM error has been already detected at system start-up. | The syntax for McuEcmInitialNotification should be provided as Mcu_EcmInitialNotification.
        container McuEcmErrorSource8  # This container contains all the supported configuration parameters of the related error source from Clock monitor upper-limit error (peripheral clock).
          boolean McuEcmErrorMaskableInterrupt: set at post-build, origin=Renesas_v1.0.0, default-value=false  # This parameter enables or disables generation of a maskable interrupt when the error occurs from Clock monitor upper-limit error (peripheral clock). | true: enables generation of a maskable interrupt when the error occurs from Clock monitor upper-limit error (peripheral clock). false: disables generation of a maskable interrupt when the error occurs from Clock monitor upper-limit error (peripheral clock).
          boolean McuEcmErrorNonMaskableInterrupt: set at post-build, origin=Renesas_v1.0.0, default-value=false  # This parameter enables or disables generation of a non-maskable interrupt when the error occurs from Clock monitor upper-limit error (peripheral clock). | true: enables generation of a non-maskable interrupt when the error occurs from Clock monitor upper-limit error (peripheral clock). false: disables generation of a non-maskable interrupt when the error occurs from Clock monitor upper-limit error (peripheral clock).
          boolean McuEcmErrorInternalReset: set at post-build, origin=Renesas_v1.0.0, default-value=false  # This parameter enables or disables generation of an internal reset when the error occurs from Clock monitor upper-limit error (peripheral clock). | true: enables generation of an internal reset when the error occurs from Clock monitor upper-limit error (peripheral clock). false: disables generation of an internal reset when the error occurs from Clock monitor upper-limit error (peripheral clock).
          boolean McuEcmErrorNMIDelayTimer: set at post-build, origin=Renesas_v1.0.0, default-value=false  # This parameter enables or disables delay timer start caused by non-maskable interrupts in response to errors from Clock monitor upper-limit error (peripheral clock). | true: enables delay timer start caused by non-maskable interrupts in response to errors from Clock monitor upper-limit error (peripheral clock). false: disables delay timer start caused by non-maskable interrupts in response to errors from Clock monitor upper-limit error (peripheral clock).
          boolean McuEcmErrorMIDelayTimer: set at post-build, origin=Renesas_v1.0.0, default-value=false  # This parameter enables or disables delay timer start caused by maskable interrupts in response to errors from Clock monitor upper-limit error (peripheral clock). | true: enables delay timer start caused by maskable interrupts in response to errors from Clock monitor upper-limit error (peripheral clock). false: disables delay timer start caused by maskable interrupts in response to errors from Clock monitor upper-limit error (peripheral clock).
          boolean McuEcmErrorOutputMask: set at post-build, origin=Renesas_v1.0.0, default-value=true  # This parameter mask or unmask the individual error sources of the error pin output from Clock monitor upper-limit error (peripheral clock). | true: mask the individual error sources of the error pin output from Clock monitor upper-limit error (peripheral clock). false: unmask the individual error sources of the error pin output from Clock monitor upper-limit error (peripheral clock).
          function name McuMiNotification [0..1]: set at post-build, origin=Renesas_v1.0.0, default-value=NULL_PTR, regular-expression=[a-zA-Z][a-zA-Z0-9_]*  # This parameter contains notification function for MI notification. | The syntax for McuMiNotification should be provided as Mcu_EcmMINotification.
          function name McuNmiNotification [0..1]: set at post-build, origin=Renesas_v1.0.0, default-value=NULL_PTR, regular-expression=[a-zA-Z][a-zA-Z0-9_]*  # This parameter contains notification function for NMI notification. | The syntax for McuNmiNotification should be provided as Mcu_EcmNMINotification.
          function name McuEcmInitialNotification [0..1]: set at post-build, origin=Renesas_v1.0.2, default-value=NULL_PTR, regular-expression=[a-zA-Z][a-zA-Z0-9_]*  # This parameter is used for notify the upper layer, if any ECM error has been already detected at system start-up. | The syntax for McuEcmInitialNotification should be provided as Mcu_EcmInitialNotification.
        container McuEcmErrorSource9  # This container contains all the supported configuration parameters of the related error source from Clock monitor lower-limit error (peripheral clock).
          boolean McuEcmErrorMaskableInterrupt: set at post-build, origin=Renesas_v1.0.0, default-value=false  # This parameter enables or disables generation of a maskable interrupt when the error occurs from Clock monitor lower-limit error (peripheral clock). | true: enables generation of a maskable interrupt when the error occurs from Clock monitor lower-limit error (peripheral clock). false: disables generation of a maskable interrupt when the error occurs from Clock monitor lower-limit error (peripheral clock).
          boolean McuEcmErrorNonMaskableInterrupt: set at post-build, origin=Renesas_v1.0.0, default-value=false  # This parameter enables or disables generation of a non-maskable interrupt when the error occurs from Clock monitor lower-limit error (peripheral clock). | true: enables generation of a non-maskable interrupt when the error occurs from Clock monitor lower-limit error (peripheral clock). false: disables generation of a non-maskable interrupt when the error occurs from Clock monitor lower-limit error (peripheral clock).
          boolean McuEcmErrorInternalReset: set at post-build, origin=Renesas_v1.0.0, default-value=false  # This parameter enables or disables generation of an internal reset when the error occurs from Clock monitor lower-limit error (peripheral clock). | true: enables generation of an internal reset when the error occurs from Clock monitor lower-limit error (peripheral clock). false: disables generation of an internal reset when the error occurs from Clock monitor lower-limit error (peripheral clock).
          boolean McuEcmErrorNMIDelayTimer: set at post-build, origin=Renesas_v1.0.0, default-value=false  # This parameter enables or disables delay timer start caused by non-maskable interrupts in response to errors from Clock monitor lower-limit error (peripheral clock). | true: enables delay timer start caused by non-maskable interrupts in response to errors from Clock monitor lower-limit error (peripheral clock). false: disables delay timer start caused by non-maskable interrupts in response to errors from Clock monitor lower-limit error (peripheral clock).
          boolean McuEcmErrorMIDelayTimer: set at post-build, origin=Renesas_v1.0.0, default-value=false  # This parameter enables or disables delay timer start caused by maskable interrupts in response to errors from Clock monitor lower-limit error (peripheral clock). | true: enables delay timer start caused by maskable interrupts in response to errors from Clock monitor lower-limit error (peripheral clock). false: disables delay timer start caused by maskable interrupts in response to errors from Clock monitor lower-limit error (peripheral clock).
          boolean McuEcmErrorOutputMask: set at post-build, origin=Renesas_v1.0.0, default-value=true  # This parameter mask or unmask the individual error sources of the error pin output from Clock monitor lower-limit error (peripheral clock). | true: mask the individual error sources of the error pin output from Clock monitor lower-limit error (peripheral clock). false: unmask the individual error sources of the error pin output from Clock monitor lower-limit error (peripheral clock).
          function name McuMiNotification [0..1]: set at post-build, origin=Renesas_v1.0.0, default-value=NULL_PTR, regular-expression=[a-zA-Z][a-zA-Z0-9_]*  # This parameter contains notification function for MI notification. | The syntax for McuMiNotification should be provided as Mcu_EcmMINotification.
          function name McuNmiNotification [0..1]: set at post-build, origin=Renesas_v1.0.0, default-value=NULL_PTR, regular-expression=[a-zA-Z][a-zA-Z0-9_]*  # This parameter contains notification function for NMI notification. | The syntax for McuNmiNotification should be provided as Mcu_EcmNMINotification.
          function name McuEcmInitialNotification [0..1]: set at post-build, origin=Renesas_v1.0.2, default-value=NULL_PTR, regular-expression=[a-zA-Z][a-zA-Z0-9_]*  # This parameter is used for notify the upper layer, if any ECM error has been already detected at system start-up. | The syntax for McuEcmInitialNotification should be provided as Mcu_EcmInitialNotification.
        container McuEcmErrorSource10  # This container contains all the supported configuration parameters of the related error source from Clock monitor upper-limit error (PE1 checker core clock).
          boolean McuEcmErrorMaskableInterrupt: set at post-build, origin=Renesas_v1.0.0, default-value=false  # This parameter enables or disables generation of a maskable interrupt when the error occurs from Clock monitor upper-limit error (PE1 checker core clock). | true: enables generation of a maskable interrupt when the error occurs from Clock monitor upper-limit error (PE1 checker core clock). false: disables generation of a maskable interrupt when the error occurs from Clock monitor upper-limit error (PE1 checker core clock).
          boolean McuEcmErrorNonMaskableInterrupt: set at post-build, origin=Renesas_v1.0.0, default-value=false  # This parameter enables or disables generation of a non-maskable interrupt when the error occurs from Clock monitor upper-limit error (PE1 checker core clock). | true: enables generation of a non-maskable interrupt when the error occurs from Clock monitor upper-limit error (PE1 checker core clock). false: disables generation of a non-maskable interrupt when the error occurs from Clock monitor upper-limit error (PE1 checker core clock).
          boolean McuEcmErrorInternalReset: set at post-build, origin=Renesas_v1.0.0, default-value=false  # This parameter enables or disables generation of an internal reset when the error occurs from Clock monitor upper-limit error (PE1 checker core clock). | true: enables generation of an internal reset when the error occurs from Clock monitor upper-limit error (PE1 checker core clock). false: disables generation of an internal reset when the error occurs from Clock monitor upper-limit error (PE1 checker core clock).
          boolean McuEcmErrorNMIDelayTimer: set at post-build, origin=Renesas_v1.0.0, default-value=false  # This parameter enables or disables delay timer start caused by non-maskable interrupts in response to errors from Clock monitor upper-limit error (PE1 checker core clock). | true: enables delay timer start caused by non-maskable interrupts in response to errors from Clock monitor upper-limit error (PE1 checker core clock). false: disables delay timer start caused by non-maskable interrupts in response to errors from Clock monitor upper-limit error (PE1 checker core clock).
          boolean McuEcmErrorMIDelayTimer: set at post-build, origin=Renesas_v1.0.0, default-value=false  # This parameter enables or disables delay timer start caused by maskable interrupts in response to errors from Clock monitor upper-limit error (PE1 checker core clock). | true: enables delay timer start caused by maskable interrupts in response to errors from Clock monitor upper-limit error (PE1 checker core clock). false: disables delay timer start caused by maskable interrupts in response to errors from Clock monitor upper-limit error (PE1 checker core clock).
          boolean McuEcmErrorOutputMask: set at post-build, origin=Renesas_v1.0.0, default-value=true  # This parameter mask or unmask the individual error sources of the error pin output from Clock monitor upper-limit error (PE1 checker core clock). | true: mask the individual error sources of the error pin output from Clock monitor upper-limit error (PE1 checker core clock). false: unmask the individual error sources of the error pin output from Clock monitor upper-limit error (PE1 checker core clock).
          function name McuMiNotification [0..1]: set at post-build, origin=Renesas_v1.0.0, default-value=NULL_PTR, regular-expression=[a-zA-Z][a-zA-Z0-9_]*  # This parameter contains notification function for MI notification. | The syntax for McuMiNotification should be provided as Mcu_EcmMINotification.
          function name McuNmiNotification [0..1]: set at post-build, origin=Renesas_v1.0.0, default-value=NULL_PTR, regular-expression=[a-zA-Z][a-zA-Z0-9_]*  # This parameter contains notification function for NMI notification. | The syntax for McuNmiNotification should be provided as Mcu_EcmNMINotification.
          function name McuEcmInitialNotification [0..1]: set at post-build, origin=Renesas_v1.0.2, default-value=NULL_PTR, regular-expression=[a-zA-Z][a-zA-Z0-9_]*  # This parameter is used for notify the upper layer, if any ECM error has been already detected at system start-up. | The syntax for McuEcmInitialNotification should be provided as Mcu_EcmInitialNotification.
        container McuEcmErrorSource11  # This container contains all the supported configuration parameters of the related error source from Clock monitor lower-limit error (PE1 checker core clock).
          boolean McuEcmErrorMaskableInterrupt: set at post-build, origin=Renesas_v1.0.0, default-value=false  # This parameter enables or disables generation of a maskable interrupt when the error occurs from Clock monitor lower-limit error (PE1 checker core clock). | true: enables generation of a maskable interrupt when the error occurs from Clock monitor lower-limit error (PE1 checker core clock). false: disables generation of a maskable interrupt when the error occurs from Clock monitor lower-limit error (PE1 checker core clock).
          boolean McuEcmErrorNonMaskableInterrupt: set at post-build, origin=Renesas_v1.0.0, default-value=false  # This parameter enables or disables generation of a non-maskable interrupt when the error occurs from Clock monitor lower-limit error (PE1 checker core clock). | true: enables generation of a non-maskable interrupt when the error occurs from Clock monitor lower-limit error (PE1 checker core clock). false: disables generation of a non-maskable interrupt when the error occurs from Clock monitor lower-limit error (PE1 checker core clock).
          boolean McuEcmErrorInternalReset: set at post-build, origin=Renesas_v1.0.0, default-value=false  # This parameter enables or disables generation of an internal reset when the error occurs from Clock monitor lower-limit error (PE1 checker core clock). | true: enables generation of an internal reset when the error occurs from Clock monitor lower-limit error (PE1 checker core clock). false: disables generation of an internal reset when the error occurs from Clock monitor lower-limit error (PE1 checker core clock).
          boolean McuEcmErrorNMIDelayTimer: set at post-build, origin=Renesas_v1.0.0, default-value=false  # This parameter enables or disables delay timer start caused by non-maskable interrupts in response to errors from Clock monitor lower-limit error (PE1 checker core clock). | true: enables delay timer start caused by non-maskable interrupts in response to errors from Clock monitor lower-limit error (PE1 checker core clock). false: disables delay timer start caused by non-maskable interrupts in response to errors from Clock monitor lower-limit error (PE1 checker core clock).
          boolean McuEcmErrorMIDelayTimer: set at post-build, origin=Renesas_v1.0.0, default-value=false  # This parameter enables or disables delay timer start caused by maskable interrupts in response to errors from Clock monitor lower-limit error (PE1 checker core clock). | true: enables delay timer start caused by maskable interrupts in response to errors from Clock monitor lower-limit error (PE1 checker core clock). false: disables delay timer start caused by maskable interrupts in response to errors from Clock monitor lower-limit error (PE1 checker core clock).
          boolean McuEcmErrorOutputMask: set at post-build, origin=Renesas_v1.0.0, default-value=true  # This parameter mask or unmask the individual error sources of the error pin output from Clock monitor lower-limit error (PE1 checker core clock). | true: mask the individual error sources of the error pin output from Clock monitor lower-limit error (PE1 checker core clock). false: unmask the individual error sources of the error pin output from Clock monitor lower-limit error (PE1 checker core clock).
          function name McuMiNotification [0..1]: set at post-build, origin=Renesas_v1.0.0, default-value=NULL_PTR, regular-expression=[a-zA-Z][a-zA-Z0-9_]*  # This parameter contains notification function for MI notification. | The syntax for McuMiNotification should be provided as Mcu_EcmMINotification.
          function name McuNmiNotification [0..1]: set at post-build, origin=Renesas_v1.0.0, default-value=NULL_PTR, regular-expression=[a-zA-Z][a-zA-Z0-9_]*  # This parameter contains notification function for NMI notification. | The syntax for McuNmiNotification should be provided as Mcu_EcmNMINotification.
          function name McuEcmInitialNotification [0..1]: set at post-build, origin=Renesas_v1.0.2, default-value=NULL_PTR, regular-expression=[a-zA-Z][a-zA-Z0-9_]*  # This parameter is used for notify the upper layer, if any ECM error has been already detected at system start-up. | The syntax for McuEcmInitialNotification should be provided as Mcu_EcmInitialNotification.
        container McuEcmErrorSource12  # This container contains all the supported configuration parameters of the related error source from Local RAM ECC 2-bit error and address parity error.
          boolean McuEcmErrorMaskableInterrupt: set at post-build, origin=Renesas_v1.0.0, default-value=false  # This parameter enables or disables generation of a maskable interrupt when the error occurs from Local RAM ECC 2-bit error and address parity error. | true: enables generation of a maskable interrupt when the error occurs from Local RAM ECC 2-bit error and address parity error. false: disables generation of a maskable interrupt when the error occurs from Local RAM ECC 2-bit error and address parity error.
          boolean McuEcmErrorNonMaskableInterrupt: set at post-build, origin=Renesas_v1.0.0, default-value=false  # This parameter enables or disables generation of a non-maskable interrupt when the error occurs from Local RAM ECC 2-bit error and address parity error. | true: enables generation of a non-maskable interrupt when the error occurs from Local RAM ECC 2-bit error and address parity error. false: disables generation of a non-maskable interrupt when the error occurs from Local RAM ECC 2-bit error and address parity error.
          boolean McuEcmErrorInternalReset: set at post-build, origin=Renesas_v1.0.0, default-value=false  # This parameter enables or disables generation of an internal reset when the error occurs from Local RAM ECC 2-bit error and address parity error. | true: enables generation of an internal reset when the error occurs from Local RAM ECC 2-bit error and address parity error. false: disables generation of an internal reset when the error occurs from Local RAM ECC 2-bit error and address parity error.
          boolean McuEcmErrorNMIDelayTimer: set at post-build, origin=Renesas_v1.0.0, default-value=false  # This parameter enables or disables delay timer start caused by non-maskable interrupts in response to errors from Local RAM ECC 2-bit error and address parity error. | true: enables delay timer start caused by non-maskable interrupts in response to errors from Local RAM ECC 2-bit error and address parity error. false: disables delay timer start caused by non-maskable interrupts in response to errors from Local RAM ECC 2-bit error and address parity error.
          boolean McuEcmErrorMIDelayTimer: set at post-build, origin=Renesas_v1.0.0, default-value=false  # This parameter enables or disables delay timer start caused by maskable interrupts in response to errors from Local RAM ECC 2-bit error and address parity error. | true: enables delay timer start caused by maskable interrupts in response to errors from Local RAM ECC 2-bit error and address parity error. false: disables delay timer start caused by maskable interrupts in response to errors from Local RAM ECC 2-bit error and address parity error.
          boolean McuEcmErrorOutputMask: set at post-build, origin=Renesas_v1.0.0, default-value=true  # This parameter mask or unmask the individual error sources of the error pin output from Local RAM ECC 2-bit error and address parity error. | true: mask the individual error sources of the error pin output from Local RAM ECC 2-bit error and address parity error. false: unmask the individual error sources of the error pin output from Local RAM ECC 2-bit error and address parity error.
          function name McuMiNotification [0..1]: set at post-build, origin=Renesas_v1.0.0, default-value=NULL_PTR, regular-expression=[a-zA-Z][a-zA-Z0-9_]*  # This parameter contains notification function for MI notification. | The syntax for McuMiNotification should be provided as Mcu_EcmMINotification.
          function name McuNmiNotification [0..1]: set at post-build, origin=Renesas_v1.0.0, default-value=NULL_PTR, regular-expression=[a-zA-Z][a-zA-Z0-9_]*  # This parameter contains notification function for NMI notification. | The syntax for McuNmiNotification should be provided as Mcu_EcmNMINotification.
          function name McuEcmInitialNotification [0..1]: set at post-build, origin=Renesas_v1.0.2, default-value=NULL_PTR, regular-expression=[a-zA-Z][a-zA-Z0-9_]*  # This parameter is used for notify the upper layer, if any ECM error has been already detected at system start-up. | The syntax for McuEcmInitialNotification should be provided as Mcu_EcmInitialNotification.
        container McuEcmErrorSource14  # This container contains all the supported configuration parameters of the related error source from Instruction cache RAM ECC 2-bit error and SED error.
          boolean McuEcmErrorMaskableInterrupt: set at post-build, origin=Renesas_v1.0.0, default-value=false  # This parameter enables or disables generation of a maskable interrupt when the error occurs from Cache module. | true: enables generation of a maskable interrupt when the error occurs from Instruction cache RAM ECC 2-bit error and SED error. false: disables generation of a maskable interrupt when the error occurs from Instruction cache RAM ECC 2-bit error and SED error.
          boolean McuEcmErrorNonMaskableInterrupt: set at post-build, origin=Renesas_v1.0.0, default-value=false  # This parameter enables or disables generation of a non-maskable interrupt when the error occurs from Instruction cache RAM ECC 2-bit error and SED error. | true: enables generation of a non-maskable interrupt when the error occurs from Instruction cache RAM ECC 2-bit error and SED error. false: disables generation of a non-maskable interrupt when the error occurs from Instruction cache RAM ECC 2-bit error and SED error.
          boolean McuEcmErrorInternalReset: set at post-build, origin=Renesas_v1.0.0, default-value=false  # This parameter enables or disables generation of an internal reset when the error occurs from Instruction cache RAM ECC 2-bit error and SED error. | true: enables generation of an internal reset when the error occurs from Instruction cache RAM ECC 2-bit error and SED error. false: disables generation of an internal reset when the error occurs from Instruction cache RAM ECC 2-bit error and SED error.
          boolean McuEcmErrorNMIDelayTimer: set at post-build, origin=Renesas_v1.0.0, default-value=false  # This parameter enables or disables delay timer start caused by non-maskable interrupts in response to errors from Instruction cache RAM ECC 2-bit error and SED error. | true: enables delay timer start caused by non-maskable interrupts in response to errors from Instruction cache RAM ECC 2-bit error and SED error. false: disables delay timer start caused by non-maskable interrupts in response to errors from Instruction cache RAM ECC 2-bit error and SED error.
          boolean McuEcmErrorMIDelayTimer: set at post-build, origin=Renesas_v1.0.0, default-value=false  # This parameter enables or disables delay timer start caused by maskable interrupts in response to errors from Instruction cache RAM ECC 2-bit error and SED error. | true: enables delay timer start caused by maskable interrupts in response to errors from Instruction cache RAM ECC 2-bit error and SED error. false: disables delay timer start caused by maskable interrupts in response to errors from Instruction cache RAM ECC 2-bit error and SED error.
          boolean McuEcmErrorOutputMask: set at post-build, origin=Renesas_v1.0.0, default-value=true  # This parameter mask or unmask the individual error sources of the error pin output from Instruction cache RAM ECC 2-bit error and SED error. | true: mask the individual error sources of the error pin output from Instruction cache RAM ECC 2-bit error and SED error. false: unmask the individual error sources of the error pin output from Instruction cache RAM ECC 2-bit error and SED error.
          function name McuMiNotification [0..1]: set at post-build, origin=Renesas_v1.0.0, default-value=NULL_PTR, regular-expression=[a-zA-Z][a-zA-Z0-9_]*  # This parameter contains notification function for MI notification. | The syntax for McuMiNotification should be provided as Mcu_EcmMINotification.
          function name McuNmiNotification [0..1]: set at post-build, origin=Renesas_v1.0.0, default-value=NULL_PTR, regular-expression=[a-zA-Z][a-zA-Z0-9_]*  # This parameter contains notification function for NMI notification. | The syntax for McuNmiNotification should be provided as Mcu_EcmNMINotification.
          function name McuEcmInitialNotification [0..1]: set at post-build, origin=Renesas_v1.0.2, default-value=NULL_PTR, regular-expression=[a-zA-Z][a-zA-Z0-9_]*  # This parameter is used for notify the upper layer, if any ECM error has been already detected at system start-up. | The syntax for McuEcmInitialNotification should be provided as Mcu_EcmInitialNotification.
        container McuEcmErrorSource15  # This container contains all the supported configuration parameters of the related error source from Code flash ECC 2-bit error and address parity error.
          boolean McuEcmErrorMaskableInterrupt: set at post-build, origin=Renesas_v1.0.0, default-value=false  # This parameter enables or disables generation of a maskable interrupt when the error occurs from Code flash ECC 2-bit error and address parity error. | true: enables generation of a maskable interrupt when the error occurs from Code flash ECC 2-bit error and address parity error. false: disables generation of a maskable interrupt when the error occurs from Code flash ECC 2-bit error and address parity error.
          boolean McuEcmErrorNonMaskableInterrupt: set at post-build, origin=Renesas_v1.0.0, default-value=false  # This parameter enables or disables generation of a non-maskable interrupt when the error occurs from Code flash ECC 2-bit error and address parity error. | true: enables generation of a non-maskable interrupt when the error occurs from Code flash ECC 2-bit error and address parity error. false: disables generation of a non-maskable interrupt when the error occurs from Code flash ECC 2-bit error and address parity error.
          boolean McuEcmErrorInternalReset: set at post-build, origin=Renesas_v1.0.0, default-value=false  # This parameter enables or disables generation of an internal reset when the error occurs from Code flash ECC 2-bit error and address parity error. | true: enables generation of an internal reset when the error occurs from Code flash ECC 2-bit error and address parity error. false: disables generation of an internal reset when the error occurs from Code flash ECC 2-bit error and address parity error.
          boolean McuEcmErrorNMIDelayTimer: set at post-build, origin=Renesas_v1.0.0, default-value=false  # This parameter enables or disables delay timer start caused by non-maskable interrupts in response to errors from Code flash ECC 2-bit error and address parity error. | true: enables delay timer start caused by non-maskable interrupts in response to errors from Code flash ECC 2-bit error and address parity error. false: disables delay timer start caused by non-maskable interrupts in response to errors from Code flash ECC 2-bit error and address parity error.
          boolean McuEcmErrorMIDelayTimer: set at post-build, origin=Renesas_v1.0.0, default-value=false  # This parameter enables or disables delay timer start caused by maskable interrupts in response to errors from Code flash ECC 2-bit error and address parity error. | true: enables delay timer start caused by maskable interrupts in response to errors from Code flash ECC 2-bit error and address parity error. false: disables delay timer start caused by maskable interrupts in response to errors from Code flash ECC 2-bit error and address parity error.
          boolean McuEcmErrorOutputMask: set at post-build, origin=Renesas_v1.0.0, default-value=true  # This parameter mask or unmask the individual error sources of the error pin output from Code flash ECC 2-bit error and address parity error. | true: mask the individual error sources of the error pin output from Code flash ECC 2-bit error and address parity error. false: unmask the individual error sources of the error pin output from Code flash ECC 2-bit error and address parity error.
          function name McuMiNotification [0..1]: set at post-build, origin=Renesas_v1.0.0, default-value=NULL_PTR, regular-expression=[a-zA-Z][a-zA-Z0-9_]*  # This parameter contains notification function for MI notification. | The syntax for McuMiNotification should be provided as Mcu_EcmMINotification.
          function name McuNmiNotification [0..1]: set at post-build, origin=Renesas_v1.0.0, default-value=NULL_PTR, regular-expression=[a-zA-Z][a-zA-Z0-9_]*  # This parameter contains notification function for NMI notification. | The syntax for McuNmiNotification should be provided as Mcu_EcmNMINotification.
          function name McuEcmInitialNotification [0..1]: set at post-build, origin=Renesas_v1.0.2, default-value=NULL_PTR, regular-expression=[a-zA-Z][a-zA-Z0-9_]*  # This parameter is used for notify the upper layer, if any ECM error has been already detected at system start-up. | The syntax for McuEcmInitialNotification should be provided as Mcu_EcmInitialNotification.
        container McuEcmErrorSource16  # This container contains all the supported configuration parameters of the related error source from Data flash ECC 2-bit error.
          boolean McuEcmErrorMaskableInterrupt: set at post-build, origin=Renesas_v1.0.0, default-value=false  # This parameter enables or disables generation of a maskable interrupt when the error occurs from Data flash ECC 2-bit error. | true: enables generation of a maskable interrupt when the error occurs from Data flash ECC 2-bit error. false: disables generation of a maskable interrupt when the error occurs from Data flash ECC 2-bit error.
          boolean McuEcmErrorNonMaskableInterrupt: set at post-build, origin=Renesas_v1.0.0, default-value=false  # This parameter enables or disables generation of a non-maskable interrupt when the error occurs from Data flash ECC 2-bit error. | true: enables generation of a non-maskable interrupt when the error occurs from Data flash ECC 2-bit error. false: disables generation of a non-maskable interrupt when the error occurs from Data flash ECC 2-bit error.
          boolean McuEcmErrorInternalReset: set at post-build, origin=Renesas_v1.0.0, default-value=false  # This parameter enables or disables generation of an internal reset when the error occurs from Data flash ECC 2-bit error. | true: enables generation of an internal reset when the error occurs from Data flash ECC 2-bit error. false: disables generation of an internal reset when the error occurs from Data flash ECC 2-bit error.
          boolean McuEcmErrorNMIDelayTimer: set at post-build, origin=Renesas_v1.0.0, default-value=false  # This parameter enables or disables delay timer start caused by non-maskable interrupts in response to errors from Data flash ECC 2-bit error. | true: enables delay timer start caused by non-maskable interrupts in response to errors from Data flash ECC 2-bit error. false: disables delay timer start caused by non-maskable interrupts in response to errors from Data flash ECC 2-bit error.
          boolean McuEcmErrorMIDelayTimer: set at post-build, origin=Renesas_v1.0.0, default-value=false  # This parameter enables or disables delay timer start caused by maskable interrupts in response to errors from Data flash ECC 2-bit error. | true: enables delay timer start caused by maskable interrupts in response to errors from Data flash ECC 2-bit error. false: disables delay timer start caused by maskable interrupts in response to errors from Data flash ECC 2-bit error.
          boolean McuEcmErrorOutputMask: set at post-build, origin=Renesas_v1.0.0, default-value=true  # This parameter mask or unmask the individual error sources of the error pin output from Data flash ECC 2-bit error. | true: mask the individual error sources of the error pin output from Data flash ECC 2-bit error. false: unmask the individual error sources of the error pin output from Data flash ECC 2-bit error.
          function name McuMiNotification [0..1]: set at post-build, origin=Renesas_v1.0.0, default-value=NULL_PTR, regular-expression=[a-zA-Z][a-zA-Z0-9_]*  # This parameter contains notification function for MI notification. | The syntax for McuMiNotification should be provided as Mcu_EcmMINotification.
          function name McuNmiNotification [0..1]: set at post-build, origin=Renesas_v1.0.0, default-value=NULL_PTR, regular-expression=[a-zA-Z][a-zA-Z0-9_]*  # This parameter contains notification function for NMI notification. | The syntax for McuNmiNotification should be provided as Mcu_EcmNMINotification.
          function name McuEcmInitialNotification [0..1]: set at post-build, origin=Renesas_v1.0.2, default-value=NULL_PTR, regular-expression=[a-zA-Z][a-zA-Z0-9_]*  # This parameter is used for notify the upper layer, if any ECM error has been already detected at system start-up. | The syntax for McuEcmInitialNotification should be provided as Mcu_EcmInitialNotification.
        container McuEcmErrorSource17  # This container contains all the supported configuration parameters of the related error source from DTS RAM ECC 2-bit error.
          boolean McuEcmErrorMaskableInterrupt: set at post-build, origin=Renesas_v1.0.0, default-value=false  # This parameter enables or disables generation of a maskable interrupt when the error occurs from DTS RAM ECC 2-bit error. | true: enables generation of a maskable interrupt when the error occurs from DTS RAM ECC 2-bit error. false: disables generation of a maskable interrupt when the error occurs from DTS RAM ECC 2-bit error.
          boolean McuEcmErrorNonMaskableInterrupt: set at post-build, origin=Renesas_v1.0.0, default-value=false  # This parameter enables or disables generation of a non-maskable interrupt when the error occurs from DTS RAM ECC 2-bit error. | true: enables generation of a non-maskable interrupt when the error occurs from DTS RAM ECC 2-bit error. false: disables generation of a non-maskable interrupt when the error occurs from DTS RAM ECC 2-bit error.
          boolean McuEcmErrorInternalReset: set at post-build, origin=Renesas_v1.0.0, default-value=false  # This parameter enables or disables generation of an internal reset when the error occurs from DTS RAM ECC 2-bit error. | true: enables generation of an internal reset when the error occurs from DTS RAM ECC 2-bit error. false: disables generation of an internal reset when the error occurs from DTS RAM ECC 2-bit error.
          boolean McuEcmErrorNMIDelayTimer: set at post-build, origin=Renesas_v1.0.0, default-value=false  # This parameter enables or disables delay timer start caused by non-maskable interrupts in response to errors from DTS RAM ECC 2-bit error. | true: enables delay timer start caused by non-maskable interrupts in response to errors from DTS RAM ECC 2-bit error. false: disables delay timer start caused by non-maskable interrupts in response to errors from DTS RAM ECC 2-bit error.
          boolean McuEcmErrorMIDelayTimer: set at post-build, origin=Renesas_v1.0.0, default-value=false  # This parameter enables or disables delay timer start caused by maskable interrupts in response to errors from DTS RAM ECC 2-bit error. | true: enables delay timer start caused by maskable interrupts in response to errors from DTS RAM ECC 2-bit error. false: disables delay timer start caused by maskable interrupts in response to errors from DTS RAM ECC 2-bit error.
          boolean McuEcmErrorOutputMask: set at post-build, origin=Renesas_v1.0.0, default-value=true  # This parameter mask or unmask the individual error sources of the error pin output from DTS RAM ECC 2-bit error. | true: mask the individual error sources of the error pin output from DTS RAM ECC 2-bit error. false: unmask the individual error sources of the error pin output from DTS RAM ECC 2-bit error.
          function name McuMiNotification [0..1]: set at post-build, origin=Renesas_v1.0.0, default-value=NULL_PTR, regular-expression=[a-zA-Z][a-zA-Z0-9_]*  # This parameter contains notification function for MI notification. | The syntax for McuMiNotification should be provided as Mcu_EcmMINotification.
          function name McuNmiNotification [0..1]: set at post-build, origin=Renesas_v1.0.0, default-value=NULL_PTR, regular-expression=[a-zA-Z][a-zA-Z0-9_]*  # This parameter contains notification function for NMI notification. | The syntax for McuNmiNotification should be provided as Mcu_EcmNMINotification.
          function name McuEcmInitialNotification [0..1]: set at post-build, origin=Renesas_v1.0.2, default-value=NULL_PTR, regular-expression=[a-zA-Z][a-zA-Z0-9_]*  # This parameter is used for notify the upper layer, if any ECM error has been already detected at system start-up. | The syntax for McuEcmInitialNotification should be provided as Mcu_EcmInitialNotification.
        container McuEcmErrorSource18  # This container contains all the supported configuration parameters of the related error source from CSIH RAM ECC 2-bit error.
          boolean McuEcmErrorMaskableInterrupt: set at post-build, origin=Renesas_v1.0.0, default-value=false  # This parameter enables or disables generation of a maskable interrupt when the error occurs from CSIH RAM ECC 2-bit error. | true: enables generation of a maskable interrupt when the error occurs from CSIH RAM ECC 2-bit error. false: disables generation of a maskable interrupt when the error occurs from CSIH RAM ECC 2-bit error.
          boolean McuEcmErrorNonMaskableInterrupt: set at post-build, origin=Renesas_v1.0.0, default-value=false  # This parameter enables or disables generation of a non-maskable interrupt when the error occurs from CSIH RAM ECC 2-bit error. | true: enables generation of a non-maskable interrupt when the error occurs from CSIH RAM ECC 2-bit error. false: disables generation of a non-maskable interrupt when the error occurs from CSIH RAM ECC 2-bit error.
          boolean McuEcmErrorInternalReset: set at post-build, origin=Renesas_v1.0.0, default-value=false  # This parameter enables or disables generation of an internal reset when the error occurs from CSIH RAM ECC 2-bit error. | true: enables generation of an internal reset when the error occurs from CSIH RAM ECC 2-bit error. false: disables generation of an internal reset when the error occurs from CSIH RAM ECC 2-bit error.
          boolean McuEcmErrorNMIDelayTimer: set at post-build, origin=Renesas_v1.0.0, default-value=false  # This parameter enables or disables delay timer start caused by non-maskable interrupts in response to errors from CSIH RAM ECC 2-bit error. | true: enables delay timer start caused by non-maskable interrupts in response to errors from CSIH RAM ECC 2-bit error. false: disables delay timer start caused by non-maskable interrupts in response to errors from CSIH RAM ECC 2-bit error.
          boolean McuEcmErrorMIDelayTimer: set at post-build, origin=Renesas_v1.0.0, default-value=false  # This parameter enables or disables delay timer start caused by maskable interrupts in response to errors from CSIH RAM ECC 2-bit error. | true: enables delay timer start caused by maskable interrupts in response to errors from CSIH RAM ECC 2-bit error. false: disables delay timer start caused by maskable interrupts in response to errors from CSIH RAM ECC 2-bit error.
          boolean McuEcmErrorOutputMask: set at post-build, origin=Renesas_v1.0.0, default-value=true  # This parameter mask or unmask the individual error sources of the error pin output from CSIH RAM ECC 2-bit error. | true: mask the individual error sources of the error pin output from CSIH RAM ECC 2-bit error. false: unmask the individual error sources of the error pin output from CSIH RAM ECC 2-bit error.
          function name McuMiNotification [0..1]: set at post-build, origin=Renesas_v1.0.0, default-value=NULL_PTR, regular-expression=[a-zA-Z][a-zA-Z0-9_]*  # This parameter contains notification function for MI notification. | The syntax for McuMiNotification should be provided as Mcu_EcmMINotification.
          function name McuNmiNotification [0..1]: set at post-build, origin=Renesas_v1.0.0, default-value=NULL_PTR, regular-expression=[a-zA-Z][a-zA-Z0-9_]*  # This parameter contains notification function for NMI notification. | The syntax for McuNmiNotification should be provided as Mcu_EcmNMINotification.
          function name McuEcmInitialNotification [0..1]: set at post-build, origin=Renesas_v1.0.2, default-value=NULL_PTR, regular-expression=[a-zA-Z][a-zA-Z0-9_]*  # This parameter is used for notify the upper layer, if any ECM error has been already detected at system start-up. | The syntax for McuEcmInitialNotification should be provided as Mcu_EcmInitialNotification.
        container McuEcmErrorSource19  # This container contains all the supported configuration parameters of the related error source from CAN RAM ECC 2-bit error.
          boolean McuEcmErrorMaskableInterrupt: set at post-build, origin=Renesas_v1.0.0, default-value=false  # This parameter enables or disables generation of a maskable interrupt when the error occurs from CAN RAM ECC 2-bit error. | true: enables generation of a maskable interrupt when the error occurs from CAN RAM ECC 2-bit error. false: disables generation of a maskable interrupt when the error occurs from CAN RAM ECC 2-bit error.
          boolean McuEcmErrorNonMaskableInterrupt: set at post-build, origin=Renesas_v1.0.0, default-value=false  # This parameter enables or disables generation of a non-maskable interrupt when the error occurs from CAN RAM ECC 2-bit error. | true: enables generation of a non-maskable interrupt when the error occurs from CAN RAM ECC 2-bit error. false: disables generation of a non-maskable interrupt when the error occurs from CAN RAM ECC 2-bit error.
          boolean McuEcmErrorInternalReset: set at post-build, origin=Renesas_v1.0.0, default-value=false  # This parameter enables or disables generation of an internal reset when the error occurs from CAN RAM ECC 2-bit error. | true: enables generation of an internal reset when the error occurs from CAN RAM ECC 2-bit error. false: disables generation of an internal reset when the error occurs from CAN RAM ECC 2-bit error.
          boolean McuEcmErrorNMIDelayTimer: set at post-build, origin=Renesas_v1.0.0, default-value=false  # This parameter enables or disables delay timer start caused by non-maskable interrupts in response to errors from CAN RAM ECC 2-bit error. | true: enables delay timer start caused by non-maskable interrupts in response to errors from CAN RAM ECC 2-bit error. false: disables delay timer start caused by non-maskable interrupts in response to errors from CAN RAM ECC 2-bit error.
          boolean McuEcmErrorMIDelayTimer: set at post-build, origin=Renesas_v1.0.0, default-value=false  # This parameter enables or disables delay timer start caused by maskable interrupts in response to errors from CAN RAM ECC 2-bit error. | true: enables delay timer start caused by maskable interrupts in response to errors from CAN RAM ECC 2-bit error. false: disables delay timer start caused by maskable interrupts in response to errors from CAN RAM ECC 2-bit error.
          boolean McuEcmErrorOutputMask: set at post-build, origin=Renesas_v1.0.0, default-value=true  # This parameter mask or unmask the individual error sources of the error pin output from CAN RAM ECC 2-bit error. | true: mask the individual error sources of the error pin output from CAN RAM ECC 2-bit error. false: unmask the individual error sources of the error pin output from CAN RAM ECC 2-bit error.
          function name McuMiNotification [0..1]: set at post-build, origin=Renesas_v1.0.0, default-value=NULL_PTR, regular-expression=[a-zA-Z][a-zA-Z0-9_]*  # This parameter contains notification function for MI notification. | The syntax for McuMiNotification should be provided as Mcu_EcmMINotification.
          function name McuNmiNotification [0..1]: set at post-build, origin=Renesas_v1.0.0, default-value=NULL_PTR, regular-expression=[a-zA-Z][a-zA-Z0-9_]*  # This parameter contains notification function for NMI notification. | The syntax for McuNmiNotification should be provided as Mcu_EcmNMINotification.
          function name McuEcmInitialNotification [0..1]: set at post-build, origin=Renesas_v1.0.2, default-value=NULL_PTR, regular-expression=[a-zA-Z][a-zA-Z0-9_]*  # This parameter is used for notify the upper layer, if any ECM error has been already detected at system start-up. | The syntax for McuEcmInitialNotification should be provided as Mcu_EcmInitialNotification.
        container McuEcmErrorSource20  # This container contains all the supported configuration parameters of the related error source from FlexRay RAM ECC 2-bit error.
          boolean McuEcmErrorMaskableInterrupt: set at post-build, origin=Renesas_v1.0.0, default-value=false  # This parameter enables or disables generation of a maskable interrupt when the error occurs from FlexRay RAM ECC 2-bit error. | true: enables generation of a maskable interrupt when the error occurs from FlexRay RAM ECC 2-bit error. false: disables generation of a maskable interrupt when the error occurs from FlexRay RAM ECC 2-bit error.
          boolean McuEcmErrorNonMaskableInterrupt: set at post-build, origin=Renesas_v1.0.0, default-value=false  # This parameter enables or disables generation of a non-maskable interrupt when the error occurs from FlexRay RAM ECC 2-bit error. | true: enables generation of a non-maskable interrupt when the error occurs from FlexRay RAM ECC 2-bit error. false: disables generation of a non-maskable interrupt when the error occurs from FlexRay RAM ECC 2-bit error.
          boolean McuEcmErrorInternalReset: set at post-build, origin=Renesas_v1.0.0, default-value=false  # This parameter enables or disables generation of an internal reset when the error occurs from FlexRay RAM ECC 2-bit error. | true: enables generation of an internal reset when the error occurs from FlexRay RAM ECC 2-bit error. false: disables generation of an internal reset when the error occurs from FlexRay RAM ECC 2-bit error.
          boolean McuEcmErrorNMIDelayTimer: set at post-build, origin=Renesas_v1.0.0, default-value=false  # This parameter enables or disables delay timer start caused by non-maskable interrupts in response to errors from FlexRay RAM ECC 2-bit error. | true: enables delay timer start caused by non-maskable interrupts in response to errors from FlexRay RAM ECC 2-bit error. false: disables delay timer start caused by non-maskable interrupts in response to errors from FlexRay RAM ECC 2-bit error.
          boolean McuEcmErrorMIDelayTimer: set at post-build, origin=Renesas_v1.0.0, default-value=false  # This parameter enables or disables delay timer start caused by maskable interrupts in response to errors from FlexRay RAM ECC 2-bit error. | true: enables delay timer start caused by maskable interrupts in response to errors from FlexRay RAM ECC 2-bit error. false: disables delay timer start caused by maskable interrupts in response to errors from FlexRay RAM ECC 2-bit error.
          boolean McuEcmErrorOutputMask: set at post-build, origin=Renesas_v1.0.0, default-value=true  # This parameter mask or unmask the individual error sources of the error pin output from FlexRay RAM ECC 2-bit error. | true: mask the individual error sources of the error pin output from FlexRay RAM ECC 2-bit error. false: unmask the individual error sources of the error pin output from FlexRay RAM ECC 2-bit error.
          function name McuMiNotification [0..1]: set at post-build, origin=Renesas_v1.0.0, default-value=NULL_PTR, regular-expression=[a-zA-Z][a-zA-Z0-9_]*  # This parameter contains notification function for MI notification. | The syntax for McuMiNotification should be provided as Mcu_EcmMINotification.
          function name McuNmiNotification [0..1]: set at post-build, origin=Renesas_v1.0.0, default-value=NULL_PTR, regular-expression=[a-zA-Z][a-zA-Z0-9_]*  # This parameter contains notification function for NMI notification. | The syntax for McuNmiNotification should be provided as Mcu_EcmNMINotification.
          function name McuEcmInitialNotification [0..1]: set at post-build, origin=Renesas_v1.0.2, default-value=NULL_PTR, regular-expression=[a-zA-Z][a-zA-Z0-9_]*  # This parameter is used for notify the upper layer, if any ECM error has been already detected at system start-up. | The syntax for McuEcmInitialNotification should be provided as Mcu_EcmInitialNotification.
        container McuEcmErrorSource21  # This container contains all the supported configuration parameters of the related error source from Mode error (flash programming mode is started in single-chip mode).
          boolean McuEcmErrorMaskableInterrupt: set at post-build, origin=Renesas_v1.0.0, default-value=false  # This parameter enables or disables generation of a maskable interrupt when the error occurs from Mode error (flash programming mode is started in single-chip mode). | true: enables generation of a maskable interrupt when the error occurs from Mode error (flash programming mode is started in single-chip mode). false: disables generation of a maskable interrupt when the error occurs from Mode error (flash programming mode is started in single-chip mode).
          boolean McuEcmErrorNonMaskableInterrupt: set at post-build, origin=Renesas_v1.0.0, default-value=false  # This parameter enables or disables generation of a non-maskable interrupt when the error occurs from Mode error (flash programming mode is started in single-chip mode). | true: enables generation of a non-maskable interrupt when the error occurs from Mode error (flash programming mode is started in single-chip mode). false: disables generation of a non-maskable interrupt when the error occurs from Mode error (flash programming mode is started in single-chip mode).
          boolean McuEcmErrorInternalReset: set at post-build, origin=Renesas_v1.0.0, default-value=false  # This parameter enables or disables generation of an internal reset when the error occurs from Mode error (flash programming mode is started in single-chip mode). | true: enables generation of an internal reset when the error occurs from Mode error (flash programming mode is started in single-chip mode). false: disables generation of an internal reset when the error occurs from Mode error (flash programming mode is started in single-chip mode).
          boolean McuEcmErrorNMIDelayTimer: set at post-build, origin=Renesas_v1.0.0, default-value=false  # This parameter enables or disables delay timer start caused by non-maskable interrupts in response to errors from Mode error (flash programming mode is started in single-chip mode). | true: enables delay timer start caused by non-maskable interrupts in response to errors from Mode error (flash programming mode is started in single-chip mode). false: disables delay timer start caused by non-maskable interrupts in response to errors from Mode error (flash programming mode is started in single-chip mode).
          boolean McuEcmErrorMIDelayTimer: set at post-build, origin=Renesas_v1.0.0, default-value=false  # This parameter enables or disables delay timer start caused by maskable interrupts in response to errors from Mode error (flash programming mode is started in single-chip mode). | true: enables delay timer start caused by maskable interrupts in response to errors from Mode error (flash programming mode is started in single-chip mode). false: disables delay timer start caused by maskable interrupts in response to errors from Mode error (flash programming mode is started in single-chip mode).
          boolean McuEcmErrorOutputMask: set at post-build, origin=Renesas_v1.0.0, default-value=true  # This parameter mask or unmask the individual error sources of the error pin output from Mode error (flash programming mode is started in single-chip mode). | true: mask the individual error sources of the error pin output from Mode error (flash programming mode is started in single-chip mode). false: unmask the individual error sources of the error pin output from Mode error (flash programming mode is started in single-chip mode).
          function name McuMiNotification [0..1]: set at post-build, origin=Renesas_v1.0.0, default-value=NULL_PTR, regular-expression=[a-zA-Z][a-zA-Z0-9_]*  # This parameter contains notification function for MI notification. | The syntax for McuMiNotification should be provided as Mcu_EcmMINotification.
          function name McuNmiNotification [0..1]: set at post-build, origin=Renesas_v1.0.0, default-value=NULL_PTR, regular-expression=[a-zA-Z][a-zA-Z0-9_]*  # This parameter contains notification function for NMI notification. | The syntax for McuNmiNotification should be provided as Mcu_EcmNMINotification.
          function name McuEcmInitialNotification [0..1]: set at post-build, origin=Renesas_v1.0.2, default-value=NULL_PTR, regular-expression=[a-zA-Z][a-zA-Z0-9_]*  # This parameter is used for notify the upper layer, if any ECM error has been already detected at system start-up. | The syntax for McuEcmInitialNotification should be provided as Mcu_EcmInitialNotification.
        container McuEcmErrorSource22  # This container contains all the supported configuration parameters of the related error source from Mode error (test mode is started in single-chip mode).
          boolean McuEcmErrorMaskableInterrupt: set at post-build, origin=Renesas_v1.0.0, default-value=false  # This parameter enables or disables generation of a maskable interrupt when the error occurs from Mode error (test mode is started in single-chip mode). | true: enables generation of a maskable interrupt when the error occurs from Mode error (test mode is started in single-chip mode). false: disables generation of a maskable interrupt when the error occurs from Mode error (test mode is started in single-chip mode).
          boolean McuEcmErrorNonMaskableInterrupt: set at post-build, origin=Renesas_v1.0.0, default-value=false  # This parameter enables or disables generation of a non-maskable interrupt when the error occurs from Mode error (test mode is started in single-chip mode). | true: enables generation of a non-maskable interrupt when the error occurs from Mode error (test mode is started in single-chip mode). false: disables generation of a non-maskable interrupt when the error occurs from Mode error (test mode is started in single-chip mode).
          boolean McuEcmErrorInternalReset: set at post-build, origin=Renesas_v1.0.0, default-value=false  # This parameter enables or disables generation of an internal reset when the error occurs from Mode error (test mode is started in single-chip mode). | true: enables generation of an internal reset when the error occurs from Mode error (test mode is started in single-chip mode). false: disables generation of an internal reset when the error occurs from Mode error (test mode is started in single-chip mode).
          boolean McuEcmErrorNMIDelayTimer: set at post-build, origin=Renesas_v1.0.0, default-value=false  # This parameter enables or disables delay timer start caused by non-maskable interrupts in response to errors from Mode error (test mode is started in single-chip mode). | true: enables delay timer start caused by non-maskable interrupts in response to errors from Mode error (test mode is started in single-chip mode). false: disables delay timer start caused by non-maskable interrupts in response to errors from Mode error (test mode is started in single-chip mode).
          boolean McuEcmErrorMIDelayTimer: set at post-build, origin=Renesas_v1.0.0, default-value=false  # This parameter enables or disables delay timer start caused by maskable interrupts in response to errors from Mode error (test mode is started in single-chip mode). | true: enables delay timer start caused by maskable interrupts in response to errors from Mode error (test mode is started in single-chip mode). false: disables delay timer start caused by maskable interrupts in response to errors from Mode error (test mode is started in single-chip mode).
          boolean McuEcmErrorOutputMask: set at post-build, origin=Renesas_v1.0.0, default-value=true  # This parameter mask or unmask the individual error sources of the error pin output from Mode error (test mode is started in single-chip mode). | true: mask the individual error sources of the error pin output from Mode error (test mode is started in single-chip mode). false: unmask the individual error sources of the error pin output from Mode error (test mode is started in single-chip mode).
          function name McuMiNotification [0..1]: set at post-build, origin=Renesas_v1.0.0, default-value=NULL_PTR, regular-expression=[a-zA-Z][a-zA-Z0-9_]*  # This parameter contains notification function for MI notification. | The syntax for McuMiNotification should be provided as Mcu_EcmMINotification.
          function name McuNmiNotification [0..1]: set at post-build, origin=Renesas_v1.0.0, default-value=NULL_PTR, regular-expression=[a-zA-Z][a-zA-Z0-9_]*  # This parameter contains notification function for NMI notification. | The syntax for McuNmiNotification should be provided as Mcu_EcmNMINotification.
          function name McuEcmInitialNotification [0..1]: set at post-build, origin=Renesas_v1.0.2, default-value=NULL_PTR, regular-expression=[a-zA-Z][a-zA-Z0-9_]*  # This parameter is used for notify the upper layer, if any ECM error has been already detected at system start-up. | The syntax for McuEcmInitialNotification should be provided as Mcu_EcmInitialNotification.
        container McuEcmErrorSource23  # This container contains all the supported configuration parameters of the related error source from Mode error (single-chip mode is inactive in single-chip mode).
          boolean McuEcmErrorMaskableInterrupt: set at post-build, origin=Renesas_v1.0.0, default-value=false  # This parameter enables or disables generation of a maskable interrupt when the error occurs from Mode error (single-chip mode is inactive in single-chip mode). | true: enables generation of a maskable interrupt when the error occurs from Mode error (single-chip mode is inactive in single-chip mode). false: disables generation of a maskable interrupt when the error occurs from Mode error (single-chip mode is inactive in single-chip mode).
          boolean McuEcmErrorNonMaskableInterrupt: set at post-build, origin=Renesas_v1.0.0, default-value=false  # This parameter enables or disables generation of a non-maskable interrupt when the error occurs from Mode error (single-chip mode is inactive in single-chip mode). | true: enables generation of a non-maskable interrupt when the error occurs from Mode error (single-chip mode is inactive in single-chip mode). false: disables generation of a non-maskable interrupt when the error occurs from Mode error (single-chip mode is inactive in single-chip mode).
          boolean McuEcmErrorInternalReset: set at post-build, origin=Renesas_v1.0.0, default-value=false  # This parameter enables or disables generation of an internal reset when the error occurs from Mode error (single-chip mode is inactive in single-chip mode). | true: enables generation of an internal reset when the error occurs from Mode error (single-chip mode is inactive in single-chip mode). false: disables generation of an internal reset when the error occurs from Mode error (single-chip mode is inactive in single-chip mode).
          boolean McuEcmErrorNMIDelayTimer: set at post-build, origin=Renesas_v1.0.0, default-value=false  # This parameter enables or disables delay timer start caused by non-maskable interrupts in response to errors from Mode error (single-chip mode is inactive in single-chip mode). | true: enables delay timer start caused by non-maskable interrupts in response to errors from Mode error (single-chip mode is inactive in single-chip mode). false: disables delay timer start caused by non-maskable interrupts in response to errors from Mode error (single-chip mode is inactive in single-chip mode).
          boolean McuEcmErrorMIDelayTimer: set at post-build, origin=Renesas_v1.0.0, default-value=false  # This parameter enables or disables delay timer start caused by maskable interrupts in response to errors from Mode error (single-chip mode is inactive in single-chip mode). | true: enables delay timer start caused by maskable interrupts in response to errors from Mode error (single-chip mode is inactive in single-chip mode). false: disables delay timer start caused by maskable interrupts in response to errors from Mode error (single-chip mode is inactive in single-chip mode).
          boolean McuEcmErrorOutputMask: set at post-build, origin=Renesas_v1.0.0, default-value=true  # This parameter mask or unmask the individual error sources of the error pin output from Mode error (single-chip mode is inactive in single-chip mode). | true: mask the individual error sources of the error pin output from Mode error (single-chip mode is inactive in single-chip mode). false: unmask the individual error sources of the error pin output from Mode error (single-chip mode is inactive in single-chip mode).
          function name McuMiNotification [0..1]: set at post-build, origin=Renesas_v1.0.0, default-value=NULL_PTR, regular-expression=[a-zA-Z][a-zA-Z0-9_]*  # This parameter contains notification function for MI notification. | The syntax for McuMiNotification should be provided as Mcu_EcmMINotification.
          function name McuNmiNotification [0..1]: set at post-build, origin=Renesas_v1.0.0, default-value=NULL_PTR, regular-expression=[a-zA-Z][a-zA-Z0-9_]*  # This parameter contains notification function for NMI notification. | The syntax for McuNmiNotification should be provided as Mcu_EcmNMINotification.
          function name McuEcmInitialNotification [0..1]: set at post-build, origin=Renesas_v1.0.2, default-value=NULL_PTR, regular-expression=[a-zA-Z][a-zA-Z0-9_]*  # This parameter is used for notify the upper layer, if any ECM error has been already detected at system start-up. | The syntax for McuEcmInitialNotification should be provided as Mcu_EcmInitialNotification.
        container McuEcmErrorSource24  # This container contains all the supported configuration parameters of the related error source from PE guard error.
          boolean McuEcmErrorMaskableInterrupt: set at post-build, origin=Renesas_v1.0.0, default-value=false  # This parameter enables or disables generation of a maskable interrupt when the error occurs from PE guard error. | true: enables generation of a maskable interrupt when the error occurs from PE guard error. false: disables generation of a maskable interrupt when the error occurs from PE guard error.
          boolean McuEcmErrorNonMaskableInterrupt: set at post-build, origin=Renesas_v1.0.0, default-value=false  # This parameter enables or disables generation of a non-maskable interrupt when the error occurs from PE guard error. | true: enables generation of a non-maskable interrupt when the error occurs from PE guard error. false: disables generation of a non-maskable interrupt when the error occurs from PE guard error.
          boolean McuEcmErrorInternalReset: set at post-build, origin=Renesas_v1.0.0, default-value=false  # This parameter enables or disables generation of an internal reset when the error occurs from PE guard error. | true: enables generation of an internal reset when the error occurs from PE guard error. false: disables generation of an internal reset when the error occurs from PE guard error.
          boolean McuEcmErrorNMIDelayTimer: set at post-build, origin=Renesas_v1.0.0, default-value=false  # This parameter enables or disables delay timer start caused by non-maskable interrupts in response to errors from PE guard error. | true: enables delay timer start caused by non-maskable interrupts in response to errors from PE guard error. false: disables delay timer start caused by non-maskable interrupts in response to errors from PE guard error.
          boolean McuEcmErrorMIDelayTimer: set at post-build, origin=Renesas_v1.0.0, default-value=false  # This parameter enables or disables delay timer start caused by maskable interrupts in response to errors from PE guard error. | true: enables delay timer start caused by maskable interrupts in response to errors from PE guard error. false: disables delay timer start caused by maskable interrupts in response to errors from PE guard error.
          boolean McuEcmErrorOutputMask: set at post-build, origin=Renesas_v1.0.0, default-value=true  # This parameter mask or unmask the individual error sources of the error pin output from PE guard error. | true: mask the individual error sources of the error pin output from PE guard error. false: unmask the individual error sources of the error pin output from PE guard error.
          function name McuMiNotification [0..1]: set at post-build, origin=Renesas_v1.0.0, default-value=NULL_PTR, regular-expression=[a-zA-Z][a-zA-Z0-9_]*  # This parameter contains notification function for MI notification. | The syntax for McuMiNotification should be provided as Mcu_EcmMINotification.
          function name McuNmiNotification [0..1]: set at post-build, origin=Renesas_v1.0.0, default-value=NULL_PTR, regular-expression=[a-zA-Z][a-zA-Z0-9_]*  # This parameter contains notification function for NMI notification. | The syntax for McuNmiNotification should be provided as Mcu_EcmNMINotification.
          function name McuEcmInitialNotification [0..1]: set at post-build, origin=Renesas_v1.0.2, default-value=NULL_PTR, regular-expression=[a-zA-Z][a-zA-Z0-9_]*  # This parameter is used for notify the upper layer, if any ECM error has been already detected at system start-up. | The syntax for McuEcmInitialNotification should be provided as Mcu_EcmInitialNotification.
        container McuEcmErrorSource26  # This container contains all the supported configuration parameters of the related error source from P-Bus guard error.
          boolean McuEcmErrorMaskableInterrupt: set at post-build, origin=Renesas_v1.0.0, default-value=false  # This parameter enables or disables generation of a maskable interrupt when the error occurs from P-Bus guard error. | true: enables generation of a maskable interrupt when the error occurs from P-Bus guard error. false: disables generation of a maskable interrupt when the error occurs from P-Bus guard error.
          boolean McuEcmErrorNonMaskableInterrupt: set at post-build, origin=Renesas_v1.0.0, default-value=false  # This parameter enables or disables generation of a non-maskable interrupt when the error occurs from P-Bus guard error. | true: enables generation of a non-maskable interrupt when the error occurs from P-Bus guard error. false: disables generation of a non-maskable interrupt when the error occurs from P-Bus guard error.
          boolean McuEcmErrorInternalReset: set at post-build, origin=Renesas_v1.0.0, default-value=false  # This parameter enables or disables generation of an internal reset when the error occurs from P-Bus guard error. | true: enables generation of an internal reset when the error occurs from P-Bus guard error. false: disables generation of an internal reset when the error occurs from P-Bus guard error.
          boolean McuEcmErrorNMIDelayTimer: set at post-build, origin=Renesas_v1.0.0, default-value=false  # This parameter enables or disables delay timer start caused by non-maskable interrupts in response to errors from P-Bus guard error. | true: enables delay timer start caused by non-maskable interrupts in response to errors from P-Bus guard error. false: disables delay timer start caused by non-maskable interrupts in response to errors from P-Bus guard error.
          boolean McuEcmErrorMIDelayTimer: set at post-build, origin=Renesas_v1.0.0, default-value=false  # This parameter enables or disables delay timer start caused by maskable interrupts in response to errors from P-Bus guard error. | true: enables delay timer start caused by maskable interrupts in response to errors from P-Bus guard error. false: disables delay timer start caused by maskable interrupts in response to errors from P-Bus guard error.
          boolean McuEcmErrorOutputMask: set at post-build, origin=Renesas_v1.0.0, default-value=true  # This parameter mask or unmask the individual error sources of the error pin output from P-Bus guard error. | true: mask the individual error sources of the error pin output from P-Bus guard error. false: unmask the individual error sources of the error pin output from P-Bus guard error.
          function name McuMiNotification [0..1]: set at post-build, origin=Renesas_v1.0.0, default-value=NULL_PTR, regular-expression=[a-zA-Z][a-zA-Z0-9_]*  # This parameter contains notification function for MI notification. | The syntax for McuMiNotification should be provided as Mcu_EcmMINotification.
          function name McuNmiNotification [0..1]: set at post-build, origin=Renesas_v1.0.0, default-value=NULL_PTR, regular-expression=[a-zA-Z][a-zA-Z0-9_]*  # This parameter contains notification function for NMI notification. | The syntax for McuNmiNotification should be provided as Mcu_EcmNMINotification.
          function name McuEcmInitialNotification [0..1]: set at post-build, origin=Renesas_v1.0.2, default-value=NULL_PTR, regular-expression=[a-zA-Z][a-zA-Z0-9_]*  # This parameter is used for notify the upper layer, if any ECM error has been already detected at system start-up. | The syntax for McuEcmInitialNotification should be provided as Mcu_EcmInitialNotification.
        container McuEcmErrorSource27  # This container contains all the supported configuration parameters of the related error source from SAR-ADC parity error.
          boolean McuEcmErrorMaskableInterrupt: set at post-build, origin=Renesas_v1.0.0, default-value=false  # This parameter enables or disables generation of a maskable interrupt when the error occurs from SAR-ADC parity error. | true: enables generation of a maskable interrupt when the error occurs from SAR-ADC parity error. false: disables generation of a maskable interrupt when the error occurs from SAR-ADC parity error.
          boolean McuEcmErrorNonMaskableInterrupt: set at post-build, origin=Renesas_v1.0.0, default-value=false  # This parameter enables or disables generation of a non-maskable interrupt when the error occurs from SAR-ADC parity error. | true: enables generation of a non-maskable interrupt when the error occurs from SAR-ADC parity error. false: disables generation of a non-maskable interrupt when the error occurs from SAR-ADC parity error.
          boolean McuEcmErrorInternalReset: set at post-build, origin=Renesas_v1.0.0, default-value=false  # This parameter enables or disables generation of an internal reset when the error occurs from SAR-ADC parity error. | true: enables generation of an internal reset when the error occurs from SAR-ADC parity error. false: disables generation of an internal reset when the error occurs from SAR-ADC parity error.
          boolean McuEcmErrorNMIDelayTimer: set at post-build, origin=Renesas_v1.0.0, default-value=false  # This parameter enables or disables delay timer start caused by non-maskable interrupts in response to errors from SAR-ADC parity error. | true: enables delay timer start caused by non-maskable interrupts in response to errors from SAR-ADC parity error. false: disables delay timer start caused by non-maskable interrupts in response to errors from SAR-ADC parity error.
          boolean McuEcmErrorMIDelayTimer: set at post-build, origin=Renesas_v1.0.0, default-value=false  # This parameter enables or disables delay timer start caused by maskable interrupts in response to errors from SAR-ADC parity error. | true: enables delay timer start caused by maskable interrupts in response to errors from SAR-ADC parity error. false: disables delay timer start caused by maskable interrupts in response to errors from SAR-ADC parity error.
          boolean McuEcmErrorOutputMask: set at post-build, origin=Renesas_v1.0.0, default-value=true  # This parameter mask or unmask the individual error sources of the error pin output from SAR-ADC parity error. | true: mask the individual error sources of the error pin output from SAR-ADC parity error. false: unmask the individual error sources of the error pin output from SAR-ADC parity error.
          function name McuMiNotification [0..1]: set at post-build, origin=Renesas_v1.0.0, default-value=NULL_PTR, regular-expression=[a-zA-Z][a-zA-Z0-9_]*  # This parameter contains notification function for MI notification. | The syntax for McuMiNotification should be provided as Mcu_EcmMINotification.
          function name McuNmiNotification [0..1]: set at post-build, origin=Renesas_v1.0.0, default-value=NULL_PTR, regular-expression=[a-zA-Z][a-zA-Z0-9_]*  # This parameter contains notification function for NMI notification. | The syntax for McuNmiNotification should be provided as Mcu_EcmNMINotification.
          function name McuEcmInitialNotification [0..1]: set at post-build, origin=Renesas_v1.0.2, default-value=NULL_PTR, regular-expression=[a-zA-Z][a-zA-Z0-9_]*  # This parameter is used for notify the upper layer, if any ECM error has been already detected at system start-up. | The syntax for McuEcmInitialNotification should be provided as Mcu_EcmInitialNotification.
        container McuEcmErrorSource28  # This container contains all the supported configuration parameters of the related error source from Bus data parity error.
          boolean McuEcmErrorMaskableInterrupt: set at post-build, origin=Renesas_v1.0.0, default-value=false  # This parameter enables or disables generation of a maskable interrupt when the error occurs from Bus data parity error. | true: enables generation of a maskable interrupt when the error occurs from Bus data parity error. false: disables generation of a maskable interrupt when the error occurs from Bus data parity error.
          boolean McuEcmErrorNonMaskableInterrupt: set at post-build, origin=Renesas_v1.0.0, default-value=false  # This parameter enables or disables generation of a non-maskable interrupt when the error occurs from Bus data parity error. | true: enables generation of a non-maskable interrupt when the error occurs from Bus data parity error. false: disables generation of a non-maskable interrupt when the error occurs from Bus data parity error.
          boolean McuEcmErrorInternalReset: set at post-build, origin=Renesas_v1.0.0, default-value=false  # This parameter enables or disables generation of an internal reset when the error occurs from Bus data parity error. | true: enables generation of an internal reset when the error occurs from Bus data parity error. false: disables generation of an internal reset when the error occurs from Bus data parity error.
          boolean McuEcmErrorNMIDelayTimer: set at post-build, origin=Renesas_v1.0.0, default-value=false  # This parameter enables or disables delay timer start caused by non-maskable interrupts in response to errors from Bus data parity error. | true: enables delay timer start caused by non-maskable interrupts in response to errors from Bus data parity error. false: disables delay timer start caused by non-maskable interrupts in response to errors from Bus data parity error.
          boolean McuEcmErrorMIDelayTimer: set at post-build, origin=Renesas_v1.0.0, default-value=false  # This parameter enables or disables delay timer start caused by maskable interrupts in response to errors from Bus data parity error. | true: enables delay timer start caused by maskable interrupts in response to errors from Bus data parity error. false: disables delay timer start caused by maskable interrupts in response to errors from Bus data parity error.
          boolean McuEcmErrorOutputMask: set at post-build, origin=Renesas_v1.0.0, default-value=true  # This parameter mask or unmask the individual error sources of the error pin output from Bus data parity error. | true: mask the individual error sources of the error pin output from Bus data parity error. false: unmask the individual error sources of the error pin output from Bus data parity error.
          function name McuMiNotification [0..1]: set at post-build, origin=Renesas_v1.0.0, default-value=NULL_PTR, regular-expression=[a-zA-Z][a-zA-Z0-9_]*  # This parameter contains notification function for MI notification. | The syntax for McuMiNotification should be provided as Mcu_EcmMINotification.
          function name McuNmiNotification [0..1]: set at post-build, origin=Renesas_v1.0.0, default-value=NULL_PTR, regular-expression=[a-zA-Z][a-zA-Z0-9_]*  # This parameter contains notification function for NMI notification. | The syntax for McuNmiNotification should be provided as Mcu_EcmNMINotification.
          function name McuEcmInitialNotification [0..1]: set at post-build, origin=Renesas_v1.0.2, default-value=NULL_PTR, regular-expression=[a-zA-Z][a-zA-Z0-9_]*  # This parameter is used for notify the upper layer, if any ECM error has been already detected at system start-up. | The syntax for McuEcmInitialNotification should be provided as Mcu_EcmInitialNotification.
        container McuEcmErrorSource29  # This container contains all the supported configuration parameters of the related error source from ECM compare error.
          boolean McuEcmErrorMaskableInterrupt: set at post-build, origin=Renesas_v1.0.0, default-value=false  # This parameter enables or disables generation of a maskable interrupt when the error occurs from ECM compare error. | true: enables generation of a maskable interrupt when the error occurs from ECM compare error. false: disables generation of a maskable interrupt when the error occurs from ECM compare error.
          boolean McuEcmErrorNonMaskableInterrupt: set at post-build, origin=Renesas_v1.0.0, default-value=false  # This parameter enables or disables generation of a non-maskable interrupt when the error occurs from ECM compare error. | true: enables generation of a non-maskable interrupt when the error occurs from ECM compare error. false: disables generation of a non-maskable interrupt when the error occurs from ECM compare error.
          boolean McuEcmErrorInternalReset: set at post-build, origin=Renesas_v1.0.0, default-value=false  # This parameter enables or disables generation of an internal reset when the error occurs from ECM compare error. | true: enables generation of an internal reset when the error occurs from ECM compare error. false: disables generation of an internal reset when the error occurs from ECM compare error.
          boolean McuEcmErrorNMIDelayTimer: set at post-build, origin=Renesas_v1.0.0, default-value=false  # This parameter enables or disables delay timer start caused by non-maskable interrupts in response to errors from ECM compare error. | true: enables delay timer start caused by non-maskable interrupts in response to errors from ECM compare error. false: disables delay timer start caused by non-maskable interrupts in response to errors from ECM compare error.
          boolean McuEcmErrorMIDelayTimer: set at post-build, origin=Renesas_v1.0.0, default-value=false  # This parameter enables or disables delay timer start caused by maskable interrupts in response to errors from ECM compare error. | true: enables delay timer start caused by maskable interrupts in response to errors from ECM compare error. false: disables delay timer start caused by maskable interrupts in response to errors from ECM compare error.
          boolean McuEcmErrorOutputMask: set at post-build, origin=Renesas_v1.0.0, default-value=true  # This parameter mask or unmask the individual error sources of the error pin output from ECM compare error. | true: mask the individual error sources of the error pin output from ECM compare error. false: unmask the individual error sources of the error pin output from ECM compare error.
          function name McuMiNotification [0..1]: set at post-build, origin=Renesas_v1.0.0, default-value=NULL_PTR, regular-expression=[a-zA-Z][a-zA-Z0-9_]*  # This parameter contains notification function for MI notification. | The syntax for McuMiNotification should be provided as Mcu_EcmMINotification.
          function name McuNmiNotification [0..1]: set at post-build, origin=Renesas_v1.0.0, default-value=NULL_PTR, regular-expression=[a-zA-Z][a-zA-Z0-9_]*  # This parameter contains notification function for NMI notification. | The syntax for McuNmiNotification should be provided as Mcu_EcmNMINotification.
          function name McuEcmInitialNotification [0..1]: set at post-build, origin=Renesas_v1.0.2, default-value=NULL_PTR, regular-expression=[a-zA-Z][a-zA-Z0-9_]*  # This parameter is used for notify the upper layer, if any ECM error has been already detected at system start-up. | The syntax for McuEcmInitialNotification should be provided as Mcu_EcmInitialNotification.
        container McuEcmErrorSource30  # This container contains all the supported configuration parameters of the related error source from LVI error.
          boolean McuEcmErrorMaskableInterrupt: set at post-build, origin=Renesas_v1.0.0, default-value=false  # This parameter enables or disables generation of a maskable interrupt when the error occurs from LVI error. | true: enables generation of a maskable interrupt when the error occurs from LVI error. false: disables generation of a maskable interrupt when the error occurs from LVI error.
          boolean McuEcmErrorNonMaskableInterrupt: set at post-build, origin=Renesas_v1.0.0, default-value=false  # This parameter enables or disables generation of a non-maskable interrupt when the error occurs from LVI error. | true: enables generation of a non-maskable interrupt when the error occurs from LVI error. false: disables generation of a non-maskable interrupt when the error occurs from LVI error.
          boolean McuEcmErrorInternalReset: set at post-build, origin=Renesas_v1.0.0, default-value=false  # This parameter enables or disables generation of an internal reset when the error occurs from LVI error. | true: enables generation of an internal reset when the error occurs from LVI error. false: disables generation of an internal reset when the error occurs from LVI error.
          boolean McuEcmErrorNMIDelayTimer: set at post-build, origin=Renesas_v1.0.0, default-value=false  # This parameter enables or disables delay timer start caused by non-maskable interrupts in response to errors from LVI error. | true: enables delay timer start caused by non-maskable interrupts in response to errors from LVI error. false: disables delay timer start caused by non-maskable interrupts in response to errors from LVI error.
          boolean McuEcmErrorMIDelayTimer: set at post-build, origin=Renesas_v1.0.0, default-value=false  # This parameter enables or disables delay timer start caused by maskable interrupts in response to errors from LVI error. | true: enables delay timer start caused by maskable interrupts in response to errors from LVI error. false: disables delay timer start caused by maskable interrupts in response to errors from LVI error.
          boolean McuEcmErrorOutputMask: set at post-build, origin=Renesas_v1.0.0, default-value=true  # This parameter mask or unmask the individual error sources of the error pin output from LVI error. | true: mask the individual error sources of the error pin output from LVI error. false: unmask the individual error sources of the error pin output from LVI error.
          function name McuMiNotification [0..1]: set at post-build, origin=Renesas_v1.0.0, default-value=NULL_PTR, regular-expression=[a-zA-Z][a-zA-Z0-9_]*  # This parameter contains notification function for MI notification. | The syntax for McuMiNotification should be provided as Mcu_EcmMINotification.
          function name McuNmiNotification [0..1]: set at post-build, origin=Renesas_v1.0.0, default-value=NULL_PTR, regular-expression=[a-zA-Z][a-zA-Z0-9_]*  # This parameter contains notification function for NMI notification. | The syntax for McuNmiNotification should be provided as Mcu_EcmNMINotification.
          function name McuEcmInitialNotification [0..1]: set at post-build, origin=Renesas_v1.0.2, default-value=NULL_PTR, regular-expression=[a-zA-Z][a-zA-Z0-9_]*  # This parameter is used for notify the upper layer, if any ECM error has been already detected at system start-up. | The syntax for McuEcmInitialNotification should be provided as Mcu_EcmInitialNotification.
        container McuEcmErrorSource31  # This container contains all the supported configuration parameters of the related error source from Temperature sensor error.
          boolean McuEcmErrorMaskableInterrupt: set at post-build, origin=Renesas_v1.0.0, default-value=false  # This parameter enables or disables generation of a maskable interrupt when the error occurs from Temperature sensor error. | true: enables generation of a maskable interrupt when the error occurs from Temperature sensor error. false: disables generation of a maskable interrupt when the error occurs from Temperature sensor error.
          boolean McuEcmErrorNonMaskableInterrupt: set at post-build, origin=Renesas_v1.0.0, default-value=false  # This parameter enables or disables generation of a non-maskable interrupt when the error occurs from Temperature sensor error. | true: enables generation of a non-maskable interrupt when the error occurs from Temperature sensor error. false: disables generation of a non-maskable interrupt when the error occurs from Temperature sensor error.
          boolean McuEcmErrorInternalReset: set at post-build, origin=Renesas_v1.0.0, default-value=false  # This parameter enables or disables generation of an internal reset when the error occurs from Temperature sensor error. | true: enables generation of an internal reset when the error occurs from Temperature sensor error. false: disables generation of an internal reset when the error occurs from Temperature sensor error.
          boolean McuEcmErrorNMIDelayTimer: set at post-build, origin=Renesas_v1.0.0, default-value=false  # This parameter enables or disables delay timer start caused by non-maskable interrupts in response to errors from Temperature sensor error. | true: enables delay timer start caused by non-maskable interrupts in response to errors from Temperature sensor error. false: disables delay timer start caused by non-maskable interrupts in response to errors from Temperature sensor error.
          boolean McuEcmErrorMIDelayTimer: set at post-build, origin=Renesas_v1.0.0, default-value=false  # This parameter enables or disables delay timer start caused by maskable interrupts in response to errors from Temperature sensor error. | true: enables delay timer start caused by maskable interrupts in response to errors from Temperature sensor error. false: disables delay timer start caused by maskable interrupts in response to errors from Temperature sensor error.
          boolean McuEcmErrorOutputMask: set at post-build, origin=Renesas_v1.0.0, default-value=true  # This parameter mask or unmask the individual error sources of the error pin output from Temperature sensor error. | true: mask the individual error sources of the error pin output from Temperature sensor error. false: unmask the individual error sources of the error pin output from Temperature sensor error.
          function name McuMiNotification [0..1]: set at post-build, origin=Renesas_v1.0.0, default-value=NULL_PTR, regular-expression=[a-zA-Z][a-zA-Z0-9_]*  # This parameter contains notification function for MI notification. | The syntax for McuMiNotification should be provided as Mcu_EcmMINotification.
          function name McuNmiNotification [0..1]: set at post-build, origin=Renesas_v1.0.0, default-value=NULL_PTR, regular-expression=[a-zA-Z][a-zA-Z0-9_]*  # This parameter contains notification function for NMI notification. | The syntax for McuNmiNotification should be provided as Mcu_EcmNMINotification.
          function name McuEcmInitialNotification [0..1]: set at post-build, origin=Renesas_v1.0.2, default-value=NULL_PTR, regular-expression=[a-zA-Z][a-zA-Z0-9_]*  # This parameter is used for notify the upper layer, if any ECM error has been already detected at system start-up. | The syntax for McuEcmInitialNotification should be provided as Mcu_EcmInitialNotification.
        container McuEcmErrorSource32  # This container contains all the supported configuration parameters of the related error source from DMA transfer error.
          boolean McuEcmErrorMaskableInterrupt: set at post-build, origin=Renesas_v1.0.0, default-value=false  # This parameter enables or disables generation of a maskable interrupt when the error occurs from DMA transfer error. | true: enables generation of a maskable interrupt when the error occurs from DMA transfer error. false: disables generation of a maskable interrupt when the error occurs from DMA transfer error.
          boolean McuEcmErrorNonMaskableInterrupt: set at post-build, origin=Renesas_v1.0.0, default-value=false  # This parameter enables or disables generation of a non-maskable interrupt when the error occurs from DMA transfer error. | true: enables generation of a non-maskable interrupt when the error occurs from DMA transfer error. false: disables generation of a non-maskable interrupt when the error occurs from DMA transfer error.
          boolean McuEcmErrorInternalReset: set at post-build, origin=Renesas_v1.0.0, default-value=false  # This parameter enables or disables generation of an internal reset when the error occurs from DMA transfer error. | true: enables generation of an internal reset when the error occurs from DMA transfer error. false: disables generation of an internal reset when the error occurs from DMA transfer error.
          boolean McuEcmErrorNMIDelayTimer: set at post-build, origin=Renesas_v1.0.0, default-value=false  # This parameter enables or disables delay timer start caused by non-maskable interrupts in response to errors from DMA transfer error. | true: enables delay timer start caused by non-maskable interrupts in response to errors from DMA transfer error. false: disables delay timer start caused by non-maskable interrupts in response to errors from DMA transfer error.
          boolean McuEcmErrorMIDelayTimer: set at post-build, origin=Renesas_v1.0.0, default-value=false  # This parameter enables or disables delay timer start caused by maskable interrupts in response to errors from DMA transfer error. | true: enables delay timer start caused by maskable interrupts in response to errors from DMA transfer error. false: disables delay timer start caused by maskable interrupts in response to errors from DMA transfer error.
          boolean McuEcmErrorOutputMask: set at post-build, origin=Renesas_v1.0.0, default-value=true  # This parameter mask or unmask the individual error sources of the error pin output from DMA transfer error. | true: mask the individual error sources of the error pin output from DMA transfer error. false: unmask the individual error sources of the error pin output from DMA transfer error.
          function name McuMiNotification [0..1]: set at post-build, origin=Renesas_v1.0.0, default-value=NULL_PTR, regular-expression=[a-zA-Z][a-zA-Z0-9_]*  # This parameter contains notification function for MI notification. | The syntax for McuMiNotification should be provided as Mcu_EcmMINotification.
          function name McuNmiNotification [0..1]: set at post-build, origin=Renesas_v1.0.0, default-value=NULL_PTR, regular-expression=[a-zA-Z][a-zA-Z0-9_]*  # This parameter contains notification function for NMI notification. | The syntax for McuNmiNotification should be provided as Mcu_EcmNMINotification.
          function name McuEcmInitialNotification [0..1]: set at post-build, origin=Renesas_v1.0.2, default-value=NULL_PTR, regular-expression=[a-zA-Z][a-zA-Z0-9_]*  # This parameter is used for notify the upper layer, if any ECM error has been already detected at system start-up. | The syntax for McuEcmInitialNotification should be provided as Mcu_EcmInitialNotification.
        container McuEcmErrorSource33  # This container contains all the supported configuration parameters of the related error source from DMA register access protection violation error.
          boolean McuEcmErrorMaskableInterrupt: set at post-build, origin=Renesas_v1.0.0, default-value=false  # This parameter enables or disables generation of a maskable interrupt when the error occurs from DMA register access protection violation error. | true: enables generation of a maskable interrupt when the error occurs from DMA register access protection violation error. false: disables generation of a maskable interrupt when the error occurs from DMA register access protection violation error.
          boolean McuEcmErrorNonMaskableInterrupt: set at post-build, origin=Renesas_v1.0.0, default-value=false  # This parameter enables or disables generation of a non-maskable interrupt when the error occurs from DMA register access protection violation error. | true: enables generation of a non-maskable interrupt when the error occurs from DMA register access protection violation error. false: disables generation of a non-maskable interrupt when the error occurs from DMA register access protection violation error.
          boolean McuEcmErrorInternalReset: set at post-build, origin=Renesas_v1.0.0, default-value=false  # This parameter enables or disables generation of an internal reset when the error occurs from DMA register access protection violation error. | true: enables generation of an internal reset when the error occurs from DMA register access protection violation error. false: disables generation of an internal reset when the error occurs from DMA register access protection violation error.
          boolean McuEcmErrorNMIDelayTimer: set at post-build, origin=Renesas_v1.0.0, default-value=false  # This parameter enables or disables delay timer start caused by non-maskable interrupts in response to errors from DMA register access protection violation error. | true: enables delay timer start caused by non-maskable interrupts in response to errors from DMA register access protection violation error. false: disables delay timer start caused by non-maskable interrupts in response to errors from DMA register access protection violation error.
          boolean McuEcmErrorMIDelayTimer: set at post-build, origin=Renesas_v1.0.0, default-value=false  # This parameter enables or disables delay timer start caused by maskable interrupts in response to errors from DMA register access protection violation error. | true: enables delay timer start caused by maskable interrupts in response to errors from DMA register access protection violation error. false: disables delay timer start caused by maskable interrupts in response to errors from DMA register access protection violation error.
          boolean McuEcmErrorOutputMask: set at post-build, origin=Renesas_v1.0.0, default-value=true  # This parameter mask or unmask the individual error sources of the error pin output from DMA register access protection violation error. | true: mask the individual error sources of the error pin output from DMA register access protection violation error. false: unmask the individual error sources of the error pin output from DMA register access protection violation error.
          function name McuMiNotification [0..1]: set at post-build, origin=Renesas_v1.0.0, default-value=NULL_PTR, regular-expression=[a-zA-Z][a-zA-Z0-9_]*  # This parameter contains notification function for MI notification. | The syntax for McuMiNotification should be provided as Mcu_EcmMINotification.
          function name McuNmiNotification [0..1]: set at post-build, origin=Renesas_v1.0.0, default-value=NULL_PTR, regular-expression=[a-zA-Z][a-zA-Z0-9_]*  # This parameter contains notification function for NMI notification. | The syntax for McuNmiNotification should be provided as Mcu_EcmNMINotification.
          function name McuEcmInitialNotification [0..1]: set at post-build, origin=Renesas_v1.0.2, default-value=NULL_PTR, regular-expression=[a-zA-Z][a-zA-Z0-9_]*  # This parameter is used for notify the upper layer, if any ECM error has been already detected at system start-up. | The syntax for McuEcmInitialNotification should be provided as Mcu_EcmInitialNotification.
        container McuEcmErrorSource34  # This container contains all the supported configuration parameters of the related error source from Local RAM ECC 1-bit error and parity error.
          boolean McuEcmErrorMaskableInterrupt: set at post-build, origin=Renesas_v1.0.0, default-value=false  # This parameter enables or disables generation of a maskable interrupt when the error occurs from Local RAM ECC 1-bit error and parity error. | true: enables generation of a maskable interrupt when the error occurs from Local RAM ECC 1-bit error and parity error. false: disables generation of a maskable interrupt when the error occurs from Local RAM ECC 1-bit error and parity error.
          boolean McuEcmErrorNonMaskableInterrupt: set at post-build, origin=Renesas_v1.0.0, default-value=false  # This parameter enables or disables generation of a non-maskable interrupt when the error occurs from Local RAM ECC 1-bit error and parity error. | true: enables generation of a non-maskable interrupt when the error occurs from Local RAM ECC 1-bit error and parity error. false: disables generation of a non-maskable interrupt when the error occurs from Local RAM ECC 1-bit error and parity error.
          boolean McuEcmErrorInternalReset: set at post-build, origin=Renesas_v1.0.0, default-value=false  # This parameter enables or disables generation of an internal reset when the error occurs from Local RAM ECC 1-bit error and parity error. | true: enables generation of an internal reset when the error occurs from Local RAM ECC 1-bit error and parity error. false: disables generation of an internal reset when the error occurs from Local RAM ECC 1-bit error and parity error.
          boolean McuEcmErrorNMIDelayTimer: set at post-build, origin=Renesas_v1.0.0, default-value=false  # This parameter enables or disables delay timer start caused by non-maskable interrupts in response to errors from Local RAM ECC 1-bit error and parity error. | true: enables delay timer start caused by non-maskable interrupts in response to errors from Local RAM ECC 1-bit error and parity error. false: disables delay timer start caused by non-maskable interrupts in response to errors from Local RAM ECC 1-bit error and parity error.
          boolean McuEcmErrorMIDelayTimer: set at post-build, origin=Renesas_v1.0.0, default-value=false  # This parameter enables or disables delay timer start caused by maskable interrupts in response to errors from Local RAM ECC 1-bit error and parity error. | true: enables delay timer start caused by maskable interrupts in response to errors from Local RAM ECC 1-bit error and parity error. false: disables delay timer start caused by maskable interrupts in response to errors from Local RAM ECC 1-bit error and parity error.
          boolean McuEcmErrorOutputMask: set at post-build, origin=Renesas_v1.0.0, default-value=true  # This parameter mask or unmask the individual error sources of the error pin output from Local RAM ECC 1-bit error and parity error. | true: mask the individual error sources of the error pin output from Local RAM ECC 1-bit error and parity error. false: unmask the individual error sources of the error pin output from Local RAM ECC 1-bit error and parity error.
          function name McuMiNotification [0..1]: set at post-build, origin=Renesas_v1.0.0, default-value=NULL_PTR, regular-expression=[a-zA-Z][a-zA-Z0-9_]*  # This parameter contains notification function for MI notification. | The syntax for McuMiNotification should be provided as Mcu_EcmMINotification.
          function name McuNmiNotification [0..1]: set at post-build, origin=Renesas_v1.0.0, default-value=NULL_PTR, regular-expression=[a-zA-Z][a-zA-Z0-9_]*  # This parameter contains notification function for NMI notification. | The syntax for McuNmiNotification should be provided as Mcu_EcmNMINotification.
          function name McuEcmInitialNotification [0..1]: set at post-build, origin=Renesas_v1.0.2, default-value=NULL_PTR, regular-expression=[a-zA-Z][a-zA-Z0-9_]*  # This parameter is used for notify the upper layer, if any ECM error has been already detected at system start-up. | The syntax for McuEcmInitialNotification should be provided as Mcu_EcmInitialNotification.
        container McuEcmErrorSource36  # This container contains all the supported configuration parameters of the related error source from Code flash ECC 1-bit error.
          boolean McuEcmErrorMaskableInterrupt: set at post-build, origin=Renesas_v1.0.0, default-value=false  # This parameter enables or disables generation of a maskable interrupt when the error occurs from Code flash ECC 1-bit error. | true: enables generation of a maskable interrupt when the error occurs from Code flash ECC 1-bit error. false: disables generation of a maskable interrupt when the error occurs from Code flash ECC 1-bit error.
          boolean McuEcmErrorNonMaskableInterrupt: set at post-build, origin=Renesas_v1.0.0, default-value=false  # This parameter enables or disables generation of a non-maskable interrupt when the error occurs from Code flash ECC 1-bit error. | true: enables generation of a non-maskable interrupt when the error occurs from Code flash ECC 1-bit error. false: disables generation of a non-maskable interrupt when the error occurs from Code flash ECC 1-bit error.
          boolean McuEcmErrorInternalReset: set at post-build, origin=Renesas_v1.0.0, default-value=false  # This parameter enables or disables generation of an internal reset when the error occurs from Code flash ECC 1-bit error. | true: enables generation of an internal reset when the error occurs from Code flash ECC 1-bit error. false: disables generation of an internal reset when the error occurs from Code flash ECC 1-bit error.
          boolean McuEcmErrorNMIDelayTimer: set at post-build, origin=Renesas_v1.0.0, default-value=false  # This parameter enables or disables delay timer start caused by non-maskable interrupts in response to errors from Code flash ECC 1-bit error. | true: enables delay timer start caused by non-maskable interrupts in response to errors from Code flash ECC 1-bit error. false: disables delay timer start caused by non-maskable interrupts in response to errors from Code flash ECC 1-bit error.
          boolean McuEcmErrorMIDelayTimer: set at post-build, origin=Renesas_v1.0.0, default-value=false  # This parameter enables or disables delay timer start caused by maskable interrupts in response to errors from Code flash ECC 1-bit error. | true: enables delay timer start caused by maskable interrupts in response to errors from Code flash ECC 1-bit error. false: disables delay timer start caused by maskable interrupts in response to errors from Code flash ECC 1-bit error.
          boolean McuEcmErrorOutputMask: set at post-build, origin=Renesas_v1.0.0, default-value=true  # This parameter mask or unmask the individual error sources of the error pin output from Code flash ECC 1-bit error. | true: mask the individual error sources of the error pin output from Code flash ECC 1-bit error. false: unmask the individual error sources of the error pin output from Code flash ECC 1-bit error.
          function name McuMiNotification [0..1]: set at post-build, origin=Renesas_v1.0.0, default-value=NULL_PTR, regular-expression=[a-zA-Z][a-zA-Z0-9_]*  # This parameter contains notification function for MI notification. | The syntax for McuMiNotification should be provided as Mcu_EcmMINotification.
          function name McuNmiNotification [0..1]: set at post-build, origin=Renesas_v1.0.0, default-value=NULL_PTR, regular-expression=[a-zA-Z][a-zA-Z0-9_]*  # This parameter contains notification function for NMI notification. | The syntax for McuNmiNotification should be provided as Mcu_EcmNMINotification.
          function name McuEcmInitialNotification [0..1]: set at post-build, origin=Renesas_v1.0.2, default-value=NULL_PTR, regular-expression=[a-zA-Z][a-zA-Z0-9_]*  # This parameter is used for notify the upper layer, if any ECM error has been already detected at system start-up. | The syntax for McuEcmInitialNotification should be provided as Mcu_EcmInitialNotification.
        container McuEcmErrorSource37  # This container contains all the supported configuration parameters of the related error source from Data flash ECC 1-bit error.
          boolean McuEcmErrorMaskableInterrupt: set at post-build, origin=Renesas_v1.0.0, default-value=false  # This parameter enables or disables generation of a maskable interrupt when the error occurs from Data flash ECC 1-bit error. | true: enables generation of a maskable interrupt when the error occurs from Data flash ECC 1-bit error. false: disables generation of a maskable interrupt when the error occurs from Data flash ECC 1-bit error.
          boolean McuEcmErrorNonMaskableInterrupt: set at post-build, origin=Renesas_v1.0.0, default-value=false  # This parameter enables or disables generation of a non-maskable interrupt when the error occurs from Data flash ECC 1-bit error. | true: enables generation of a non-maskable interrupt when the error occurs from Data flash ECC 1-bit error. false: disables generation of a non-maskable interrupt when the error occurs from Data flash ECC 1-bit error.
          boolean McuEcmErrorInternalReset: set at post-build, origin=Renesas_v1.0.0, default-value=false  # This parameter enables or disables generation of an internal reset when the error occurs from Data flash ECC 1-bit error. | true: enables generation of an internal reset when the error occurs from Data flash ECC 1-bit error. false: disables generation of an internal reset when the error occurs from Data flash ECC 1-bit error.
          boolean McuEcmErrorNMIDelayTimer: set at post-build, origin=Renesas_v1.0.0, default-value=false  # This parameter enables or disables delay timer start caused by non-maskable interrupts in response to errors from Data flash ECC 1-bit error. | true: enables delay timer start caused by non-maskable interrupts in response to errors from Data flash ECC 1-bit error. false: disables delay timer start caused by non-maskable interrupts in response to errors from Data flash ECC 1-bit error.
          boolean McuEcmErrorMIDelayTimer: set at post-build, origin=Renesas_v1.0.0, default-value=false  # This parameter enables or disables delay timer start caused by maskable interrupts in response to errors from Data flash ECC 1-bit error. | true: enables delay timer start caused by maskable interrupts in response to errors from Data flash ECC 1-bit error. false: disables delay timer start caused by maskable interrupts in response to errors from Data flash ECC 1-bit error.
          boolean McuEcmErrorOutputMask: set at post-build, origin=Renesas_v1.0.0, default-value=true  # This parameter mask or unmask the individual error sources of the error pin output from Data flash ECC 1-bit error. | true: mask the individual error sources of the error pin output from Data flash ECC 1-bit error. false: unmask the individual error sources of the error pin output from Data flash ECC 1-bit error.
          function name McuMiNotification [0..1]: set at post-build, origin=Renesas_v1.0.0, default-value=NULL_PTR, regular-expression=[a-zA-Z][a-zA-Z0-9_]*  # This parameter contains notification function for MI notification. | The syntax for McuMiNotification should be provided as Mcu_EcmMINotification.
          function name McuNmiNotification [0..1]: set at post-build, origin=Renesas_v1.0.0, default-value=NULL_PTR, regular-expression=[a-zA-Z][a-zA-Z0-9_]*  # This parameter contains notification function for NMI notification. | The syntax for McuNmiNotification should be provided as Mcu_EcmNMINotification.
          function name McuEcmInitialNotification [0..1]: set at post-build, origin=Renesas_v1.0.2, default-value=NULL_PTR, regular-expression=[a-zA-Z][a-zA-Z0-9_]*  # This parameter is used for notify the upper layer, if any ECM error has been already detected at system start-up. | The syntax for McuEcmInitialNotification should be provided as Mcu_EcmInitialNotification.
        container McuEcmErrorSource38  # This container contains all the supported configuration parameters of the related error source from DTS RAM ECC 1-bit error.
          boolean McuEcmErrorMaskableInterrupt: set at post-build, origin=Renesas_v1.0.0, default-value=false  # This parameter enables or disables generation of a maskable interrupt when the error occurs from DTS RAM ECC 1-bit error. | true: enables generation of a maskable interrupt when the error occurs from DTS RAM ECC 1-bit error. false: disables generation of a maskable interrupt when the error occurs from DTS RAM ECC 1-bit error.
          boolean McuEcmErrorNonMaskableInterrupt: set at post-build, origin=Renesas_v1.0.0, default-value=false  # This parameter enables or disables generation of a non-maskable interrupt when the error occurs from DTS RAM ECC 1-bit error. | true: enables generation of a non-maskable interrupt when the error occurs from DTS RAM ECC 1-bit error. false: disables generation of a non-maskable interrupt when the error occurs from DTS RAM ECC 1-bit error.
          boolean McuEcmErrorInternalReset: set at post-build, origin=Renesas_v1.0.0, default-value=false  # This parameter enables or disables generation of an internal reset when the error occurs from DTS RAM ECC 1-bit error. | true: enables generation of an internal reset when the error occurs from DTS RAM ECC 1-bit error. false: disables generation of an internal reset when the error occurs from DTS RAM ECC 1-bit error.
          boolean McuEcmErrorNMIDelayTimer: set at post-build, origin=Renesas_v1.0.0, default-value=false  # This parameter enables or disables delay timer start caused by non-maskable interrupts in response to errors from DTS RAM ECC 1-bit error. | true: enables delay timer start caused by non-maskable interrupts in response to errors from DTS RAM ECC 1-bit error. false: disables delay timer start caused by non-maskable interrupts in response to errors from DTS RAM ECC 1-bit error.
          boolean McuEcmErrorMIDelayTimer: set at post-build, origin=Renesas_v1.0.0, default-value=false  # This parameter enables or disables delay timer start caused by maskable interrupts in response to errors from DTS RAM ECC 1-bit error. | true: enables delay timer start caused by maskable interrupts in response to errors from DTS RAM ECC 1-bit error. false: disables delay timer start caused by maskable interrupts in response to errors from DTS RAM ECC 1-bit error.
          boolean McuEcmErrorOutputMask: set at post-build, origin=Renesas_v1.0.0, default-value=true  # This parameter mask or unmask the individual error sources of the error pin output from DTS RAM ECC 1-bit error. | true: mask the individual error sources of the error pin output from DTS RAM ECC 1-bit error. false: unmask the individual error sources of the error pin output from DTS RAM ECC 1-bit error.
          function name McuMiNotification [0..1]: set at post-build, origin=Renesas_v1.0.0, default-value=NULL_PTR, regular-expression=[a-zA-Z][a-zA-Z0-9_]*  # This parameter contains notification function for MI notification. | The syntax for McuMiNotification should be provided as Mcu_EcmMINotification.
          function name McuNmiNotification [0..1]: set at post-build, origin=Renesas_v1.0.0, default-value=NULL_PTR, regular-expression=[a-zA-Z][a-zA-Z0-9_]*  # This parameter contains notification function for NMI notification. | The syntax for McuNmiNotification should be provided as Mcu_EcmNMINotification.
          function name McuEcmInitialNotification [0..1]: set at post-build, origin=Renesas_v1.0.2, default-value=NULL_PTR, regular-expression=[a-zA-Z][a-zA-Z0-9_]*  # This parameter is used for notify the upper layer, if any ECM error has been already detected at system start-up. | The syntax for McuEcmInitialNotification should be provided as Mcu_EcmInitialNotification.
        container McuEcmErrorSource39  # This container contains all the supported configuration parameters of the related error source from All peripheral functions RAM ECC 1-bit error.
          boolean McuEcmErrorMaskableInterrupt: set at post-build, origin=Renesas_v1.0.0, default-value=false  # This parameter enables or disables generation of a maskable interrupt when the error occurs from All peripheral functions RAM ECC 1-bit error. | true: enables generation of a maskable interrupt when the error occurs from All peripheral functions RAM ECC 1-bit error. false: disables generation of a maskable interrupt when the error occurs from All peripheral functions RAM ECC 1-bit error.
          boolean McuEcmErrorNonMaskableInterrupt: set at post-build, origin=Renesas_v1.0.0, default-value=false  # This parameter enables or disables generation of a non-maskable interrupt when the error occurs from All peripheral functions RAM ECC 1-bit error. | true: enables generation of a non-maskable interrupt when the error occurs from All peripheral functions RAM ECC 1-bit error. false: disables generation of a non-maskable interrupt when the error occurs from All peripheral functions RAM ECC 1-bit error.
          boolean McuEcmErrorInternalReset: set at post-build, origin=Renesas_v1.0.0, default-value=false  # This parameter enables or disables generation of an internal reset when the error occurs from All peripheral functions RAM ECC 1-bit error. | true: enables generation of an internal reset when the error occurs from All peripheral functions RAM ECC 1-bit error. false: disables generation of an internal reset when the error occurs from All peripheral functions RAM ECC 1-bit error.
          boolean McuEcmErrorNMIDelayTimer: set at post-build, origin=Renesas_v1.0.0, default-value=false  # This parameter enables or disables delay timer start caused by non-maskable interrupts in response to errors from All peripheral functions RAM ECC 1-bit error. | true: enables delay timer start caused by non-maskable interrupts in response to errors from All peripheral functions RAM ECC 1-bit error. false: disables delay timer start caused by non-maskable interrupts in response to errors from All peripheral functions RAM ECC 1-bit error.
          boolean McuEcmErrorMIDelayTimer: set at post-build, origin=Renesas_v1.0.0, default-value=false  # This parameter enables or disables delay timer start caused by maskable interrupts in response to errors from All peripheral functions RAM ECC 1-bit error. | true: enables delay timer start caused by maskable interrupts in response to errors from All peripheral functions RAM ECC 1-bit error. false: disables delay timer start caused by maskable interrupts in response to errors from All peripheral functions RAM ECC 1-bit error.
          boolean McuEcmErrorOutputMask: set at post-build, origin=Renesas_v1.0.0, default-value=true  # This parameter mask or unmask the individual error sources of the error pin output from All peripheral functions RAM ECC 1-bit error. | true: mask the individual error sources of the error pin output from All peripheral functions RAM ECC 1-bit error. false: unmask the individual error sources of the error pin output from All peripheral functions RAM ECC 1-bit error.
          function name McuMiNotification [0..1]: set at post-build, origin=Renesas_v1.0.0, default-value=NULL_PTR, regular-expression=[a-zA-Z][a-zA-Z0-9_]*  # This parameter contains notification function for MI notification. | The syntax for McuMiNotification should be provided as Mcu_EcmMINotification.
          function name McuNmiNotification [0..1]: set at post-build, origin=Renesas_v1.0.0, default-value=NULL_PTR, regular-expression=[a-zA-Z][a-zA-Z0-9_]*  # This parameter contains notification function for NMI notification. | The syntax for McuNmiNotification should be provided as Mcu_EcmNMINotification.
          function name McuEcmInitialNotification [0..1]: set at post-build, origin=Renesas_v1.0.2, default-value=NULL_PTR, regular-expression=[a-zA-Z][a-zA-Z0-9_]*  # This parameter is used for notify the upper layer, if any ECM error has been already detected at system start-up. | The syntax for McuEcmInitialNotification should be provided as Mcu_EcmInitialNotification.
        container McuEcmErrorSource40  # This container contains all the supported configuration parameters of the related error source from BIST code ECC 1-bit error.
          boolean McuEcmErrorMaskableInterrupt: set at post-build, origin=Renesas_v1.0.0, default-value=false  # This parameter enables or disables generation of a maskable interrupt when the error occurs from BIST code ECC 1-bit error. | true: enables generation of a maskable interrupt when the error occurs from BIST code ECC 1-bit error. false: disables generation of a maskable interrupt when the error occurs from BIST code ECC 1-bit error.
          boolean McuEcmErrorNonMaskableInterrupt: set at post-build, origin=Renesas_v1.0.0, default-value=false  # This parameter enables or disables generation of a non-maskable interrupt when the error occurs from BIST code ECC 1-bit error. | true: enables generation of a non-maskable interrupt when the error occurs from BIST code ECC 1-bit error. false: disables generation of a non-maskable interrupt when the error occurs from BIST code ECC 1-bit error.
          boolean McuEcmErrorInternalReset: set at post-build, origin=Renesas_v1.0.0, default-value=false  # This parameter enables or disables generation of an internal reset when the error occurs from BIST code ECC 1-bit error. | true: enables generation of an internal reset when the error occurs from BIST code ECC 1-bit error. false: disables generation of an internal reset when the error occurs from BIST code ECC 1-bit error.
          boolean McuEcmErrorNMIDelayTimer: set at post-build, origin=Renesas_v1.0.0, default-value=false  # This parameter enables or disables delay timer start caused by non-maskable interrupts in response to errors from BIST code ECC 1-bit error. | true: enables delay timer start caused by non-maskable interrupts in response to errors from BIST code ECC 1-bit error. false: disables delay timer start caused by non-maskable interrupts in response to errors from BIST code ECC 1-bit error.
          boolean McuEcmErrorMIDelayTimer: set at post-build, origin=Renesas_v1.0.0, default-value=false  # This parameter enables or disables delay timer start caused by maskable interrupts in response to errors from BIST code ECC 1-bit error. | true: enables delay timer start caused by maskable interrupts in response to errors from BIST code ECC 1-bit error. false: disables delay timer start caused by maskable interrupts in response to errors from BIST code ECC 1-bit error.
          boolean McuEcmErrorOutputMask: set at post-build, origin=Renesas_v1.0.0, default-value=true  # This parameter mask or unmask the individual error sources of the error pin output from BIST code ECC 1-bit error. | true: mask the individual error sources of the error pin output from BIST code ECC 1-bit error. false: unmask the individual error sources of the error pin output from BIST code ECC 1-bit error.
          function name McuMiNotification [0..1]: set at post-build, origin=Renesas_v1.0.0, default-value=NULL_PTR, regular-expression=[a-zA-Z][a-zA-Z0-9_]*  # This parameter contains notification function for MI notification. | The syntax for McuMiNotification should be provided as Mcu_EcmMINotification.
          function name McuNmiNotification [0..1]: set at post-build, origin=Renesas_v1.0.0, default-value=NULL_PTR, regular-expression=[a-zA-Z][a-zA-Z0-9_]*  # This parameter contains notification function for NMI notification. | The syntax for McuNmiNotification should be provided as Mcu_EcmNMINotification.
          function name McuEcmInitialNotification [0..1]: set at post-build, origin=Renesas_v1.0.2, default-value=NULL_PTR, regular-expression=[a-zA-Z][a-zA-Z0-9_]*  # This parameter is used for notify the upper layer, if any ECM error has been already detected at system start-up. | The syntax for McuEcmInitialNotification should be provided as Mcu_EcmInitialNotification.
        container McuEcmErrorSource41  # This container contains all the supported configuration parameters of the related error source from BIST code ECC 2-bit error.
          boolean McuEcmErrorMaskableInterrupt: set at post-build, origin=Renesas_v1.0.0, default-value=false  # This parameter enables or disables generation of a maskable interrupt when the error occurs from BIST code ECC 2-bit error. | true: enables generation of a maskable interrupt when the error occurs from BIST code ECC 2-bit error. false: disables generation of a maskable interrupt when the error occurs from BIST code ECC 2-bit error.
          boolean McuEcmErrorNonMaskableInterrupt: set at post-build, origin=Renesas_v1.0.0, default-value=false  # This parameter enables or disables generation of a non-maskable interrupt when the error occurs from BIST code ECC 2-bit error. | true: enables generation of a non-maskable interrupt when the error occurs from BIST code ECC 2-bit error. false: disables generation of a non-maskable interrupt when the error occurs from BIST code ECC 2-bit error.
          boolean McuEcmErrorInternalReset: set at post-build, origin=Renesas_v1.0.0, default-value=false  # This parameter enables or disables generation of an internal reset when the error occurs from BIST code ECC 2-bit error. | true: enables generation of an internal reset when the error occurs from BIST code ECC 2-bit error. false: disables generation of an internal reset when the error occurs from BIST code ECC 2-bit error.
          boolean McuEcmErrorNMIDelayTimer: set at post-build, origin=Renesas_v1.0.0, default-value=false  # This parameter enables or disables delay timer start caused by non-maskable interrupts in response to errors from BIST code ECC 2-bit error. | true: enables delay timer start caused by non-maskable interrupts in response to errors from BIST code ECC 2-bit error. false: disables delay timer start caused by non-maskable interrupts in response to errors from BIST code ECC 2-bit error.
          boolean McuEcmErrorMIDelayTimer: set at post-build, origin=Renesas_v1.0.0, default-value=false  # This parameter enables or disables delay timer start caused by maskable interrupts in response to errors from BIST code ECC 2-bit error. | true: enables delay timer start caused by maskable interrupts in response to errors from BIST code ECC 2-bit error. false: disables delay timer start caused by maskable interrupts in response to errors from BIST code ECC 2-bit error.
          boolean McuEcmErrorOutputMask: set at post-build, origin=Renesas_v1.0.0, default-value=true  # This parameter mask or unmask the individual error sources of the error pin output from BIST code ECC 2-bit error. | true: mask the individual error sources of the error pin output from BIST code ECC 2-bit error. false: unmask the individual error sources of the error pin output from BIST code ECC 2-bit error.
          function name McuMiNotification [0..1]: set at post-build, origin=Renesas_v1.0.0, default-value=NULL_PTR, regular-expression=[a-zA-Z][a-zA-Z0-9_]*  # This parameter contains notification function for MI notification. | The syntax for McuMiNotification should be provided as Mcu_EcmMINotification.
          function name McuNmiNotification [0..1]: set at post-build, origin=Renesas_v1.0.0, default-value=NULL_PTR, regular-expression=[a-zA-Z][a-zA-Z0-9_]*  # This parameter contains notification function for NMI notification. | The syntax for McuNmiNotification should be provided as Mcu_EcmNMINotification.
          function name McuEcmInitialNotification [0..1]: set at post-build, origin=Renesas_v1.0.2, default-value=NULL_PTR, regular-expression=[a-zA-Z][a-zA-Z0-9_]*  # This parameter is used for notify the upper layer, if any ECM error has been already detected at system start-up. | The syntax for McuEcmInitialNotification should be provided as Mcu_EcmInitialNotification.
        container McuEcmErrorSource42  # This container contains all the supported configuration parameters of the related error source from FACI reset transfer error.
          boolean McuEcmErrorMaskableInterrupt: set at post-build, origin=Renesas_v1.0.0, default-value=false  # This parameter enables or disables generation of a maskable interrupt when the error occurs from FACI reset transfer error. | true: enables generation of a maskable interrupt when the error occurs from FACI reset transfer error. false: disables generation of a maskable interrupt when the error occurs from FACI reset transfer error.
          boolean McuEcmErrorNonMaskableInterrupt: set at post-build, origin=Renesas_v1.0.0, default-value=false  # This parameter enables or disables generation of a non-maskable interrupt when the error occurs from FACI reset transfer error. | true: enables generation of a non-maskable interrupt when the error occurs from FACI reset transfer error. false: disables generation of a non-maskable interrupt when the error occurs from FACI reset transfer error.
          boolean McuEcmErrorInternalReset: set at post-build, origin=Renesas_v1.0.0, default-value=false  # This parameter enables or disables generation of an internal reset when the error occurs from FACI reset transfer error. | true: enables generation of an internal reset when the error occurs from FACI reset transfer error. false: disables generation of an internal reset when the error occurs from FACI reset transfer error.
          boolean McuEcmErrorNMIDelayTimer: set at post-build, origin=Renesas_v1.0.0, default-value=false  # This parameter enables or disables delay timer start caused by non-maskable interrupts in response to errors from FACI reset transfer error. | true: enables delay timer start caused by non-maskable interrupts in response to errors from FACI reset transfer error. false: disables delay timer start caused by non-maskable interrupts in response to errors from FACI reset transfer error.
          boolean McuEcmErrorMIDelayTimer: set at post-build, origin=Renesas_v1.0.0, default-value=false  # This parameter enables or disables delay timer start caused by maskable interrupts in response to errors from FACI reset transfer error. | true: enables delay timer start caused by maskable interrupts in response to errors from FACI reset transfer error. false: disables delay timer start caused by maskable interrupts in response to errors from FACI reset transfer error.
          boolean McuEcmErrorOutputMask: set at post-build, origin=Renesas_v1.0.0, default-value=true  # This parameter mask or unmask the individual error sources of the error pin output from FACI reset transfer error. | true: mask the individual error sources of the error pin output from FACI reset transfer error. false: unmask the individual error sources of the error pin output from FACI reset transfer error.
          function name McuMiNotification [0..1]: set at post-build, origin=Renesas_v1.0.0, default-value=NULL_PTR, regular-expression=[a-zA-Z][a-zA-Z0-9_]*  # This parameter contains notification function for MI notification. | The syntax for McuMiNotification should be provided as Mcu_EcmMINotification.
          function name McuNmiNotification [0..1]: set at post-build, origin=Renesas_v1.0.0, default-value=NULL_PTR, regular-expression=[a-zA-Z][a-zA-Z0-9_]*  # This parameter contains notification function for NMI notification. | The syntax for McuNmiNotification should be provided as Mcu_EcmNMINotification.
          function name McuEcmInitialNotification [0..1]: set at post-build, origin=Renesas_v1.0.2, default-value=NULL_PTR, regular-expression=[a-zA-Z][a-zA-Z0-9_]*  # This parameter is used for notify the upper layer, if any ECM error has been already detected at system start-up. | The syntax for McuEcmInitialNotification should be provided as Mcu_EcmInitialNotification.
        container McuEcmErrorSource129  # This container contains all the supported configuration parameters of the related error source for ecm delay timer overflow.
          boolean McuEcmErrorInternalReset: set at post-build, origin=Renesas_v1.0.0, default-value=false  # This parameter enables or disables generation of an internal reset when the ecm delay timer overflow error occurs. | true: enables generation of an internal reset when the ecm delay timer overflow error occurs. false: disables generation of an internal reset when the ecm delay timer overflow error occurs.
          boolean McuEcmErrorOutputMask: set at post-build, origin=Renesas_v1.0.0, default-value=true  # This parameter mask or unmask the individual error sources of the error pin output when the ecm delay timer overflow error occurs. | true: mask the individual error sources of the error pin output when the ecm delay timer overflow error occurs. false: unmask the individual error sources of the error pin output when the ecm delay timer overflow error occurs.
          function name McuEcmInitialNotification [0..1]: set at post-build, origin=Renesas_v1.0.2, default-value=NULL_PTR, regular-expression=[a-zA-Z][a-zA-Z0-9_]*  # This parameter is used for notify the upper layer, if any ECM error has been already detected at system start-up. | The syntax for McuEcmInitialNotification should be provided as Mcu_EcmInitialNotification.
      container McuDemEventParameterRefs  # Container for the references to DemEventParameter elements which shall be invoked using the API Dem_ReportErrorStatus API in case the corresponding error occurs. The EventId is taken from the referenced DemEventParameter's DemEventId value. The standardized errors are provided in the container and can be extended by vendor specific error references.
        symbolic name reference MCU_E_CLOCK_FAILURE: set at pre-compile, destination=DemEventParameter  # Reference to configured DEM event to report "Clock source failure".
        symbolic name reference MCU_E_WRITE_TIMEOUT_FAILURE: set at pre-compile, origin=Renesas_v1.0.0, destination=DemEventParameter  # Reference to configured DEM event to report "write failure".
        symbolic name reference MCU_E_CVM_SELFDIAG_FAILURE [0..1]: set at pre-compile, origin=Renesas_v1.0.0, destination=DemEventParameter  # Reference to configured DEM event to report "CVM self diagnostic failure".
        symbolic name reference MCU_E_CLM_SELFDIAG_FAILURE [0..1]: set at pre-compile, origin=Renesas_v1.0.0, destination=DemEventParameter  # Reference to configured DEM event to report "CLM self diagnostic failure".
        symbolic name reference MCU_E_ECM_SELFDIAG_FAILURE [0..1]: set at pre-compile, origin=Renesas_v1.0.0, destination=DemEventParameter  # Reference to configured DEM event to report "ECM self diagnostic failure".
        symbolic name reference MCU_E_LOCKSTEP_SELFDIAG_FAILURE [0..1]: set at pre-compile, origin=Renesas_v1.1.1, destination=DemEventParameter  # Reference to configured DEM event to report "LockStep self diagnostic failure".
        symbolic name reference MCU_E_RESETCONTROLLER_STARTUP_FAILURE [0..1]: set at pre-compile, origin=Renesas_v1.0.0, destination=DemEventParameter  # Reference to configured DEM event to report "Reset Controller start up failure".
        symbolic name reference MCU_E_INT_INCONSISTENT [0..1]: set at pre-compile, origin=Renesas_v1.0.2, destination=DemEventParameter  # This parameter specifies the reference to the DemEventParameter which shall be issued when interrupt inconsistency is detected.
        symbolic name reference MCU_E_REG_WRITE_VERIFY [0..1]: set at pre-compile, origin=Renesas_v1.0.4, destination=DemEventParameter  # This parameter specifies the reference to the DemEventParameter which shall be issued when register write verification is failed.
      container McuModeSettingConf  # This container contains the configuration (parameters) for the Mode setting of the MCU. Please see MCU035 for more information on the MCU mode settings. This container is not used for implementation.
        enumeration McuModeType: {RUN_MODE}, set at pre-compile, origin=Renesas_v1.0.0, default-value=RUN_MODE  # This parameter contains the power save mode type. The value for this parameter should not be repeated within same configuration set. | RUN_MODE: under power and running.
        integer McuMode: 0..0, set at pre-compile, symbolic-name-value=true, default-value=0  # The parameter represents the MCU Mode settings.
      container McuRamSectorSettingConf [0..255]  # This container contains the configuration (parameters) for the RAM Sector setting. Please see MCU030 for more information on RAM sector settings.
        integer McuRamDefaultValue: 0..255, set at post-build, default-value=255  # This parameter specifies the data to be filled in the memory location while invoking Mcu_InitRamSection.
        integer McuRamSectionBaseAddress: 4273864704..4273995775, set at post-build, default-value=4273864704  # This parameter shall represent the MCU RAM section base address. For LOCAL RAM 128KB having address range 4273864704 to 4273995775.
        integer McuRamSectionSize: 1..131072, set at post-build, default-value=256  # This parameter shall represent the MCU RAM Section size in bytes. For LOCAL RAM 128KB having range 1 to 131072.
        enumeration McuRamTypeSel: {LOCAL_RAM_4273864704_4273995775}, set at post-build, origin=Renesas_v1.0.0, default-value=LOCAL_RAM_4273864704_4273995775  # This parameter contains the RAM selection type. | LOCAL_RAM_4273864704_4273995775: For Local Ram.
