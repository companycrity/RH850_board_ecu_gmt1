AUTOSAR XML (schema 4-0-3)
# COPYRIGHT
# Copyright(c) 2013-2016 Renesas Electronics Corporation
package /Renesas/DriverA
  ecuc definition collection RenesasParameterDefinition_Wdg: module=Wdg
  module definition Wdg: refined-module-def=Wdg, variants post-build  # Configuration of the Wdg (Watchdog driver) module. | This is the external watchdog driver. For internal watchdogs, no port pins / DIO is used.
    container WdgDemEventParameterRefs [0..1]  # Container for the references to DemEventParameter elements which shall be invoked using the API Dem_ReportErrorStatus in case the corresponding error occurs. The EventId is taken from the referenced DemEventParameter's DemEventId value. | The standardized errors are provided in the container and can be extended by vendor-specific error references.
      symbolic name reference WDG_E_DISABLE_REJECTED [0..1]: set at pre-compile, destination=DemEventParameter  # This parameter specifies the reference to the DemEventParameter which shall be issued when the error "Initialization or mode switch failed because it would disable the watchdog" has occurred.
      symbolic name reference WDG_E_MODE_FAILED [0..1]: set at pre-compile, destination=DemEventParameter  # This parameter specifies the reference to the DemEventParameter which shall be issued when the error "Setting a watchdog mode failed (during initialization or mode switch)" has occurred.
      symbolic name reference WDG_E_INT_INCONSISTENT [0..1]: set at pre-compile, origin=Renesas_v1.0.4, destination=DemEventParameter  # Reference to the DemEventParameter which shall be issued when Interrupt consistency error was detected.
      symbolic name reference WDG_E_REG_WRITE_VERIFY [0..1]: set at pre-compile, origin=Renesas_v1.0.4, destination=DemEventParameter  # Reference to the DemEventParameter which shall be issued when a register write-verify failure was detected. If the reference is not configured the error shall not be reported..
    container WdgGeneral  # This container contains all general parameters of the watchdog driver.
      boolean WdgDevErrorDetect: set at pre-compile, default-value=false  # This parameter compile switch to enable / disable development error detection for this module. | true: Development error detection enabled. false: Development error detection disabled.
      boolean WdgDisableAllowed: set at pre-compile, default-value=false  # This parameter compile switch to allow / forbid disabling the watchdog driver during runtime. This parameter is not used for implementation since hardware doesn't support. | true: Disabling the watchdog driver at runtime is allowed. false: Disabling the watchdog driver at runtime is not allowed.
      integer WdgIndex: 0..0, set at pre-compile, symbolic-name-value=true, default-value=0  # Represents the watchdog driver's ID so that it can be referenced by the watchdog interface.
      float WdgInitialTimeout: 0..65.535, set at pre-compile, default-value=0  # The initial timeout (sec) for the trigger condition to be initialized during Init function. It shall be not larger than WdgMaxTimeout.
      float WdgMaxTimeout: 0..65.535, set at pre-compile, default-value=0  # The maximum timeout (sec) to which the watchdog trigger condition can be initialized.
      enumeration WdgRunArea: {RAM, ROM}, set at pre-compile, default-value=RAM  # This parameter Represents the watchdog driver execution area is either from ROM (Flash) or RAM as required with the particular microcontroller.
      function name WdgTriggerLocation: set at pre-compile, default-value=NULL, regular-expression=[a-zA-Z][a-zA-Z0-9_]*  # Location (memory address) of the watchdog trigger routine. This parameter is not used for implementation. Since hardware doesn't support.
      boolean WdgVersionInfoApi: set at pre-compile, default-value=true  # This parameter Compile switch to enable / disable the version information API. | true: API enabled. false: API disabled.
      boolean WdgCriticalSectionProtection: set at pre-compile, origin=Renesas_v1.0.0, default-value=true  # This parameter specifies if the WDG driver CPU load can be reduced by disabling the enter/exit critical section functionality by adding a precompiled configuration parameter to the WDG driver configuration. | true: Enables the critical section functionality for the restricted area. false: Disables the critical section functionality for the restricted area.
      enumeration WdgVaryingActivationCodeMode: {DISABLE, ENABLE}, set at pre-compile, origin=Renesas_v1.0.0, default-value=DISABLE  # This parameter enables / disables Varying Activation Code Mode. | DISABLE: Varying Activation Code Mode is disabled. ENABLE: Varying Activation Code Mode is enabled.
      boolean WdgVersionCheckExternalModules: set at pre-compile, origin=Renesas_v1.0.0, default-value=true  # This parameter Enable / disable AUTOSAR Version check for inter-module dependencies. | true: AUTOSAR Version check for inter-module dependencies is enabled. false: AUTOSAR Version check for inter-module dependencies is disabled.
      enumeration WdgDeviceName: {R7F701304, R7F701305, R7F701310, R7F701311, R7F701312, R7F701313, R7F701314, R7F701315, R7F701318, R7F701319, R7F701320, R7F701321, R7F701322, R7F701323}, set at pre-compile, origin=Renesas_v1.0.0, default-value=R7F701312  # This parameter contains the supported device name to identify the device specific C header file through Translation XML File. | R7F701304, R7F701305, R7F701310, R7F701311, R7F701312, R7F701313, R7F701314, R7F701315, R7F701318, R7F701319, R7F701320, R7F701321, R7F701322 or R7F701323: This value should be child tag of TRANSLATION-FILE-PATH and DEVICE-FILE-PATH tag in Translation XML File.
      boolean WdgInterruptConsistencyCheck: set at pre-compile, origin=Renesas_v1.0.4, default-value=false  # This parameter shall enable/disable the Interrupt consistency check functionality. | TRUE - Interrupt Consistency checks are enabled. FALSE - Interrupt Consistency checks are disabled
      enumeration WdgWriteVerify: {WV_DISABLE, WV_INIT_ONLY, WV_INIT_RUNTIME}, set at pre-compile, origin=Renesas_v1.0.4, default-value=WV_DISABLE  # This parameter enables selection and support of INIT_ONLY or INIT_RUNTIME register read-back functionality of WDG DriverA registers. | WV_INIT_ONLY: Enables read-back functionality on static registers. WV_INIT_RUNTIME: Enables read-back functionality on static and dynamic registers. WV_DISABLED: Disables the register read back functionality for WDG DriverA registers.
      boolean WdgUseWriteVerifyErrorInterface: set at pre-compile, origin=Renesas_v1.0.4, default-value=false  # This parameter specifies whether user can configure error notification interface instead of DEM error for Write-Verify functionality. | true: user can configure error notification interface via WdgWriteVerifyErrorInterface parameter. false: Error notification for Write-Verify functionality shall be handled via DEM error.
      function name WdgWriteVerifyErrorInterface [0..1]: set at post-build, origin=Renesas_v1.0.4, default-value=NULL, regular-expression=[a-zA-Z][a-zA-Z0-9_]*  # This parameter is used to configure the name of the error notification which shall be called with the ApiID and ErrorId when there is a Write Verify error. | It is required only in case WdgUseWriteVerifyErrorInterface is configured as TRUE.
      reference WdgClockRef: set at pre-compile, origin=Renesas_v1.0.0, destination=McuWdtacounterClk  # This parameter specifies assignment of WDTATCKI clock for a WDTA instance 0. | In P1x family, High-speed internal oscillation can be configured for below mentioned modes and these modes can be selected in optional byte register and same clock speed must be configured in MCU module "/Renesas/EcucDefs_Mcu/Mcu0/McuModuleConfiguration0/McuClockSettingConfig0/McuWdtacounterClk0" path. High-speed mode: High-speed internal oscillation: 8 MHz Low-speed mode: High-speed internal oscillation/32: 250 kHz.
    container WdgPublishedInformation  # Container holding all Wdg specific published information parameters.
      enumeration WdgTriggerMode: {WDG_WINDOW}, set at published-information, default-value=WDG_WINDOW  # Watchdog trigger mode (toggle/window/both). | WDG_WINDOW: Watchdog trigger is in window mode.
    container WdgSettingsConfig: multiple-configuration-container=true  # Configuration items for the different watchdog settings, including those for external watchdog hardware. | Note: All post-build parameters are handled via this container.
      enumeration WdgDefaultMode: {WDGIF_FAST_MODE, WDGIF_OFF_MODE, WDGIF_SLOW_MODE}, set at post-build, default-value=WDGIF_SLOW_MODE  # Default mode for watchdog driver initialization. | ImplementationType: WdgIf_ModeType. WDGIF_FAST_MODE: Default watchdog mode is "fast". WDGIF_OFF_MODE: Default watchdog mode is "off". WDGIF_SLOW_MODE: Default watchdog mode is "slow".
      container WdgExternalConfiguration [0..1]  # Configuration items for an external watchdog hardware.This container is not used for implementation
        choice reference WdgExternalContainerRef [0..1]: set at post-build, destination=[DioChannelGroup, SpiSequence]  # Reference to either | - a DioChannelGroup container in case the hardware watchdog is connected via DIO pins - an SpiSequenceConfiguration container in case the watchdog hardware is accessed via SPI
      container WdgSettingsFast  # Hardware dependent settings for the watchdog driver's "fast" mode.
        enumeration WdgClkSettingsFast: set at post-build, origin=Renesas_v1.0.0, default-value=WDGCLK_DIVBY_2POWOF_13  # This parameter contains hardware dependent clock settings for the watchdog driver's "fast" mode. | WDGCLK_DIVBY_2POWOF_9: Clock settings for the Watchdog Driver's "fast" mode is (WDTATCKI/[2^9]). WDGCLK_DIVBY_2POWOF_10: Clock settings for the Watchdog Driver's "fast" mode is (WDTATCKI/[2^10]). WDGCLK_DIVBY_2POWOF_11: Clock settings for the Watchdog Driver's "fast" mode is (WDTATCKI/[2^11]). WDGCLK_DIVBY_2POWOF_12: Clock settings for the Watchdog Driver's "fast" mode is (WDTATCKI/[2^12]). WDGCLK_DIVBY_2POWOF_13: Clock settings for the Watchdog Driver's "fast" mode is (WDTATCKI/[2^13]). WDGCLK_DIVBY_2POWOF_14: Clock settings for the Watchdog Driver's "fast" mode is (WDTATCKI/[2^14]). WDGCLK_DIVBY_2POWOF_15: Clock settings for the Watchdog Driver's "fast" mode is (WDTATCKI/[2^15]). WDGCLK_DIVBY_2POWOF_16: Clock settings for the Watchdog Driver's "fast" mode is (WDTATCKI/[2^16]).
          WDGCLK_DIVBY_2POWOF_{9..16}  # WDTATCKI / [2^{9..16}]
      container WdgSettingsOff  # Hardware dependent settings for the watchdog driver's "off" mode.
      container WdgSettingsSlow  # Hardware dependent settings for the watchdog driver's "slow" mode.
        enumeration WdgClkSettingsSlow: set at post-build, origin=Renesas_v1.0.0, default-value=WDGCLK_DIVBY_2POWOF_14  # This parameter contains hardware dependent clock settings for the watchdog driver's "slow" mode. | WDGCLK_DIVBY_2POWOF_9: Clock settings for the Watchdog Driver's "slow" mode is (WDTATCKI/[2^9]). WDGCLK_DIVBY_2POWOF_10: Clock settings for the Watchdog Driver's "slow" mode is (WDTATCKI/[2^10]). WDGCLK_DIVBY_2POWOF_11: Clock settings for the Watchdog Driver's "slow" mode is (WDTATCKI/[2^11]). WDGCLK_DIVBY_2POWOF_12: Clock settings for the Watchdog Driver's "slow" mode is (WDTATCKI/[2^12]). WDGCLK_DIVBY_2POWOF_13: Clock settings for the Watchdog Driver's "slow" mode is (WDTATCKI/[2^13]). WDGCLK_DIVBY_2POWOF_14: Clock settings for the Watchdog Driver's "slow" mode is (WDTATCKI/[2^14]). WDGCLK_DIVBY_2POWOF_15: Clock settings for the Watchdog Driver's "slow" mode is (WDTATCKI/[2^15]). WDGCLK_DIVBY_2POWOF_16: Clock settings for the Watchdog Driver's "slow" mode is (WDTATCKI/[2^16]).
          WDGCLK_DIVBY_2POWOF_{9..16}  # WDTATCKI / [2^{9..16}]
