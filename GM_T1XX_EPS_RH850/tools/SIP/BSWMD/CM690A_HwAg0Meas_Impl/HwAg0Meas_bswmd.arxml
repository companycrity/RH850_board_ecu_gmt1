AUTOSAR XML (schema 4-0-3)
package /Nexteer
  module definition HwAg0Meas [0..1]: variants pre-compile  # Configuration of the HwAg0Meas.
    container HwAg0MeasGeneral  # This container contains the configuration (parameters) of the HwAg0Meas.
      enumeration NTC_HwAg0MfgFlt: {NTCNR_0X1F9, NTCNR_0X1FA}, set at pre-compile, origin=Nexteer, default-value=NTCNR_0X1F9  # .
      enumeration NTC_HwAg0IfFlt: {NTCNR_0X093, NTCNR_0X094, NTCNR_0X095, NTCNR_0X096, NTCNR_0X097, NTCNR_0X098, NTCNR_0X099, NTCNR_0X09A}, set at pre-compile, origin=Nexteer, default-value=NTCNR_0X094  # .
      enumeration NTC_HwAg0Snsr0PrtclFlt: {NTCNR_0X093, NTCNR_0X094, NTCNR_0X095, NTCNR_0X096, NTCNR_0X097, NTCNR_0X098, NTCNR_0X099, NTCNR_0X09A}, set at pre-compile, origin=Nexteer, default-value=NTCNR_0X093  # .
      enumeration NTC_HwAg0Snsr1PrtclFlt: {NTCNR_0X093, NTCNR_0X094, NTCNR_0X095, NTCNR_0X096, NTCNR_0X097, NTCNR_0X098, NTCNR_0X099, NTCNR_0X09A}, set at pre-compile, origin=Nexteer, default-value=NTCNR_0X095  # .
