AUTOSAR XML (schema 4-0-3)
package /TTTECH
  module definition WdgM [0..1]: refined-module-def=WdgM, variants post-build/pre-compile  # Configuration of the WdgM (Watchdog Manager) module.
    container WdgMConfigSet: multiple-configuration-container=true  # This container describes one of multiple configuration sets of WdgM. | This is a MultipleConfigurationContainer, i.e. this container and its sub-containers exist once per configuration set.
      symbolic name reference WdgMInitialMode: set at post-build in variant post-build / pre-compile in variant pre-compile, destination=WdgMMode  # The mode that the Watchdog Manager is in after it has been initialized.
      container WdgMDemEventParameterRefs [0..1]  # Container for the references to DemEventParameter elements which shall be invoked using the API Dem_ReportErrorStatus API in case the corresponding error occurs. The EventId is taken from the referenced DemEventParameter's DemEventId value. The standardized errors are provided in the container and can be extended by vendor specific error references.
        symbolic name reference WDGM_E_IMPROPER_CALLER [0..1]: set at post-build in variant post-build / pre-compile in variant pre-compile, destination=DemEventParameter  # Reference to the DemEventParameter which shall be issued when the defensive behavior checks have detected an improper caller.
        symbolic name reference WDGM_E_MONITORING [0..1]: set at post-build in variant post-build / pre-compile in variant pre-compile, destination=DemEventParameter  # Reference to the DemEventParameter which shall be issued when the error "Monitoring has failed and a watchdog reset will occur" has occured.
        symbolic name reference WDGM_E_SET_MODE [0..1]: set at post-build in variant post-build / pre-compile in variant pre-compile, destination=DemEventParameter  # Reference to the DemEventParameter which shall be issued when the error "Watchdog drivers' mode switch has failed" has occured.
      container WdgMMode [1..255]  # The container describes one of several modes of the Watchdog Manager.
        integer WdgMExpiredSupervisionCycleTol: 0..65535, set at post-build in variant post-build / pre-compile in variant pre-compile, default-value=0  # This parameter shall be used to define a value that fixes the amount of expired supervision cycles for how long the blocking of watchdog triggering shall be postponed, AFTER THE GLOBAL SUPERVISION STATUS HAS REACHED THE STATE EXPIRED.
        integer WdgMModeId: 0..255, set at post-build in variant post-build / pre-compile in variant pre-compile, symbolic-name-value=true, default-value=0  # This parameter fixes the identfier for the mode. This identifier is for instance passed as a parameter to the WdgM_SetMode service.
        float WdgMTicksPerSecond: 1.., set at pre-compile, origin=TTTECH  # This parameter defines the number of Watchdog Manager ticks per second.
        float WdgMSupervisionCycle: 0..Inf, set at post-build in variant post-build / pre-compile in variant pre-compile  # This parameter defines the schedule period of the main function WdgM_MainFunction. | Unit: [s]
        integer WdgMInitialTriggerModeId: 0..255, set at pre-compile, origin=TTTECH, symbolic-name-value=true, default-value=0  # Denotes the ID of the Trigger Mode which shall be used at system start.
        container WdgMAliveSupervision [0..65535]  # This container collects all configuration parameters of Alive-Supervision of one Checkpoint. Note that each Checkpoint may have different parameters. For example, it may have different min and max margin.
          integer WdgMExpectedAliveIndications: 0..65535, set at post-build in variant post-build / pre-compile in variant pre-compile, default-value=0  # This parameter contains the amount of expected alive indications of the Checkpoint within the referenced amount of defined supervision cycles according to corresponding SE.
          integer WdgMMaxMargin: 0..255, set at post-build in variant post-build / pre-compile in variant pre-compile, default-value=0  # This parameter contains the amount of alive indications of the Checkpoint that are acceptable to be additional to the expected alive indications within the corresponding supervision reference cycle.
          integer WdgMMinMargin: 0..255, set at post-build in variant post-build / pre-compile in variant pre-compile, default-value=0  # This parameter contains the amount of alive indications of the Checkpoint that are acceptable to be missed from the expected alive indications within the corresponding supervision reference cycle.
          integer WdgMSupervisionReferenceCycle: 1..65535, set at post-build in variant post-build / pre-compile in variant pre-compile, default-value=1  # This parameter shall contain the amount of supervision cycles to be used as reference by the alive-supervision mechanism to perform the checkup with counted alive indications according to corresponding SE.
          symbolic name reference WdgMAliveSupervisionCheckpointRef: set at post-build in variant post-build / pre-compile in variant pre-compile, destination=WdgMCheckpoint  # Reference to Checkpoint within a Supervised Entity that shall be supervised.
        container WdgMDeadlineSupervision [0..65535]  # This container collects all configuration parameters for Deadline Supervision for a Supervised Entity.
          float WdgMDeadlineMax: 0..Inf, set at post-build in variant post-build / pre-compile in variant pre-compile, default-value=0.0  # This parameter contains the longest time span after which the deadline is considered to be met. | Unit: [s]
          float WdgMDeadlineMin: 0..Inf, set at post-build in variant post-build / pre-compile in variant pre-compile, default-value=0.0  # This parameter contains the shortest time span after which the deadline is considered to be met. | Unit: [s]
          symbolic name reference WdgMDeadlineStartRef: set at post-build in variant post-build / pre-compile in variant pre-compile, destination=WdgMCheckpoint  # This is the reference to the start Checkpoint for Deadline Supervision.
          symbolic name reference WdgMDeadlineStopRef: set at post-build in variant post-build / pre-compile in variant pre-compile, destination=WdgMCheckpoint  # This is the reference to the stop Checkpoint for Deadline Supervision.
        container WdgMExternalLogicalSupervision [0..65535]  # This container collects all configuration parameters for Logical Supervision for one external graph.
          symbolic name reference WdgMExternalCheckpointFinalRef [1..65535]: set at pre-compile, destination=WdgMCheckpoint  # This is the reference to the final Checkpoint(s) for this External Graph.
          symbolic name reference WdgMExternalCheckpointInitialRef [1..65535]: set at pre-compile, destination=WdgMCheckpoint  # This is the reference to the initial Checkpoint(s) for this External Graph.
          container WdgMExternalTransition [0..65535]  # This container collects the Checkpoints for an External Transition across Supervised Entities.
            symbolic name reference WdgMExternalTransitionDestRef: set at post-build in variant post-build / pre-compile in variant pre-compile, destination=WdgMCheckpoint  # This is the reference to the destination Checkpoint of an External Transition.
            symbolic name reference WdgMExternalTransitionSourceRef: set at post-build in variant post-build / pre-compile in variant pre-compile, destination=WdgMCheckpoint  # This is the reference to the source Checkpoint of an External Transition.
        container WdgMLocalStatusParams [0..65535]  # This container collects all configuration parameters for the Local Status of a Supervised Entity.
          integer WdgMFailedAliveSupervisionRefCycleTol: 0..255, set at post-build in variant post-build / pre-compile in variant pre-compile, default-value=0  # This parameter shall contain the acceptable amount of reference cycles with incorrect/failed alive supervisions for this Supervised Entity.
          enumeration WdgMSupervisedEntityInitialMode: {WDGM_LOCAL_STATUS_DEACTIVATED, WDGM_LOCAL_STATUS_OK, WDGM_LOCAL_STATUS_STATUS_FAILED}, set at pre-compile, origin=TTTECH, default-value=WDGM_LOCAL_STATUS_OK  # Initial local monitoring status of the supervised entity.
          integer WdgMFailedDeadlineRefCycleTol [0..1]: 0..65535, set at pre-compile, origin=TTTECH, default-value=0  # This parameter contains the acceptable amount of violated deadlines for this Supervised Entity.
          integer WdgMDeadlineReferenceCycle [0..1]: 0..65535, set at pre-compile, origin=TTTECH, default-value=0  # This parameter contains the amount of supervision cycles to be used as reference by the deadline supervisions of this SE.
          integer WdgMFailedProgramFlowRefCycleTol [0..1]: 0..65535, set at pre-compile, origin=TTTECH, default-value=0  # This parameter contains the acceptable amount of program flow violations for this Supervised Entity.
          integer WdgMProgramFlowReferenceCycle [0..1]: 0..65535, set at pre-compile, origin=TTTECH, default-value=0  # This parameter contains the amount of supervision cycles to be used as reference by the program flow supervisions of this SE.
          symbolic name reference WdgMLocalStatusSupervisedEntityRef: set at post-build in variant post-build / pre-compile in variant pre-compile, destination=WdgMSupervisedEntity  # This is the reference to the Supervised Entity for which the Local Status parameters are specified.
        container WdgMTrigger [0..255]  # This container collects all configuration parameters for the triggering of hardware watchdogs.
          integer WdgMTriggerConditionValue: 1..65535, set at pre-compile, default-value=1  # This parameter defines the maximum possible window time where the watchdog trigger is accepted (window end). The consumer of this parameter is the WdgIf_UpdateTriggerCondition for this watchdog. Unit: [ms]
          enumeration WdgMWatchdogMode: {WDGIF_FAST_MODE, WDGIF_OFF_MODE, WDGIF_SLOW_MODE}, set at post-build in variant post-build / pre-compile in variant pre-compile  # This parameter contains the watchdog mode that shall be used for the referenced watchdog in this Watchdog Manager mode. | Implementation Type: WdgIf_ModeType
          integer WdgMTriggerWindowStart: 0..65535, set at pre-compile, origin=TTTECH  # This parameter defines the minimum window time after which a watchdog triggering is allowed (window start). The consumer of this parameter is the WdgIf_UpdateTriggerCondition for this watchdog. Unit: [ms]
          integer WdgMTriggerModeId: 0..254, set at pre-compile, origin=TTTECH, default-value=0  # This parameter contains a unique identifier of the trigger mode.
          symbolic name reference WdgMTriggerWatchdogRef: set at post-build in variant post-build / pre-compile in variant pre-compile, destination=WdgMWatchdog  # This parameter is a reference to the configured watchdog.
    container WdgMGeneral  # Container defines all general configuration parameters of the Watchdog Manager.
      boolean WdgMDefensiveBehavior: set at pre-compile, default-value=false  # Preprocessor switch to enable/disable the defensive behavior of the Watchdog Manager module.
      boolean WdgMUseRte: set at pre-compile, origin=TTTECH, default-value=false  # This preprocessor switch instructs the Watchdog Manager to use the by Rte generated defines and typedefs. true: the S-WdgM uses the by Rte generated defines and typedefs false: the S-WdgM uses own defines and typedefs
      boolean WdgMDemSupervisionReport: set at pre-compile, origin=TTTECH  # Preprocessor switch to enable / disable call to DEM in case the Safe Watchdog Manager has the WDGM_GLOBAL_STATE_STOPPED reached. True: The DEM call is enabled False: The DEM call is disabled
      boolean WdgMFirstCycleAliveCounterReset: set at pre-compile, origin=TTTECH, default-value=false  # When this preprocessor switch is enabled, then the Alive counters in the first Supervision cycle are not evaluated
      boolean WdgMUseOsSuspendInterrupt: set at pre-compile, origin=TTTECH  # This preprocessor switch enables/disables the usage of OS suspend and resume interrupt services within WdgM.
      enumeration WdgMTimebaseSource: {WDGM_INTERNAL_SOFTWARE_TICK, WDGM_INTERNAL_HARDWARE_TICK, WDGM_EXTERNAL_TICK}, set at pre-compile, origin=TTTECH, default-value=WDGM_INTERNAL_SOFTWARE_TICK  # This parameter selects the Tick counter source for Deadline monitoring. WDGM_INTERNAL_SOFTWARE_TICK: The counter is incremented each time `WdgM_MainFunction` is called. WDGM_INTERNAL_HARDWARE_TICK: The counter is based on the microcontroller's hardware counter. WDGM_EXTERNAL_TICK: The counter is incremented each time `WdgM_UpdateTickCount` is called.
      boolean WdgMSecondResetPath: set at pre-compile, origin=TTTECH  # This preprocessor switch generally enables the access to the external Mcu_ImmediateReset() function. This function is used as second reset path a specially when the primary reset path signals failure.
      boolean WdgMTickOverrunCorrection: set at pre-compile, origin=TTTECH  # This preprocessor switch enables/disables 32 bit timebase counter overflow detection and correction.
      boolean WdgMEntityDeactivationEnabled: set at pre-compile, origin=TTTECH  # This preprocessor switch enables generally entity deactivation. Please see additional important safety information regarding this functionality in the S-WdgM Safety Manual
      function name WdgMGlobalStateChangeCbk [0..1]: set at pre-compile in variant pre-compile / post-build in variant post-build, origin=TTTECH  # Callback function for notifying Watchdog Manager global state change.
      boolean WdgMStateChangeNotification: set at pre-compile, origin=TTTECH  # This preprocessor switch enables local and global state callback notifications for the Watchdog Manager.
      boolean WdgMDemStoppedSupervisionReport: set at pre-compile, default-value=false  # Parameter to enable/disable the error reporting to DEM. | true: A notification to DEM is sent if the Watchdog Manager reaches the state WDGM_GLOBAL_STATUS_STOPPED. false: The notification is disabled.
      boolean WdgMDevErrorDetect: set at pre-compile  # Preprocessor switch to enable/disable development error detection and reporting. | Shall be used to remove unneeded code segments regarding DET features true: Development error detection is enabled false: Development error detection is disabled
      boolean WdgMDemReport: set at pre-compile, origin=TTTECH  # Preprocessor switch to enable / disable calls to DEM in case of production error detection. True: DEM calls enabled in case of production errors False: DEM calls disabled in case of production errors
      boolean WdgMImmediateReset: set at pre-compile  # This parameter enables/disablse the immediate reset feature in case of alive-supervision failure. | true: Immediate reset is enabled false: Immediate reset is disabled
      boolean WdgMOffModeEnabled: set at pre-compile  # This parameter enables/disables the selection of the "OffMode" of the watchdog driver. | true: "OffMode" selection is allowed false: "OffMode" selection is disallowed
      boolean WdgMVersionInfoApi: set at pre-compile  # Preprocessor switch to enable/disable the existence of the API WdgM_GetVersionInfo. Shall be used to remove unneeded code segments. | true: API is enabled false: API is disabled
      choice reference WdgMGlobalMemoryAppTaskRef [0..1]: set at pre-compile, origin=TTTECH, destination=OsApplication  # Reference to an OS Application or Task where the S-WdgM is running. In case of OS SC3 (with memory protection) the global variables of the Watchdog Manager module should be placed in the same memory segment as the application / task in the context of which the Watchdog Manager is running.
      container WdgMCallerIds [0..1]  # Contains the definition of valid CallerIds for the callers who have permission to call the function WdgM_SetMode.
        integer WdgMCallerId [0..255]: 0..65535, set at pre-compile  # This parameter defines one valid CallerId for the callers who have permission to call the function WdgM_SetMode.
      container WdgMSupervisedEntity [0..65535]  # This container collects all common (mode-independent) parameters of a Supervised Entity to be supervised by the Watchdog Manager.
        integer WdgMSupervisedEntityId: 0..65535, set at pre-compile, symbolic-name-value=true  # This parameter shall contain the unique identifier of the supervised entity.
        integer OSApplication [0..1]: 0..255, set at pre-compile, origin=TTTECH, default-value=WDGM_INVALID_OSAPPLICATION  # The ID of the OS Application that this SE is part of. If defined then the OS Application will receive a partition reset signal each time this SE changes its status from OK to FAILED. Enter 255 (== 0xFF) if this supervised entity is not a part of an OS Application.
        boolean WdgMEnableEntityDeactivation: set at pre-compile, origin=TTTECH, default-value=false  # Enables deactivation of this supervised enitiy.
        enumeration WdgMSupportedAutosarAPI: {API_4_0, API_3_1}, set at pre-compile, origin=TTTECH, default-value=API_4_0  # Defines which version of the AUTOSAR API shall be used.
        function name WdgMLocalStateChangeCbk [0..1]: set at pre-compile in variant pre-compile / post-build in variant post-build, origin=TTTECH  # Callback function for notifying this Supervised Entity's state change.
        reference WdgMEcucPartitionRef [0..1]: set at pre-compile, destination=EcucPartition  # Denotes in which "EcucPartition" the supervised entity is executed. When the partition is stopped, the supervised entity shall be de-activated in the WdgM to avoid an ECU reset.
        symbolic name reference WdgMInternalCheckpointInitialRef: set at pre-compile, destination=WdgMCheckpoint  # A reference to the initial internal Checkpoint of this supervised entity.
        symbolic name reference WdgMInternallCheckpointFinalRef [0..65535]: set at pre-compile, destination=WdgMCheckpoint  # A reference to the final local Checkpoint of this supervised entity. Note that there might be several final local checkpoints.
        choice reference WdgMAppTaskRef [0..1]: set at pre-compile, origin=TTTECH, destination=OsApplication  # Reference to an OS Application or Task. In case of OS SC3 the local data of the supervised entity should be placed in the same memory segment as the application / task this supervised entity is part of.
        container WdgMCheckpoint [1..65535]  # This container collects all Checkpoints of this Supervised Entity. Each Supervised Entity has at least one Checkpoint.
          integer WdgMCheckpointId: 0..65535, set at pre-compile, symbolic-name-value=true  # This parameter shall contain the unique identifier of Checkpoint.
        container WdgMInternalTransition [0..65535]  # This container defines the graph of Internal Transitions within this Supervised Entity.
          symbolic name reference WdgMInternalTransitionDestRef: set at pre-compile, destination=WdgMCheckpoint  # This is the reference to the destination Checkpoint of an Internal Transition within this Supervised Entity.
          symbolic name reference WdgMInternalTransitionSourceRef: set at pre-compile, destination=WdgMCheckpoint  # This is the reference to the source Checkpoint of an Internal Transition within this Supervised Entity.
      container WdgMWatchdog [0..255]  # This container collects all common (mode-independent) parameters of a Watchdog to be triggered by the Watchdog Manager.
        string WdgMWatchdogName: set at pre-compile, symbolic-name-value=true  # This parameter shall contain the symbolic name of the watchdog instance.
        symbolic name reference WdgMWatchdogDeviceRef: set at pre-compile, destination=WdgIfDevice  # Reference to one device container of Watchdog Interface. In the referenced container WdgIfDevice, the parameter WdgIfDeviceIndex contains the Index parameter that WdgM has to use for WdgIf_SetTriggerCondition calls for that watchdog instance.
  bsw implementation WdgM_Impl: programming-language=C, sw-version=3.3.3, used-code-generator=TTTech, vendor-id=46, ar-release-version=4.00.03, preconfigured-configuration=WdgM_Pre, recommended-configuration=WdgM_Rec, vendor-specific-module-def=WdgM
  module config WdgM_Pre: definition=WdgM
  module config WdgM_Rec: definition=WdgM_Pre
