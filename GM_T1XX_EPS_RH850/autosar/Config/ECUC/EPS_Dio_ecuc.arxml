AUTOSAR XML (schema 4-0-3)
package /ActiveEcuC
  module config Dio: implementation-config-variant=VARIANT-POST-BUILD-LOADABLE, module-description=Dio_Impl
    DioGeneral:
      DioDevErrorDetect = true
      DioMaskedWritePortApi = false
      DioFlipChannelApi = false
      DioVersionInfoApi = false
      DioVersionCheckExternalModules = false
      DioCriticalSectionProtection = true
      DioDeviceName = R7F701311
      DioWriteVerifyErrorInterface = DioWrVrfyFailr
      DioUseWriteVerifyErrorInterface = true
      DioWriteVerify = WV_INIT_RUNTIME
    DioConfig
      5 x DioPort:
        Port0: DioPortId=0, DioPortName=PORTGROUP_0_BITS_0_TO_14
          3 x DioChannel:
            PwrTurnOffCtrl: DioChannelBitPosition=13, DioChannelId=2
            HwAg0: DioChannelId=1, DioChannelBitPosition=1
            HwTq3: DioChannelId=0, DioChannelBitPosition=2
        Port5: DioPortId=4, DioPortName=PORTGROUP_5_BITS_0_TO_15
          9 x DioChannel:
            McuEna: DioChannelId=1, DioChannelBitPosition=7
            SysFlt2B: DioChannelId=0, DioChannelBitPosition=3
            TmplMonrWdg: DioChannelId=2, DioChannelBitPosition=10
            PwrSplyCs: DioChannelId=7, DioChannelBitPosition=9
            HwAg1: DioChannelId=6, DioChannelBitPosition=12
            HwTq2: DioChannelId=3, DioChannelBitPosition=11
            HwTq1: DioChannelId=4, DioChannelBitPosition=8
            HwTq0: DioChannelId=5, DioChannelBitPosition=5
            PwrSplyNotFlt: DioChannelId=8, DioChannelBitPosition=6
        Port4: DioPortId=3, DioPortName=PORTGROUP_4_BITS_0_TO_14
          MotDrvr1Diag (DioChannel): DioChannelId=0, DioChannelBitPosition=11
        Port3: DioPortId=2, DioPortName=PORTGROUP_3_BITS_0_TO_14
          8 x DioChannel:
            GateDrv0Rst: DioChannelId=6, DioChannelBitPosition=5
            PhaALowrCmd: DioChannelId=1, DioChannelBitPosition=8
            PhaAUpprCmd: DioChannelId=0, DioChannelBitPosition=7
            PhaBLowrCmd: DioChannelId=3, DioChannelBitPosition=10
            PhaBUpprCmd: DioChannelId=2, DioChannelBitPosition=9
            PhaCLowrCmd: DioChannelId=5, DioChannelBitPosition=13
            PhaCUpprCmd: DioChannelId=4, DioChannelBitPosition=12
            PwrOutpEnaFb: DioChannelId=7, DioChannelBitPosition=6
        Port2: DioPortId=1, DioPortName=PORTGROUP_2_BITS_0_TO_15
          3 x DioChannel:
            GateDrv1Rst: DioChannelId=1, DioChannelBitPosition=15
            MotDrvr0Diag: DioChannelId=2, DioChannelBitPosition=2
            SysFlt2A: DioChannelId=0, DioChannelBitPosition=4
    DioDemEventParameterRefs: DIO_E_REG_WRITE_VERIFY=DIO_E_REG_WRITE_VERIFY
