AUTOSAR XML (schema 4-0-3)
package /ActiveEcuC
  module config NxtrMfgSrvIf: implementation-config-variant=VARIANT-PRE-COMPILE
    NxtrMfgSrvIfGeneral: BufSize=825
