AUTOSAR XML (schema 4-0-3)
package /ActiveEcuC
  module config SyncCrc: implementation-config-variant=VARIANT-PRE-COMPILE, module-description=SyncCrc_Impl
    SyncCrcCommon: AvailableCRCHardwareUnits=4, AutosarWrapperEnable=STD_OFF, CrcOsApplicationReference=Appl10
