AUTOSAR XML (schema 4-0-3)
package /ActiveEcuC
  module config Mcu: implementation-config-variant=VARIANT-POST-BUILD-LOADABLE, module-description=Mcu_Impl
    McuModuleConfiguration:
      McuClockSrcFailureNotification = DISABLED
      McuLviDetectionLevel = DETECTION_LEVEL_0
      McuLviResetMask = false
      McuNumberOfMcuModes = 1
      McuRamSectors = 1
      McuCvmOutMaskDiag = false
      McuCvmResetEnable = true
      McuCvmDiagLockBit = true
      McuCvmOutMaskFbist = false
      McuCvmOutputFilter = true
      McuEcmErrorSourcesCfg
        McuEcmErrorSource0:
          McuMiNotification = NULL_PTR
          McuNmiNotification = FeNmiWdg
          McuEcmErrorMaskableInterrupt = false
          McuEcmErrorNonMaskableInterrupt = true
          McuEcmErrorInternalReset = false
          McuEcmErrorNMIDelayTimer = false
          McuEcmErrorMIDelayTimer = false
          McuEcmErrorOutputMask = false
        McuEcmErrorSource1:
          McuMiNotification = NULL_PTR
          McuNmiNotification = NULL_PTR
          McuEcmErrorMaskableInterrupt = false
          McuEcmErrorNonMaskableInterrupt = false
          McuEcmErrorInternalReset = true
          McuEcmErrorNMIDelayTimer = false
          McuEcmErrorMIDelayTimer = false
          McuEcmErrorOutputMask = false
        McuEcmErrorSource4:
          McuNmiNotification = FeNmiClkMonr0RtUpprLimFlt
          McuMiNotification = NULL_PTR
          McuEcmErrorMaskableInterrupt = false
          McuEcmErrorNonMaskableInterrupt = true
          McuEcmErrorInternalReset = false
          McuEcmErrorNMIDelayTimer = false
          McuEcmErrorMIDelayTimer = false
          McuEcmErrorOutputMask = false
        McuEcmErrorSource10:
          McuNmiNotification = FeNmiClkMonr3RtUpprLimFlt
          McuMiNotification = NULL_PTR
          McuEcmErrorMaskableInterrupt = false
          McuEcmErrorNonMaskableInterrupt = true
          McuEcmErrorInternalReset = false
          McuEcmErrorNMIDelayTimer = false
          McuEcmErrorMIDelayTimer = false
          McuEcmErrorOutputMask = false
        McuEcmErrorSource11:
          McuNmiNotification = FeNmiClkMonr3RtLowrLimFlt
          McuMiNotification = NULL_PTR
          McuEcmErrorMaskableInterrupt = false
          McuEcmErrorNonMaskableInterrupt = true
          McuEcmErrorInternalReset = false
          McuEcmErrorNMIDelayTimer = false
          McuEcmErrorMIDelayTimer = false
          McuEcmErrorOutputMask = false
        McuEcmErrorSource12:
          McuNmiNotification = NULL_PTR
          McuMiNotification = NULL_PTR
          McuEcmErrorMaskableInterrupt = false
          McuEcmErrorNonMaskableInterrupt = false
          McuEcmErrorInternalReset = false
          McuEcmErrorNMIDelayTimer = false
          McuEcmErrorMIDelayTimer = false
          McuEcmErrorOutputMask = false
        McuEcmErrorSource14:
          McuNmiNotification = NULL_PTR
          McuMiNotification = NULL_PTR
          McuEcmErrorMaskableInterrupt = false
          McuEcmErrorNonMaskableInterrupt = false
          McuEcmErrorInternalReset = false
          McuEcmErrorNMIDelayTimer = false
          McuEcmErrorMIDelayTimer = false
          McuEcmErrorOutputMask = true
        McuEcmErrorSource15:
          McuNmiNotification = NULL_PTR
          McuMiNotification = NULL_PTR
          McuEcmErrorMaskableInterrupt = false
          McuEcmErrorNonMaskableInterrupt = false
          McuEcmErrorInternalReset = false
          McuEcmErrorNMIDelayTimer = false
          McuEcmErrorMIDelayTimer = false
          McuEcmErrorOutputMask = false
        McuEcmErrorSource16:
          McuNmiNotification = NULL_PTR
          McuMiNotification = NULL_PTR
          McuEcmErrorMaskableInterrupt = false
          McuEcmErrorNonMaskableInterrupt = false
          McuEcmErrorInternalReset = false
          McuEcmErrorNMIDelayTimer = false
          McuEcmErrorMIDelayTimer = false
          McuEcmErrorOutputMask = true
        McuEcmErrorSource17:
          McuNmiNotification = NULL_PTR
          McuMiNotification = NULL_PTR
          McuEcmErrorMaskableInterrupt = false
          McuEcmErrorNonMaskableInterrupt = false
          McuEcmErrorInternalReset = false
          McuEcmErrorNMIDelayTimer = false
          McuEcmErrorMIDelayTimer = false
          McuEcmErrorOutputMask = false
        McuEcmErrorSource18:
          McuNmiNotification = NULL_PTR
          McuMiNotification = NULL_PTR
          McuEcmErrorMaskableInterrupt = false
          McuEcmErrorNonMaskableInterrupt = false
          McuEcmErrorInternalReset = false
          McuEcmErrorNMIDelayTimer = false
          McuEcmErrorMIDelayTimer = false
          McuEcmErrorOutputMask = true
        McuEcmErrorSource19:
          McuNmiNotification = NULL_PTR
          McuMiNotification = NULL_PTR
          McuEcmErrorMaskableInterrupt = false
          McuEcmErrorNonMaskableInterrupt = false
          McuEcmErrorInternalReset = false
          McuEcmErrorNMIDelayTimer = false
          McuEcmErrorMIDelayTimer = false
          McuEcmErrorOutputMask = true
        McuEcmErrorSource20:
          McuNmiNotification = NULL_PTR
          McuMiNotification = NULL_PTR
          McuEcmErrorMaskableInterrupt = false
          McuEcmErrorNonMaskableInterrupt = false
          McuEcmErrorInternalReset = false
          McuEcmErrorNMIDelayTimer = false
          McuEcmErrorMIDelayTimer = false
          McuEcmErrorOutputMask = true
        McuEcmErrorSource21:
          McuNmiNotification = FeNmiOperModErrFlsProgmModStrtd
          McuMiNotification = NULL_PTR
          McuEcmErrorMaskableInterrupt = false
          McuEcmErrorNonMaskableInterrupt = true
          McuEcmErrorInternalReset = false
          McuEcmErrorNMIDelayTimer = false
          McuEcmErrorMIDelayTimer = false
          McuEcmErrorOutputMask = false
        McuEcmErrorSource22:
          McuNmiNotification = FeNmiOperModErrTestModStrtd
          McuMiNotification = NULL_PTR
          McuEcmErrorMaskableInterrupt = false
          McuEcmErrorNonMaskableInterrupt = true
          McuEcmErrorInternalReset = false
          McuEcmErrorNMIDelayTimer = false
          McuEcmErrorMIDelayTimer = false
          McuEcmErrorOutputMask = false
        McuEcmErrorSource23:
          McuNmiNotification = FeNmiOperModErrSngChipInactv
          McuMiNotification = NULL_PTR
          McuEcmErrorMaskableInterrupt = false
          McuEcmErrorNonMaskableInterrupt = true
          McuEcmErrorInternalReset = false
          McuEcmErrorNMIDelayTimer = false
          McuEcmErrorMIDelayTimer = false
          McuEcmErrorOutputMask = false
        McuEcmErrorSource24:
          McuNmiNotification = FeNmiPeg
          McuMiNotification = NULL_PTR
          McuEcmErrorMaskableInterrupt = false
          McuEcmErrorNonMaskableInterrupt = true
          McuEcmErrorInternalReset = false
          McuEcmErrorNMIDelayTimer = false
          McuEcmErrorMIDelayTimer = false
          McuEcmErrorOutputMask = false
        McuEcmErrorSource26:
          McuNmiNotification = NULL_PTR
          McuMiNotification = NULL_PTR
          McuEcmErrorMaskableInterrupt = false
          McuEcmErrorNonMaskableInterrupt = false
          McuEcmErrorInternalReset = false
          McuEcmErrorNMIDelayTimer = false
          McuEcmErrorMIDelayTimer = false
          McuEcmErrorOutputMask = false
        McuEcmErrorSource27:
          McuNmiNotification = NULL_PTR
          McuMiNotification = NULL_PTR
          McuEcmErrorMaskableInterrupt = false
          McuEcmErrorNonMaskableInterrupt = false
          McuEcmErrorInternalReset = false
          McuEcmErrorNMIDelayTimer = false
          McuEcmErrorMIDelayTimer = false
          McuEcmErrorOutputMask = true
        McuEcmErrorSource28:
          McuNmiNotification = NULL_PTR
          McuMiNotification = NULL_PTR
          McuEcmErrorMaskableInterrupt = false
          McuEcmErrorNonMaskableInterrupt = false
          McuEcmErrorInternalReset = false
          McuEcmErrorNMIDelayTimer = false
          McuEcmErrorMIDelayTimer = false
          McuEcmErrorOutputMask = false
        McuEcmErrorSource29:
          McuNmiNotification = FeNmiEcmMstChkrCmp
          McuMiNotification = NULL_PTR
          McuEcmErrorMaskableInterrupt = false
          McuEcmErrorNonMaskableInterrupt = true
          McuEcmErrorInternalReset = false
          McuEcmErrorNMIDelayTimer = false
          McuEcmErrorMIDelayTimer = false
          McuEcmErrorOutputMask = false
        McuEcmErrorSource30:
          McuNmiNotification = NULL_PTR
          McuMiNotification = NULL_PTR
          McuEcmErrorMaskableInterrupt = false
          McuEcmErrorNonMaskableInterrupt = false
          McuEcmErrorInternalReset = false
          McuEcmErrorNMIDelayTimer = false
          McuEcmErrorMIDelayTimer = false
          McuEcmErrorOutputMask = true
        McuEcmErrorSource31:
          McuNmiNotification = NULL_PTR
          McuMiNotification = NULL_PTR
          McuEcmErrorMaskableInterrupt = false
          McuEcmErrorNonMaskableInterrupt = false
          McuEcmErrorInternalReset = false
          McuEcmErrorNMIDelayTimer = false
          McuEcmErrorMIDelayTimer = false
          McuEcmErrorOutputMask = true
        McuEcmErrorSource32:
          McuNmiNotification = FeNmiDmaTrf
          McuMiNotification = NULL_PTR
          McuEcmErrorMaskableInterrupt = false
          McuEcmErrorNonMaskableInterrupt = true
          McuEcmErrorInternalReset = false
          McuEcmErrorNMIDelayTimer = false
          McuEcmErrorMIDelayTimer = false
          McuEcmErrorOutputMask = false
        McuEcmErrorSource33:
          McuNmiNotification = FeNmiDmaRegAcsProtnErr
          McuMiNotification = NULL_PTR
          McuEcmErrorMaskableInterrupt = false
          McuEcmErrorNonMaskableInterrupt = true
          McuEcmErrorInternalReset = false
          McuEcmErrorNMIDelayTimer = false
          McuEcmErrorMIDelayTimer = false
          McuEcmErrorOutputMask = false
        McuEcmErrorSource34:
          McuNmiNotification = NULL_PTR
          McuMiNotification = RamMemLclRamSngBitEcc
          McuEcmErrorMaskableInterrupt = true
          McuEcmErrorNonMaskableInterrupt = false
          McuEcmErrorInternalReset = false
          McuEcmErrorNMIDelayTimer = false
          McuEcmErrorMIDelayTimer = false
          McuEcmErrorOutputMask = true
        McuEcmErrorSource36:
          McuNmiNotification = NULL_PTR
          McuMiNotification = CodFlsSngBitEcc
          McuEcmErrorMaskableInterrupt = true
          McuEcmErrorNonMaskableInterrupt = false
          McuEcmErrorInternalReset = false
          McuEcmErrorNMIDelayTimer = false
          McuEcmErrorMIDelayTimer = false
          McuEcmErrorOutputMask = true
        McuEcmErrorSource37:
          McuNmiNotification = NULL_PTR
          McuMiNotification = NULL_PTR
          McuEcmErrorMaskableInterrupt = false
          McuEcmErrorNonMaskableInterrupt = false
          McuEcmErrorInternalReset = false
          McuEcmErrorNMIDelayTimer = false
          McuEcmErrorMIDelayTimer = false
          McuEcmErrorOutputMask = true
        McuEcmErrorSource38:
          McuNmiNotification = NULL_PTR
          McuMiNotification = NULL_PTR
          McuEcmErrorMaskableInterrupt = false
          McuEcmErrorNonMaskableInterrupt = false
          McuEcmErrorInternalReset = false
          McuEcmErrorNMIDelayTimer = false
          McuEcmErrorMIDelayTimer = false
          McuEcmErrorOutputMask = true
        McuEcmErrorSource39:
          McuNmiNotification = NULL_PTR
          McuMiNotification = NULL_PTR
          McuEcmErrorMaskableInterrupt = false
          McuEcmErrorNonMaskableInterrupt = false
          McuEcmErrorInternalReset = false
          McuEcmErrorNMIDelayTimer = false
          McuEcmErrorMIDelayTimer = false
          McuEcmErrorOutputMask = true
        McuEcmErrorSource40:
          McuNmiNotification = NULL_PTR
          McuMiNotification = NULL_PTR
          McuEcmErrorMaskableInterrupt = false
          McuEcmErrorNonMaskableInterrupt = false
          McuEcmErrorInternalReset = false
          McuEcmErrorNMIDelayTimer = false
          McuEcmErrorMIDelayTimer = false
          McuEcmErrorOutputMask = true
        McuEcmErrorSource41:
          McuNmiNotification = NULL_PTR
          McuMiNotification = NULL_PTR
          McuEcmErrorMaskableInterrupt = false
          McuEcmErrorNonMaskableInterrupt = false
          McuEcmErrorInternalReset = false
          McuEcmErrorNMIDelayTimer = false
          McuEcmErrorMIDelayTimer = false
          McuEcmErrorOutputMask = false
        McuEcmErrorSource42:
          McuNmiNotification = NULL_PTR
          McuMiNotification = NULL_PTR
          McuEcmErrorMaskableInterrupt = false
          McuEcmErrorNonMaskableInterrupt = false
          McuEcmErrorInternalReset = false
          McuEcmErrorNMIDelayTimer = false
          McuEcmErrorMIDelayTimer = false
          McuEcmErrorOutputMask = true
        McuEcmErrorSource5:
          McuNmiNotification = FeNmiClkMonr0RtLowrLimFlt
          McuMiNotification = NULL_PTR
          McuEcmErrorMaskableInterrupt = false
          McuEcmErrorNonMaskableInterrupt = true
          McuEcmErrorInternalReset = false
          McuEcmErrorNMIDelayTimer = false
          McuEcmErrorMIDelayTimer = false
          McuEcmErrorOutputMask = false
        McuEcmErrorSource6:
          McuNmiNotification = FeNmiClkMonr2RtUpprLimFlt
          McuMiNotification = NULL_PTR
          McuEcmErrorMaskableInterrupt = false
          McuEcmErrorNonMaskableInterrupt = true
          McuEcmErrorInternalReset = false
          McuEcmErrorNMIDelayTimer = false
          McuEcmErrorMIDelayTimer = false
          McuEcmErrorOutputMask = false
        McuEcmErrorSource7:
          McuNmiNotification = FeNmiClkMonr2RtLowrLimFlt
          McuMiNotification = NULL_PTR
          McuEcmErrorMaskableInterrupt = false
          McuEcmErrorNonMaskableInterrupt = true
          McuEcmErrorInternalReset = false
          McuEcmErrorNMIDelayTimer = false
          McuEcmErrorMIDelayTimer = false
          McuEcmErrorOutputMask = false
        McuEcmErrorSource8:
          McuNmiNotification = FeNmiClkMonr1RtUpprLimFlt
          McuMiNotification = NULL_PTR
          McuEcmErrorMaskableInterrupt = false
          McuEcmErrorNonMaskableInterrupt = true
          McuEcmErrorInternalReset = false
          McuEcmErrorNMIDelayTimer = false
          McuEcmErrorMIDelayTimer = false
          McuEcmErrorOutputMask = false
        McuEcmErrorSource9:
          McuNmiNotification = FeNmiClkMonr1RtLowrLimFlt
          McuMiNotification = NULL_PTR
          McuEcmErrorMaskableInterrupt = false
          McuEcmErrorNonMaskableInterrupt = true
          McuEcmErrorInternalReset = false
          McuEcmErrorNMIDelayTimer = false
          McuEcmErrorMIDelayTimer = false
          McuEcmErrorOutputMask = false
        McuEcmErrorSource129: McuEcmErrorInternalReset=false, McuEcmErrorOutputMask=true
      McuClockSettingConfig: McuClockSettingId=0, McuMainOsciFrequency=16000000, McuCpuMainSysClk=160000000, McuUnitName=CLK_CPU
        McuExternalClkOutSetting:
          McuExternalClk0SourceSel = MCU_NO_OUTPUT
          McuExternalClk0DividerSel = 1
          McuExternalClock0 = 0
          McuExternalClk1SourceSel = MCU_NO_OUTPUT
          McuExternalClk1DividerSel = 1
          McuExternalClock1 = 0
        McuClockReferencePoint: McuClockReferencePointFrequency=0
        McuLowspeedPeriClk: McuUnitName=CLK_LSB, McuPeripheralClock=40000000
        McuWdtacounterClk: McuWdtCounterDivider=DIVBY_1_ID_1, McuUnitName=WDTCLKI, McuPeripheralClock=8000000
        McuAdcClk: McuDivClockSel=CLK_LSB, McuUnitName=ADC, McuPeripheralClock=40000000
        McuHighspeedPeriClk0 (McuHighspeedPeriClk): McuUnitName=CLK_HSB, McuPeripheralClock=80000000
      McuDemEventParameterRefs:
        MCU_E_CLOCK_FAILURE = MCU_E_CLOCK_FAILURE
        MCU_E_WRITE_TIMEOUT_FAILURE = MCU_E_WRITE_TIMEOUT_FAILURE
        MCU_E_CLM_SELFDIAG_FAILURE = MCU_E_CLM_SELFDIAG_FAILURE
        MCU_E_CVM_SELFDIAG_FAILURE = MCU_E_CVM_SELFDIAG_FAILURE
        MCU_E_ECM_SELFDIAG_FAILURE = MCU_E_ECM_SELFDIAG_FAILURE
        MCU_E_LOCKSTEP_SELFDIAG_FAILURE = MCU_E_LOCKSTEP_SELFDIAG_FAILURE
        MCU_E_INT_INCONSISTENT = MCU_E_INT_INCONSISTENT
        MCU_E_REG_WRITE_VERIFY = MCU_E_REG_WRITE_VERIFY
      McuModeSettingConf: McuModeType=RUN_MODE, McuMode=0
    McuPublishedInformation
      McuResetReasonConf: McuResetReason=0
      McuRstRsnConfPowOnClr: McuResetReason=0
      McuRstRsnConfPinRst: McuResetReason=1
      McuRstRsnConfSwRst: McuResetReason=2
      McuRstRsnConfWdta: McuResetReason=3
      McuRstRsnConfLockStepCompare: McuResetReason=4
      McuRstRsnConfClkMonUprLimErMosc: McuResetReason=5
      McuRstRsnConfClkMonLwrLimErMosc: McuResetReason=6
      McuRstRsnConfClkMonUprLimErWdt: McuResetReason=7
      McuRstRsnConfClkMonLwrLimErWdt: McuResetReason=8
      McuRstRsnConfClkMonUprLimErPclk: McuResetReason=9
      McuRstRsnConfClkMonLwrLimErPclk: McuResetReason=10
      McuRstRsnConfClkMonUprLimErPe1: McuResetReason=11
      McuRstRsnConfClkMonLwrLimErPe1: McuResetReason=12
      McuRstRsnConfLRamEcc2AddPrty: McuResetReason=13
      McuRstRsnConfInstCacheRamEcc2: McuResetReason=14
      McuRstRsnConfCodeFlsEcc2AddPrty: McuResetReason=15
      McuRstRsnConfDataFlsEcc2: McuResetReason=16
      McuRstRsnConfDtsRamEcc2: McuResetReason=17
      McuRstRsnConfCsihRamEcc2: McuResetReason=18
      McuRstRsnConfCanRamEcc2: McuResetReason=19
      McuRstRsnConfFrRamEcc2: McuResetReason=20
      McuRstRsnConfFlsProgMode: McuResetReason=21
      McuRstRsnConfTestMode: McuResetReason=22
      McuRstRsnConfSingChipModInact: McuResetReason=23
      McuRstRsnConfPeGuard: McuResetReason=24
      McuRstRsnConfPBusGuard: McuResetReason=25
      McuRstRsnConfSarAdcPrty: McuResetReason=26
      McuRstRsnConfBusDataPrty: McuResetReason=27
      McuRstRsnConfEcmCompare: McuResetReason=28
      McuRstRsnConfLvi: McuResetReason=29
      McuRstRsnConfTempSensor: McuResetReason=30
      McuRstRsnConfDmaTrans: McuResetReason=31
      McuRstRsnConfDmaViol: McuResetReason=32
      McuRstRsnConfLRamEcc1: McuResetReason=33
      McuRstRsnConfCodeFlsEcc1: McuResetReason=34
      McuRstRsnConfDataFlsEcc1: McuResetReason=35
      McuRstRsnConfDtsRamEcc1: McuResetReason=36
      McuRstRsnConfPeriRamEcc1: McuResetReason=37
      McuRstRsnConfBistCodeEcc1: McuResetReason=38
      McuRstRsnConfBistCodeEcc2: McuResetReason=39
      McuRstRsnConfFaci: McuResetReason=40
      McuRstRsnConfEcmDelayOverFlow: McuResetReason=41
      McuRstRsnConfCvmRst: McuResetReason=42
      McuRstRsnConfRstUndefined: McuResetReason=43
      McuRstRsnConfRstUnknown: McuResetReason=44
    McuGeneralConfiguration:
      McuVersionCheckExternalModules = false
      McuDevErrorDetect = true
      McuGetRamStateApi = false
      McuInitClock = true
      McuNoPll = true
      McuPerformResetApi = true
      McuVersionInfoApi = false
      McuCriticalSectionProtection = true
      McuSwResetCallApi = false
      McuEcmDelayTimerOverflowValue = 65535
      McuEcmErrorOutputMode = NON_DYNAMIC_MODE
      McuEcmErrorOutTimer = false
      McuDeviceName = R7F701311
      McuClm0Operation = true
      McuClm0SamplingClockAccuracy = 10
      McuClm1Operation = true
      McuClm2Operation = true
      McuClm2SamplingClockAccuracy = 10
      McuClm3Operation = true
      McuClma{0..3}SelfDiagnosticTest = false
      McuEcmSelfDiagnosticTest = false
      McuLoopCount = 5
      McuLockStepSelfDiagnosticTest = false
      McuWriteVerify = WV_INIT_RUNTIME
      McuWVErrorNotification = McuWrVrfyFailr
      McuStartUpSWResetTest = false
      McuStartUpECMResetTest = false
      Mcu_UseWVErrorInterface = true
      McuInterruptConsistencyCheck = true
      McuClm1MonitoringClockAccuracy = 1
      McuClm3SamplingClockAccuracy = 1
      McuClm2MonitoringClockAccuracy = 1
      McuClm3MonitoringClockAccuracy = 1
      McuCvmSelfDiagnosticTest = true
      McuRamSectorSetting = false
      McuClm0MonitoringClockAccuracy = 1
      McuClm1SamplingClockAccuracy = 1
