AUTOSAR XML (schema 4-0-3)
package /ActiveEcuC
  module config MemIf: implementation-config-variant=VARIANT-PRE-COMPILE, module-description=MemIf_Impl
    MemIfGeneral: MemIfDevErrorDetect=true, MemIfVersionInfoApi=false
    Fee (MemIfMemHwA): MemIfMemHwAId=0, MemIfMemHwARef=FeeGeneral
