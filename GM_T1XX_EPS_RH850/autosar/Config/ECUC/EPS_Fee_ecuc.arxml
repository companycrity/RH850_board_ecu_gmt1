AUTOSAR XML (schema 4-0-3)
package /ActiveEcuC
  module config Fee: implementation-config-variant=VARIANT-PRE-COMPILE, module-description=Fee_Impl
    FeeGeneral:
      FeeDevErrorDetect = true
      FeeVersionInfoApi = false
      FeePollingMode = true
      FeeSetModeSupported = true
      FeeIndex = 0
      FeeNvmJobEndNotification = NULL_PTR
      FeeNvmJobErrorNotification = NULL_PTR
      FeeInternalBufferSize = 128
      FeeMainFunctionPeriod = 0.01
      FeeMainFunctionTriggering = FixedCycleTime
      FeeDevErrorChecks: FeeDebugReporting=true, FeeDetErrorhook=Det_ReportError, FeeDetIncludeFile=Det.h
      FeeFlsApi:
        FeeFlsIncludeFile = Fls.h
        FeeFlsSetMode = Fls_SetMode
        FeeFlsRead = Fls_Read
        FeeFlsWrite = Fls_Write
        FeeFlsCancel = Fls_Cancel
        FeeFlsGetStatus = Fls_GetStatus
        FeeFlsGetJobResult = Fls_GetJobResult
        FeeFlsErase = Fls_Erase
        FeeFlsCompare = Fls_Compare
        FeeFlsDeviceIndex = FlsGeneral
    FeeSpecificFeatures:
      FeeApplErrorCallbackFunction = Appl_FeeCriticalErrorCallback
      FeeApplErrorCallbackIncludeFile = Fee_Callouts.h
      FeeGetEraseCycleApi = false
      FeeGetWriteCycleApi = false
      FeeUseApplErrorCallback = true
      FeeUseJobCache = false
      FeeForceSectorSwitchApi = false
      FeeDataConversionApi = false
      FeeFblConfig = false
      FeeMaxLinkTableSize = 100
      FeeFssControlApi = true
    FeeConfigBlock (FeeBlockConfiguration):
      FeeBlockIdFixed = true
      FeeBlockIsCritical = false
      FeeImmediateData = false
      FeeNumberOfChunkInstances = 1
      FeeBlockNumber = 234
      FeeBlockSize = 4
      FeeNumberOfWriteCycles = 10000
      FeeNumberOfDatasets = 2
      FeeBlockId = 0
      FeePartition = FEE0
      FeeDeviceIndex = FlsGeneral
    FeePublishedInformation: FeeBlockOverhead=2, FeeMaximumBlockingTime=1, FeePageOverhead=0, FeeChunkHeader=16, FeeChunkLink=8, FeeSectorHeader=8
    FEE0 (FeePartitionConfiguration):
      FeeBssThresholdReserved = 2181
      FeeFssThresholdReserved = 100
      FeeLowerSectorAddress = 0
      FeeLowerSectorSize = 8192
      FeeUpperSectorAddress = 8192
      FeeUpperSectorSize = 8192
      FeeAddressAlignment = 8
      FeeWriteAlignment = 8
      FeePartitionDevice = FlsConfigSet
    FEE1 (FeePartitionConfiguration):
      FeeBssThresholdReserved = 502
      FeeFssThresholdReserved = 100
      FeeLowerSectorAddress = 16384
      FeeLowerSectorSize = 8192
      FeeUpperSectorAddress = 24576
      FeeUpperSectorSize = 8192
      FeeAddressAlignment = 8
      FeeWriteAlignment = 8
      FeePartitionDevice = FlsConfigSet
    116 x FeeBlockConfiguration, all with FeeBlockIsCritical=false, FeeImmediateData=false, FeeNumberOfWriteCycles=10000, FeeNumberOfDatasets=1, FeeDeviceIndex=FlsGeneral:
      FeeCurrMeasMotEol_Deprecated: FeeBlockIdFixed=true, FeeNumberOfChunkInstances=1, FeeBlockNumber=232, FeeBlockSize=76, FeeBlockId=1, FeePartition=FEE0
      FeePolarityCfgSaved: FeeBlockIdFixed=true, FeeNumberOfChunkInstances=1, FeeBlockNumber=230, FeeBlockSize=6, FeeBlockId=2, FeePartition=FEE0
      FeeRte_NvmBlock_CDD_MotAg0Meas_MotAg0CoeffTbl: FeeBlockIdFixed=true, FeeNumberOfChunkInstances=1, FeeBlockNumber=228, FeeBlockSize=106, FeeBlockId=3, FeePartition=FEE0
      FeeRte_NvmBlock_CDD_MotAgCmp_MotAgCmpMotAgBackEmf: FeeBlockIdFixed=true, FeeNumberOfChunkInstances=1, FeeBlockNumber=222, FeeBlockSize=4, FeeBlockId=4, FeePartition=FEE0
      FeeMotPrmNom: FeeBlockIdFixed=true, FeeNumberOfChunkInstances=1, FeeBlockNumber=226, FeeBlockSize=10, FeeBlockId=5, FeePartition=FEE0
      FeeRte_NvmBlock_CmnMfgSrv_NxtrMfgEnaCntr: FeeBlockIdFixed=true, FeeNumberOfChunkInstances=1, FeeBlockNumber=224, FeeBlockSize=1, FeeBlockId=6, FeePartition=FEE0
      FeeRte_NvmBlock_CmnMfgSrv_IgnCntr: FeeBlockIdFixed=true, FeeNumberOfChunkInstances=15, FeeBlockNumber=220, FeeBlockSize=4, FeeBlockId=0, FeePartition=FEE1
      FeeRte_NvmBlock_CDD_MotAg1Meas_MotAg1CoeffTbl: FeeBlockIdFixed=true, FeeNumberOfChunkInstances=1, FeeBlockNumber=216, FeeBlockSize=106, FeeBlockId=7, FeePartition=FEE0
      FeeRte_NvmBlock_HwAg0Meas_HwAg0Offs: FeeBlockIdFixed=true, FeeNumberOfChunkInstances=1, FeeBlockNumber=218, FeeBlockSize=10, FeeBlockId=8, FeePartition=FEE0
      FeeRte_NvmBlock_NvMProxy_ShtdwnClsChk: FeeBlockIdFixed=true, FeeNumberOfChunkInstances=7, FeeBlockNumber=214, FeeBlockSize=6, FeeBlockId=1, FeePartition=FEE1
      FeeRte_NvmBlock_HwAg1Meas_HwAg1Offs: FeeBlockIdFixed=true, FeeNumberOfChunkInstances=1, FeeBlockNumber=212, FeeBlockSize=10, FeeBlockId=9, FeePartition=FEE0
      FeeRte_NvmBlock_HwTqCorrln_HwTqChACmnModCmpLpFilSt: FeeBlockIdFixed=true, FeeNumberOfChunkInstances=15, FeeBlockNumber=202, FeeBlockSize=6, FeeBlockId=2, FeePartition=FEE1
      FeeRte_NvmBlock_HwTqCorrln_HwTqChBCmnModCmpLpFilSt: FeeBlockIdFixed=true, FeeNumberOfChunkInstances=15, FeeBlockNumber=210, FeeBlockSize=6, FeeBlockId=3, FeePartition=FEE1
      FeeRte_NvmBlock_CDD_HwTq1Meas_HwTq1Offs: FeeBlockIdFixed=true, FeeNumberOfChunkInstances=1, FeeBlockNumber=208, FeeBlockSize=10, FeeBlockId=10, FeePartition=FEE0
      FeeRte_NvmBlock_CDD_HwTq3Meas_HwTq3Offs: FeeBlockIdFixed=true, FeeNumberOfChunkInstances=1, FeeBlockNumber=206, FeeBlockSize=10, FeeBlockId=11, FeePartition=FEE0
      FeeRte_NvmBlock_CDD_HwTq2Meas_HwTq2Offs: FeeBlockIdFixed=true, FeeNumberOfChunkInstances=1, FeeBlockNumber=204, FeeBlockSize=10, FeeBlockId=12, FeePartition=FEE0
      FeeRte_NvmBlock_CDD_HwTq0Meas_HwTq0Offs: FeeBlockIdFixed=true, FeeNumberOfChunkInstances=1, FeeBlockNumber=200, FeeBlockSize=10, FeeBlockId=13, FeePartition=FEE0
      FeeRte_NvmBlock_MotAg2Meas_MotAg2EolPrm: FeeBlockIdFixed=true, FeeNumberOfChunkInstances=1, FeeBlockNumber=198, FeeBlockSize=22, FeeBlockId=14, FeePartition=FEE0
      FeeRte_NvmBlock_DiagcMgr_DiagcMgrNtcFltAry: FeeBlockIdFixed=true, FeeNumberOfChunkInstances=1, FeeBlockNumber=194, FeeBlockSize=82, FeeBlockId=4, FeePartition=FEE1
      FeeRte_NvmBlock_EotLrng_EotNvmData: FeeBlockIdFixed=true, FeeNumberOfChunkInstances=1, FeeBlockNumber=196, FeeBlockSize=14, FeeBlockId=5, FeePartition=FEE1
      FeeRte_NvmBlock_CDD_CurrMeas_CurrMeasEolOffsCalSet: FeeBlockIdFixed=true, FeeNumberOfChunkInstances=1, FeeBlockNumber=188, FeeBlockSize=54, FeeBlockId=15, FeePartition=FEE0
      FeeRte_NvmBlock_CDD_CurrMeas_CurrMeasEolGainCalSet: FeeBlockIdFixed=true, FeeNumberOfChunkInstances=1, FeeBlockNumber=192, FeeBlockSize=26, FeeBlockId=16, FeePartition=FEE0
      FeeRte_NvmBlock_PartNr_PartNrRepairShopCod: FeeBlockIdFixed=true, FeeNumberOfChunkInstances=1, FeeBlockNumber=190, FeeBlockSize=22, FeeBlockId=17, FeePartition=FEE0
      FeeRte_NvmBlock_PartNr_PartNrSysName: FeeBlockIdFixed=true, FeeNumberOfChunkInstances=1, FeeBlockNumber=186, FeeBlockSize=22, FeeBlockId=18, FeePartition=FEE0
      FeeRte_NvmBlock_PartNr_PartNrCcaMfgTrakg: FeeBlockIdFixed=true, FeeNumberOfChunkInstances=1, FeeBlockNumber=184, FeeBlockSize=11, FeeBlockId=19, FeePartition=FEE0
      FeeRte_NvmBlock_PartNr_PartNrSysCodVersNr: FeeBlockIdFixed=true, FeeNumberOfChunkInstances=1, FeeBlockNumber=182, FeeBlockSize=4, FeeBlockId=20, FeePartition=FEE0
      FeeRte_NvmBlock_PartNr_PartNrNxtrMfgTrakg: FeeBlockIdFixed=true, FeeNumberOfChunkInstances=1, FeeBlockNumber=180, FeeBlockSize=9, FeeBlockId=21, FeePartition=FEE0
      FeeRte_NvmBlock_PartNr_PartNrEndMdlPartNr: FeeBlockIdFixed=true, FeeNumberOfChunkInstances=1, FeeBlockNumber=178, FeeBlockSize=8, FeeBlockId=22, FeePartition=FEE0
      FeeRte_NvmBlock_PartNr_PartNrBasMdlPartNr: FeeBlockIdFixed=true, FeeNumberOfChunkInstances=1, FeeBlockNumber=176, FeeBlockSize=8, FeeBlockId=23, FeePartition=FEE0
      FeeRte_NvmBlock_PartNr_PartNrCtrlPidSeedKey: FeeBlockIdFixed=true, FeeNumberOfChunkInstances=1, FeeBlockNumber=162, FeeBlockSize=12, FeeBlockId=24, FeePartition=FEE0
      FeeRte_NvmBlock_PartNr_PartNrVinData: FeeBlockIdFixed=true, FeeNumberOfChunkInstances=1, FeeBlockNumber=174, FeeBlockSize=19, FeeBlockId=25, FeePartition=FEE0
      FeeRte_NvmBlock_PartNr_PartNrProgmDate: FeeBlockIdFixed=true, FeeNumberOfChunkInstances=1, FeeBlockNumber=172, FeeBlockSize=6, FeeBlockId=26, FeePartition=FEE0
      FeeRte_NvmBlock_PartNr_PartNrDataUniversalNrSysId: FeeBlockIdFixed=true, FeeNumberOfChunkInstances=1, FeeBlockNumber=170, FeeBlockSize=11, FeeBlockId=27, FeePartition=FEE0
      FeeRte_NvmBlock_PartNr_PartNrCalProgdSts: FeeBlockIdFixed=true, FeeNumberOfChunkInstances=1, FeeBlockNumber=168, FeeBlockSize=3, FeeBlockId=28, FeePartition=FEE0
      FeeRte_NvmBlock_PartNr_PartNrCustMfgEnaCntr: FeeBlockIdFixed=true, FeeNumberOfChunkInstances=1, FeeBlockNumber=166, FeeBlockSize=3, FeeBlockId=29, FeePartition=FEE0
      FeeRte_NvmBlock_PartNr_PartNrProgmSessionSeedKey: FeeBlockIdFixed=true, FeeNumberOfChunkInstances=1, FeeBlockNumber=164, FeeBlockSize=12, FeeBlockId=30, FeePartition=FEE0
      FeeRte_NvmBlock_CmnMfgSrv_MfgTmpBuf4: FeeBlockIdFixed=true, FeeNumberOfChunkInstances=1, FeeBlockNumber=152, FeeBlockSize=18, FeeBlockId=31, FeePartition=FEE0
      FeeRte_NvmBlock_CmnMfgSrv_EpsSysSerlNr: FeeBlockIdFixed=true, FeeNumberOfChunkInstances=1, FeeBlockNumber=160, FeeBlockSize=22, FeeBlockId=32, FeePartition=FEE0
      FeeRte_NvmBlock_CmnMfgSrv_MfgTmpBuf3: FeeBlockIdFixed=true, FeeNumberOfChunkInstances=1, FeeBlockNumber=158, FeeBlockSize=18, FeeBlockId=33, FeePartition=FEE0
      FeeRte_NvmBlock_CmnMfgSrv_DiRestore: FeeBlockIdFixed=true, FeeNumberOfChunkInstances=1, FeeBlockNumber=156, FeeBlockSize=10, FeeBlockId=34, FeePartition=FEE0
      FeeRte_NvmBlock_CmnMfgSrv_MfgTmpBuf2: FeeBlockIdFixed=true, FeeNumberOfChunkInstances=1, FeeBlockNumber=154, FeeBlockSize=18, FeeBlockId=35, FeePartition=FEE0
      FeeRte_NvmBlock_CmnMfgSrv_MfgTmpBuf1: FeeBlockIdFixed=true, FeeNumberOfChunkInstances=1, FeeBlockNumber=144, FeeBlockSize=18, FeeBlockId=36, FeePartition=FEE0
      FeeRte_NvmBlock_CmnMfgSrv_CcaHwPartNr: FeeBlockIdFixed=true, FeeNumberOfChunkInstances=1, FeeBlockNumber=150, FeeBlockSize=22, FeeBlockId=37, FeePartition=FEE0
      FeeRte_NvmBlock_CmnMfgSrv_MfgTmpBuf0: FeeBlockIdFixed=true, FeeNumberOfChunkInstances=1, FeeBlockNumber=148, FeeBlockSize=18, FeeBlockId=38, FeePartition=FEE0
      FeeRte_NvmBlock_CmnMfgSrv_CcaSerlNr: FeeBlockIdFixed=true, FeeNumberOfChunkInstances=1, FeeBlockNumber=146, FeeBlockSize=22, FeeBlockId=39, FeePartition=FEE0
      FeeRte_NvmBlock_DutyCycThermProtn_FilStVal: FeeBlockIdFixed=true, FeeNumberOfChunkInstances=1, FeeBlockNumber=2, FeeBlockSize=6, FeeBlockId=6, FeePartition=FEE1
      FeeRte_NvmBlock_PullCmpActv_PullCmpLongTerm: FeeBlockIdFixed=true, FeeNumberOfChunkInstances=1, FeeBlockNumber=142, FeeBlockSize=6, FeeBlockId=7, FeePartition=FEE1
      FeeRte_NvmBlock_MotTqCmdSca_MotTqScaFac: FeeBlockIdFixed=true, FeeNumberOfChunkInstances=1, FeeBlockNumber=140, FeeBlockSize=6, FeeBlockId=40, FeePartition=FEE0
      FeeRte_NvmBlock_SnsrOffsLrng_SnsrOffsLrnd: FeeBlockIdFixed=true, FeeNumberOfChunkInstances=1, FeeBlockNumber=138, FeeBlockSize=78, FeeBlockId=8, FeePartition=FEE1
      FeeRte_NvmBlock_GmOvrlStMgr_GmLoaIgnCntr: FeeBlockIdFixed=true, FeeNumberOfChunkInstances=1, FeeBlockNumber=136, FeeBlockSize=4, FeeBlockId=9, FeePartition=FEE1
      FeeRte_NvmBlock_MotRplCoggCfg_MotRplCoggPrm: FeeBlockIdFixed=true, FeeNumberOfChunkInstances=1, FeeBlockNumber=134, FeeBlockSize=20, FeeBlockId=41, FeePartition=FEE0
      FeeRte_NvmBlock_CDD_MotRplCoggCmd_MotCoggCmdY: FeeBlockIdFixed=true, FeeNumberOfChunkInstances=1, FeeBlockNumber=132, FeeBlockSize=1026, FeeBlockId=42, FeePartition=FEE0
      FeeRte_NvmBlock_StHlthSigStc_SigStcHistDataAry: FeeBlockIdFixed=true, FeeNumberOfChunkInstances=1, FeeBlockNumber=130, FeeBlockSize=227, FeeBlockId=10, FeePartition=FEE1
      FeeRte_NvmBlock_HwAgVehCentrTrim_HwAgTrimVal_Deprecated: FeeBlockIdFixed=true, FeeNumberOfChunkInstances=1, FeeBlockNumber=128, FeeBlockSize=6, FeeBlockId=43, FeePartition=FEE0
      FeeRte_NvmBlock_WhlImbRejctn_MaxCompPerc_Deprecated: FeeBlockIdFixed=true, FeeNumberOfChunkInstances=1, FeeBlockNumber=126, FeeBlockSize=6, FeeBlockId=11, FeePartition=FEE1
      FeeRte_NvmBlock_WhlImbRejctn_ActvCmpBand3_Deprecated: FeeBlockIdFixed=true, FeeNumberOfChunkInstances=1, FeeBlockNumber=124, FeeBlockSize=6, FeeBlockId=12, FeePartition=FEE1
      FeeRte_NvmBlock_WhlImbRejctn_ActvCmpBand1_Deprecated: FeeBlockIdFixed=true, FeeNumberOfChunkInstances=1, FeeBlockNumber=122, FeeBlockSize=6, FeeBlockId=13, FeePartition=FEE1
      FeeRte_NvmBlock_WhlImbRejctn_RiPeakPrev_Deprecated: FeeBlockIdFixed=true, FeeNumberOfChunkInstances=1, FeeBlockNumber=120, FeeBlockSize=6, FeeBlockId=14, FeePartition=FEE1
      FeeRte_NvmBlock_WhlImbRejctn_LePeakPrev_Deprecated: FeeBlockIdFixed=true, FeeNumberOfChunkInstances=1, FeeBlockNumber=118, FeeBlockSize=6, FeeBlockId=15, FeePartition=FEE1
      FeeRte_NvmBlock_WhlImbRejctn_ActvCmpBand2_Deprecated: FeeBlockIdFixed=true, FeeNumberOfChunkInstances=1, FeeBlockNumber=116, FeeBlockSize=6, FeeBlockId=16, FeePartition=FEE1
      FeeRte_NvmBlock_HwAgVehCentrTrim_HwAgTrimData: FeeBlockIdFixed=true, FeeNumberOfChunkInstances=1, FeeBlockNumber=114, FeeBlockSize=10, FeeBlockId=44, FeePartition=FEE0
      FeeRte_NvmBlock_SysFricLrng_FricNonLrngData: FeeBlockIdFixed=false, FeeNumberOfChunkInstances=1, FeeBlockNumber=112, FeeBlockSize=10, FeeBlockId=45, FeePartition=FEE0
      FeeRte_NvmBlock_SysFricLrng_FricLrngData: FeeBlockIdFixed=true, FeeNumberOfChunkInstances=1, FeeBlockNumber=110, FeeBlockSize=218, FeeBlockId=17, FeePartition=FEE1
      FeeRte_NvmBlock_Bootloader_EcuId: FeeBlockIdFixed=true, FeeNumberOfChunkInstances=1, FeeBlockNumber=108, FeeBlockSize=16, FeeBlockId=46, FeePartition=FEE0
      FeeRte_NvmBlock_Bootloader_NbId: FeeBlockIdFixed=true, FeeNumberOfChunkInstances=1, FeeBlockNumber=106, FeeBlockSize=4, FeeBlockId=47, FeePartition=FEE0
      FeeRte_NvmBlock_Bootloader_SBAT: FeeBlockIdFixed=true, FeeNumberOfChunkInstances=1, FeeBlockNumber=104, FeeBlockSize=822, FeeBlockId=48, FeePartition=FEE0
      FeeDemAdminDataBlock: FeeBlockIdFixed=true, FeeNumberOfChunkInstances=1, FeeBlockNumber=102, FeeBlockSize=8, FeeBlockId=19, FeePartition=FEE1
      FeeDemStatusDataBlock: FeeBlockIdFixed=true, FeeNumberOfChunkInstances=1, FeeBlockNumber=100, FeeBlockSize=72, FeeBlockId=20, FeePartition=FEE1
      FeeDemPrimaryDataBlock0: FeeBlockIdFixed=true, FeeNumberOfChunkInstances=1, FeeBlockNumber=98, FeeBlockSize=44, FeeBlockId=21, FeePartition=FEE1
      FeeDemPrimaryDataBlock1: FeeBlockIdFixed=true, FeeNumberOfChunkInstances=1, FeeBlockNumber=96, FeeBlockSize=44, FeeBlockId=22, FeePartition=FEE1
      FeeDemPrimaryDataBlock2: FeeBlockIdFixed=true, FeeNumberOfChunkInstances=1, FeeBlockNumber=94, FeeBlockSize=44, FeeBlockId=23, FeePartition=FEE1
      FeeDemPrimaryDataBlock3: FeeBlockIdFixed=true, FeeNumberOfChunkInstances=1, FeeBlockNumber=92, FeeBlockSize=44, FeeBlockId=24, FeePartition=FEE1
      FeeDemPrimaryDataBlock4: FeeBlockIdFixed=true, FeeNumberOfChunkInstances=1, FeeBlockNumber=90, FeeBlockSize=44, FeeBlockId=25, FeePartition=FEE1
      FeeDemPrimaryDataBlock5: FeeBlockIdFixed=true, FeeNumberOfChunkInstances=1, FeeBlockNumber=88, FeeBlockSize=44, FeeBlockId=26, FeePartition=FEE1
      FeeDemPrimaryDataBlock6: FeeBlockIdFixed=true, FeeNumberOfChunkInstances=1, FeeBlockNumber=86, FeeBlockSize=44, FeeBlockId=27, FeePartition=FEE1
      FeeDemPrimaryDataBlock7: FeeBlockIdFixed=true, FeeNumberOfChunkInstances=1, FeeBlockNumber=84, FeeBlockSize=44, FeeBlockId=28, FeePartition=FEE1
      FeeDemPrimaryDataBlock8: FeeBlockIdFixed=true, FeeNumberOfChunkInstances=1, FeeBlockNumber=20, FeeBlockSize=44, FeeBlockId=29, FeePartition=FEE1
      FeeDemPrimaryDataBlock9: FeeBlockIdFixed=true, FeeNumberOfChunkInstances=1, FeeBlockNumber=22, FeeBlockSize=44, FeeBlockId=30, FeePartition=FEE1
      FeeDemPrimaryDataBlock10: FeeBlockIdFixed=true, FeeNumberOfChunkInstances=1, FeeBlockNumber=24, FeeBlockSize=44, FeeBlockId=31, FeePartition=FEE1
      FeeDemPrimaryDataBlock11: FeeBlockIdFixed=true, FeeNumberOfChunkInstances=1, FeeBlockNumber=26, FeeBlockSize=44, FeeBlockId=32, FeePartition=FEE1
      FeeDemPrimaryDataBlock12: FeeBlockIdFixed=true, FeeNumberOfChunkInstances=1, FeeBlockNumber=28, FeeBlockSize=44, FeeBlockId=33, FeePartition=FEE1
      FeeDemPrimaryDataBlock13: FeeBlockIdFixed=true, FeeNumberOfChunkInstances=1, FeeBlockNumber=30, FeeBlockSize=44, FeeBlockId=34, FeePartition=FEE1
      FeeDemPrimaryDataBlock14: FeeBlockIdFixed=true, FeeNumberOfChunkInstances=1, FeeBlockNumber=32, FeeBlockSize=44, FeeBlockId=35, FeePartition=FEE1
      FeeDemPrimaryDataBlock15: FeeBlockIdFixed=true, FeeNumberOfChunkInstances=1, FeeBlockNumber=34, FeeBlockSize=44, FeeBlockId=36, FeePartition=FEE1
      FeeDemPrimaryDataBlock16: FeeBlockIdFixed=true, FeeNumberOfChunkInstances=1, FeeBlockNumber=36, FeeBlockSize=44, FeeBlockId=37, FeePartition=FEE1
      FeeDemPrimaryDataBlock17: FeeBlockIdFixed=true, FeeNumberOfChunkInstances=1, FeeBlockNumber=38, FeeBlockSize=44, FeeBlockId=38, FeePartition=FEE1
      FeeDemPrimaryDataBlock18: FeeBlockIdFixed=true, FeeNumberOfChunkInstances=1, FeeBlockNumber=40, FeeBlockSize=44, FeeBlockId=39, FeePartition=FEE1
      FeeDemPrimaryDataBlock19: FeeBlockIdFixed=true, FeeNumberOfChunkInstances=1, FeeBlockNumber=42, FeeBlockSize=44, FeeBlockId=40, FeePartition=FEE1
      FeeDemPrimaryDataBlock20: FeeBlockIdFixed=true, FeeNumberOfChunkInstances=1, FeeBlockNumber=44, FeeBlockSize=44, FeeBlockId=41, FeePartition=FEE1
      FeeDemPrimaryDataBlock21: FeeBlockIdFixed=true, FeeNumberOfChunkInstances=1, FeeBlockNumber=46, FeeBlockSize=44, FeeBlockId=42, FeePartition=FEE1
      FeeDemPrimaryDataBlock22: FeeBlockIdFixed=true, FeeNumberOfChunkInstances=1, FeeBlockNumber=48, FeeBlockSize=44, FeeBlockId=43, FeePartition=FEE1
      FeeDemPrimaryDataBlock23: FeeBlockIdFixed=true, FeeNumberOfChunkInstances=1, FeeBlockNumber=50, FeeBlockSize=44, FeeBlockId=44, FeePartition=FEE1
      FeeDemPrimaryDataBlock24: FeeBlockIdFixed=true, FeeNumberOfChunkInstances=1, FeeBlockNumber=52, FeeBlockSize=44, FeeBlockId=45, FeePartition=FEE1
      FeeDemPrimaryDataBlock25: FeeBlockIdFixed=true, FeeNumberOfChunkInstances=1, FeeBlockNumber=54, FeeBlockSize=44, FeeBlockId=46, FeePartition=FEE1
      FeeDemPrimaryDataBlock26: FeeBlockIdFixed=true, FeeNumberOfChunkInstances=1, FeeBlockNumber=56, FeeBlockSize=44, FeeBlockId=47, FeePartition=FEE1
      FeeDemPrimaryDataBlock27: FeeBlockIdFixed=true, FeeNumberOfChunkInstances=1, FeeBlockNumber=58, FeeBlockSize=44, FeeBlockId=48, FeePartition=FEE1
      FeeDemPrimaryDataBlock28: FeeBlockIdFixed=true, FeeNumberOfChunkInstances=1, FeeBlockNumber=60, FeeBlockSize=44, FeeBlockId=49, FeePartition=FEE1
      FeeDemPrimaryDataBlock29: FeeBlockIdFixed=true, FeeNumberOfChunkInstances=1, FeeBlockNumber=62, FeeBlockSize=44, FeeBlockId=50, FeePartition=FEE1
      FeeDemPrimaryDataBlock30: FeeBlockIdFixed=true, FeeNumberOfChunkInstances=1, FeeBlockNumber=64, FeeBlockSize=44, FeeBlockId=51, FeePartition=FEE1
      FeeDemPrimaryDataBlock31: FeeBlockIdFixed=true, FeeNumberOfChunkInstances=1, FeeBlockNumber=66, FeeBlockSize=44, FeeBlockId=52, FeePartition=FEE1
      FeeDemPrimaryDataBlock32: FeeBlockIdFixed=true, FeeNumberOfChunkInstances=1, FeeBlockNumber=68, FeeBlockSize=44, FeeBlockId=53, FeePartition=FEE1
      FeeDemPrimaryDataBlock33: FeeBlockIdFixed=true, FeeNumberOfChunkInstances=1, FeeBlockNumber=70, FeeBlockSize=44, FeeBlockId=54, FeePartition=FEE1
      FeeDemPrimaryDataBlock34: FeeBlockIdFixed=true, FeeNumberOfChunkInstances=1, FeeBlockNumber=72, FeeBlockSize=44, FeeBlockId=55, FeePartition=FEE1
      FeeDemPrimaryDataBlock35: FeeBlockIdFixed=true, FeeNumberOfChunkInstances=1, FeeBlockNumber=74, FeeBlockSize=44, FeeBlockId=56, FeePartition=FEE1
      FeeDemPrimaryDataBlock36: FeeBlockIdFixed=true, FeeNumberOfChunkInstances=1, FeeBlockNumber=76, FeeBlockSize=44, FeeBlockId=57, FeePartition=FEE1
      FeeDemPrimaryDataBlock37: FeeBlockIdFixed=true, FeeNumberOfChunkInstances=1, FeeBlockNumber=78, FeeBlockSize=44, FeeBlockId=58, FeePartition=FEE1
      FeeDemPrimaryDataBlock38: FeeBlockIdFixed=true, FeeNumberOfChunkInstances=1, FeeBlockNumber=80, FeeBlockSize=44, FeeBlockId=59, FeePartition=FEE1
      FeeDemPrimaryDataBlock39: FeeBlockIdFixed=true, FeeNumberOfChunkInstances=1, FeeBlockNumber=82, FeeBlockSize=44, FeeBlockId=60, FeePartition=FEE1
      FeeRte_NvmBlock_CustDiagc_GmIgnCntr: FeeBlockIdFixed=true, FeeNumberOfChunkInstances=1, FeeBlockNumber=18, FeeBlockSize=4, FeeBlockId=18, FeePartition=FEE1
      FeeRte_NvmBlock_GmMsg778BusHiSpd_DtcTrigStsAry: FeeBlockIdFixed=true, FeeNumberOfChunkInstances=1, FeeBlockNumber=16, FeeBlockSize=42, FeeBlockId=61, FeePartition=FEE1
      FeeSnpshtDataAry: FeeBlockIdFixed=false, FeeNumberOfChunkInstances=1, FeeBlockNumber=14, FeeBlockSize=194, FeeBlockId=62, FeePartition=FEE1
      FeeRte_NvmBlock_HwAgSnsrls_StordLstPrm: FeeBlockIdFixed=true, FeeNumberOfChunkInstances=1, FeeBlockNumber=12, FeeBlockSize=10, FeeBlockId=63, FeePartition=FEE1
      FeeRte_NvmBlock_EotLrng_MaxHwAgCwAndCcw_Deprecated: FeeBlockIdFixed=true, FeeNumberOfChunkInstances=1, FeeBlockNumber=10, FeeBlockSize=10, FeeBlockId=64, FeePartition=FEE1
      FeeRte_NvmBlock_CmnMfgSrv_SeedKey: FeeBlockIdFixed=true, FeeNumberOfChunkInstances=1, FeeBlockNumber=8, FeeBlockSize=10, FeeBlockId=49, FeePartition=FEE0
      FeeRte_NvmBlock_EotLrng_MaxHwAgCwAndCcw: FeeBlockIdFixed=true, FeeNumberOfChunkInstances=1, FeeBlockNumber=6, FeeBlockSize=14, FeeBlockId=65, FeePartition=FEE1
      FeeRte_NvmBlock_WhlImbRejctn_CmpPeakData: FeeBlockIdFixed=false, FeeNumberOfChunkInstances=1, FeeBlockNumber=4, FeeBlockSize=26, FeeBlockId=66, FeePartition=FEE1
