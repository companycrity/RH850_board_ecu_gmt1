AUTOSAR XML (schema 4-0-3)
package /ActiveEcuC
  module config Dem: implementation-config-variant=VARIANT-PRE-COMPILE, module-description=Dem_Impl
    DemGeneral:
      DemAgingCycleCounterProcessing = DEM_PROCESS_AGINGCTR_INTERN
      DemGeneralInterfaceSupport = false
      DemClearDTCLimitation = DEM_ALL_SUPPORTED_DTCS
      DemDataElementDefaultEndianness = LITTLE_ENDIAN
      DemAgingRequieresTestedCycle = false
      DemMaxNumberEventEntryMirror = 0
      DemPTOSupport = false
      DemTriggerMonitorInitBeforeClearOk = true
      DemExtendedDataCapture = DEM_TRIGGER_EVENT_MEMORY_STORAGE
      DemFreezeFrameCapture = DEM_TRIGGER_EVENT_MEMORY_STORAGE
      DemOperationCycleProcessing = DEM_PROCESS_OPCYC_STATE
      DemAvailabilitySupport = DEM_NO_AVAILABILITY
      DemAvailabilityStorage = false
      DemBswErrorBufferSize = 0
      DemClearDTCBehavior = DEM_CLRRESP_VOLATILE
      DemDebounceCounterBasedSupport = true
      DemDebounceTimeBasedSupport = false
      DemDevErrorDetect = true
      DemDtcStatusAvailabilityMask = 219
      DemEnableConditionSupport = true
      DemEventCombinationSupport = DEM_EVCOMB_DISABLED
      DemEventDisplacementStrategy = DEM_DISPLACEMENT_LEGACY_403
      DemEventMemoryEntryStorageTrigger = DEM_STORAGE_ON_TEST_FAILED
      DemMaxNumberEventEntryPermanent = 0
      DemMaxNumberEventEntryPrimary = 40
      DemMaxNumberEventEntrySecondary = 0
      DemMaxNumberPrestoredFF = 0
      DemOBDSupport = DEM_OBD_NO_OBD_SUPPORT
      DemOccurrenceCounterProcessing = DEM_PROCESS_OCCCTR_TF
      DemOperationCycleStatusStorage = false
      DemResetConfirmedBitOnOverflow = true
      DemStatusBitHandlingTestFailedSinceLastClear = DEM_STATUS_BIT_NORMAL
      DemStatusBitStorageTestFailed = true
      DemStorageConditionSupport = false
      DemSuppressionSupport = DEM_NO_SUPPRESSION
      DemTaskTime = 0.01
      DemTriggerDcmReports = false
      DemTriggerDltReports = false
      DemTriggerFiMReports = false
      DemTriggerMonitorInitForEnableConditions = false
      DemTypeOfDTCSupported = DEM_DTC_TRANSLATION_ISO14229_1
      DemTypeOfFreezeFrameRecordNumeration = DEM_FF_RECNUM_CALCULATED
      DemVersionInfoApi = false
      DemBswApiVersion = DEM_BSW_API_4_XX_XX
      DemBswApiVersionNvM = DEM_BSW_API_4_XX_XX
      DemBswApiVersionFiM = DEM_BSW_API_4_XX_XX
      DemAgingAfterHealing = DEM_AGING_WHILE_HEALING
      DemAgingCounterBehavior = DEM_AGING_COUNT_ALWAYS
      DemAgingRetainEnvironmentalData = false
      DemCompiledPostbuildCrc = 468923993
      DemCompiledPostbuildCrcMode = DEM_POSTBUILD_CRC_AUTOMATIC
      DemEventDisplacementFallbackStrategy = DEM_FALLBACK_DISCARD_NEW_EVENT
      DemGeneralDiagnosticInfoSupport = true
      DemJ1939Support = false
      DemMaxNumberEventEntryOBDFreezeFrame = 0
      DemNvSynchronizeSupport = false
      DemPendingDtcProcessing = DEM_PROCESS_PDTC_STOREDONLY
      DemResetDebounceBehavior = DEM_RESET_DEBOUNCE_ON_DISABLE_ENABLE_CONDITIONS
      DemResetTestFailedOnOperationCycleStart = false
      DemRetryStorageSupport = false
      DemUseMemcopyMacros = false
      DemUseRte = true
      DemWarningIndicatorRequestedProcessing = DEM_PROCESS_WIR_STOREDONLY
      DemUseNvm = true
      DemAgingBehavior = DEM_AGING_TYPE_1
      DemMaxNumberTimeSeriesSnapshots = 0
      DemAgingCounterReporting = DEM_AGING_NORMAL_REPORTING
      DemUserControlledWirBehavior = DEM_DISABLED_DURING_CONTROLDTCSETTING
      DemSafeBswModeEnabled = true
      DemRestartCycleOnInitRef = PowerCycle
      PowerCycle (DemOperationCycle): DemOperationCycleAutomaticEnd=false, DemOperationCycleAutostart=false, DemOperationCycleType=DEM_OPCYC_OTHER
      DemPostbuild: DemEventAvailableDefaultSupport=true, DemMaxSizeFreezeFrame=34
      9 x DemEnableCondition, all with DemEnableConditionStatus=true:
        DemEnableConditionA: DemEnableConditionId=2
        DemEnableConditionB: DemEnableConditionId=3
        DemEnableConditionC: DemEnableConditionId=4
        DemEnableConditionD: DemEnableConditionId=5
        DemEnableConditionE: DemEnableConditionId=6
        DemEnableConditionF: DemEnableConditionId=7
        DemEnableConditionG: DemEnableConditionId=8
        DemEnableConditionH: DemEnableConditionId=9
        DemEnableConditionI: DemEnableConditionId=10
      SysThermErrTHiEna (DemEnableConditionGroup):
        DemEnableConditionRef = DemEnableConditionA
        DemEnableConditionRef = DemEnableConditionB
        DemEnableConditionRef = DemEnableConditionC
        DemEnableConditionRef = DemEnableConditionE
        DemEnableConditionRef = DemEnableConditionI
      SteerWheelAgSnsrCalNorPrfmdEna (DemEnableConditionGroup):
        DemEnableConditionRef = DemEnableConditionA
        DemEnableConditionRef = DemEnableConditionB
        DemEnableConditionRef = DemEnableConditionC
        DemEnableConditionRef = DemEnableConditionE
        DemEnableConditionRef = DemEnableConditionI
      DemFreezeFrameClass:
        DemDidClassRef = Pid8002
        DemDidClassRef = Pid43D0
        DemDidClassRef = Pid8078
        DemDidClassRef = Pid40BC
        DemDidClassRef = Pid40BD
        DemDidClassRef = PidC000
        DemDidClassRef = Pid4016
        DemDidClassRef = PidC050
        DemDidClassRef = Pid401B
        DemDidClassRef = Pid40AD
        DemDidClassRef = Pid4074
        DemDidClassRef = Pid40AC
        DemDidClassRef = Pid41D9
        DemDidClassRef = Pid41D3
        DemDidClassRef = Pid41D4
        DemDidClassRef = Pid41D7
        DemDidClassRef = Pid41D5
        DemDidClassRef = Pid446F
        DemDidClassRef = Pid41D6
      Pid4016 (DemDidClass): DemDidIdentifier=16406, DemDidDataElementClassRef=IgnCycCntrDat
      IgnCycCntr (DemDataElementClass)
        IgnCycCntrDat (DemExternalCSDataElementClass): DemDataElementDataSize=2, DemDataElementUsePort=true, DemUseEventIdArgumentForCallback=false, DemDataElementStoreNonVolatile=true
      EcuIntT (DemDataElementClass)
        EcuIntTDat (DemExternalCSDataElementClass): DemDataElementDataSize=1, DemDataElementUsePort=true, DemUseEventIdArgumentForCallback=false, DemDataElementStoreNonVolatile=true
      Pid401B (DemDidClass): DemDidIdentifier=16411, DemDidDataElementClassRef=EcuIntTDat
      PwrSteerIndcr (DemIndicator): DemIndicatorID=1
      42 x DemNvRamBlockId:
        Dem_AdminData: DemNvRamBlockIdType=DEM_NVBLOCK_ADMIN, DemNvRamBlockIdRef=DemAdminDataBlock
        Dem_StatusData: DemNvRamBlockIdType=DEM_NVBLOCK_STATUS, DemNvRamBlockIdRef=DemStatusDataBlock
        Dem_PrimaryEntry{0..39}: DemNvRamBlockIdType=DEM_NVBLOCK_PRIMARY, DemNvRamBlockIdIndex={0..39}, DemNvRamBlockIdRef=DemPrimaryDataBlock{0..39}
      SteerWhlAg (DemDataElementClass)
        SteerWhlAgDat (DemExternalCSDataElementClass): DemDataElementDataSize=2, DemDataElementUsePort=true, DemUseEventIdArgumentForCallback=false, DemDataElementStoreNonVolatile=true
      Pid4074 (DemDidClass): DemDidIdentifier=16500, DemDidDataElementClassRef=SteerWhlAgDat
      SteerInpTq (DemDataElementClass)
        SteerInpTqDat (DemExternalCSDataElementClass): DemDataElementDataSize=2, DemDataElementUsePort=true, DemUseEventIdArgumentForCallback=false, DemDataElementStoreNonVolatile=true
      Pid40AC (DemDidClass): DemDidIdentifier=16556, DemDidDataElementClassRef=SteerInpTqDat
      EpdMotOvldProtnCntr (DemDataElementClass)
        EpdMotOvldProtnCntrDat (DemExternalCSDataElementClass): DemDataElementDataSize=1, DemDataElementUsePort=true, DemUseEventIdArgumentForCallback=false, DemDataElementStoreNonVolatile=true
      Pid40AD (DemDidClass): DemDidIdentifier=16557, DemDidDataElementClassRef=EpdMotOvldProtnCntrDat
      EngSpd (DemDataElementClass)
        EngSpdDat (DemExternalCSDataElementClass): DemDataElementDataSize=2, DemDataElementUsePort=true, DemUseEventIdArgumentForCallback=false, DemDataElementStoreNonVolatile=true
      Pid40BC (DemDidClass): DemDidIdentifier=16572, DemDidDataElementClassRef=EngSpdDat
      VehSpd (DemDataElementClass)
        VehSpdDat (DemExternalCSDataElementClass): DemDataElementDataSize=1, DemDataElementUsePort=true, DemUseEventIdArgumentForCallback=false, DemDataElementStoreNonVolatile=true
      Pid40BD (DemDidClass): DemDidIdentifier=16573, DemDidDataElementClassRef=VehSpdDat
      EpsMotCurr (DemDataElementClass)
        EpsMotCurrDat (DemExternalCSDataElementClass): DemDataElementDataSize=2, DemDataElementUsePort=true, DemUseEventIdArgumentForCallback=false, DemDataElementStoreNonVolatile=true
      Pid41D3 (DemDidClass): DemDidIdentifier=16851, DemDidDataElementClassRef=EpsMotCurrDat
      EpsMotCurrFb (DemDataElementClass)
        EpsMotCurrFbDat (DemExternalCSDataElementClass): DemDataElementDataSize=2, DemDataElementUsePort=true, DemUseEventIdArgumentForCallback=false, DemDataElementStoreNonVolatile=true
      Pid41D4 (DemDidClass): DemDidIdentifier=16852, DemDidDataElementClassRef=EpsMotCurrFbDat
      EpsTqOvrlSts (DemDataElementClass)
        EpsTqOvrlStsDat (DemExternalCSDataElementClass): DemDataElementDataSize=1, DemDataElementUsePort=true, DemUseEventIdArgumentForCallback=false, DemDataElementStoreNonVolatile=true
      Pid41D5 (DemDidClass): DemDidIdentifier=16853, DemDidDataElementClassRef=EpsTqOvrlStsDat
      EpsAgOvrlSts (DemDataElementClass)
        EpsAgOvrlStsDat (DemExternalCSDataElementClass): DemDataElementDataSize=1, DemDataElementUsePort=true, DemUseEventIdArgumentForCallback=false, DemDataElementStoreNonVolatile=true
      Pid41D6 (DemDidClass): DemDidIdentifier=16854, DemDidDataElementClassRef=EpsAgOvrlStsDat
      EpsTqOvrlReq (DemDataElementClass)
        EpsTqOvrlReqDat (DemExternalCSDataElementClass): DemDataElementDataSize=2, DemDataElementUsePort=true, DemUseEventIdArgumentForCallback=false, DemDataElementStoreNonVolatile=true
      Pid41D7 (DemDidClass): DemDidIdentifier=16855, DemDidDataElementClassRef=EpsTqOvrlReqDat
      SteerOutpTq (DemDataElementClass)
        SteerOutpTqDat (DemExternalCSDataElementClass): DemDataElementDataSize=2, DemDataElementUsePort=true, DemUseEventIdArgumentForCallback=false, DemDataElementStoreNonVolatile=true
      Pid41D9 (DemDidClass): DemDidIdentifier=16857, DemDidDataElementClassRef=SteerOutpTqDat
      EpsStopStrtSts (DemDataElementClass)
        EpsStopStrtStsDat (DemExternalCSDataElementClass): DemDataElementDataSize=1, DemDataElementUsePort=true, DemUseEventIdArgumentForCallback=false, DemDataElementStoreNonVolatile=true
      Pid43D0 (DemDidClass): DemDidIdentifier=17360, DemDidDataElementClassRef=EpsStopStrtStsDat
      EpsApaAgOvrlReq (DemDataElementClass)
        EpsApaAgOvrlReqDat (DemExternalCSDataElementClass): DemDataElementDataSize=2, DemDataElementUsePort=true, DemUseEventIdArgumentForCallback=false, DemDataElementStoreNonVolatile=true
      Pid446F (DemDidClass): DemDidIdentifier=17519, DemDidDataElementClassRef=EpsApaAgOvrlReqDat
      SysPwrMod (DemDataElementClass)
        SysPwrModDat (DemExternalCSDataElementClass): DemDataElementDataSize=1, DemDataElementUsePort=true, DemUseEventIdArgumentForCallback=false, DemDataElementStoreNonVolatile=true
      Pid8002 (DemDidClass): DemDidIdentifier=32770, DemDidDataElementClassRef=SysPwrModDat
      BattVltgEcu (DemDataElementClass)
        BattVltgEcuDat (DemExternalCSDataElementClass): DemDataElementDataSize=1, DemDataElementUsePort=true, DemUseEventIdArgumentForCallback=false, DemDataElementStoreNonVolatile=true
      Pid8078 (DemDidClass): DemDidIdentifier=32888, DemDidDataElementClassRef=BattVltgEcuDat
      SplrIntDtcInfo (DemDataElementClass)
        SplrIntDtcInfoDat (DemExternalCSDataElementClass): DemDataElementDataSize=4, DemDataElementUsePort=true, DemUseEventIdArgumentForCallback=false, DemDataElementStoreNonVolatile=true
      PidC000 (DemDidClass): DemDidIdentifier=49152, DemDidDataElementClassRef=SplrIntDtcInfoDat
      TiIgnOn (DemDataElementClass)
        TiIgnOnDat (DemExternalCSDataElementClass): DemDataElementDataSize=4, DemDataElementUsePort=true, DemUseEventIdArgumentForCallback=false, DemDataElementStoreNonVolatile=true
      PidC050 (DemDidClass): DemDidIdentifier=49232, DemDidDataElementClassRef=TiIgnOnDat
      30 x DemEnableConditionGroup:
        SteerWheelAgSnsrHwFltEna: DemEnableConditionRef=DemEnableConditionA, DemEnableConditionRef=DemEnableConditionB, DemEnableConditionRef=DemEnableConditionC, DemEnableConditionRef=DemEnableConditionE
        SteerWheelAgSnsrPlauslyEna: DemEnableConditionRef=DemEnableConditionA, DemEnableConditionRef=DemEnableConditionB, DemEnableConditionRef=DemEnableConditionC, DemEnableConditionRef=DemEnableConditionE, DemEnableConditionRef=DemEnableConditionI
        ElecSteerMotCircEna: DemEnableConditionRef=DemEnableConditionB, DemEnableConditionRef=DemEnableConditionC, DemEnableConditionRef=DemEnableConditionE
        ElecSteerMotPosSnsrCirEna: DemEnableConditionRef=DemEnableConditionC, DemEnableConditionRef=DemEnableConditionE
        SteerWhlTqInpSnsrEna: DemEnableConditionRef=DemEnableConditionC, DemEnableConditionRef=DemEnableConditionE, DemEnableConditionRef=DemEnableConditionI
        SteerWhlTqInpSnsrCalNoLrndEna: DemEnableConditionRef=DemEnableConditionA, DemEnableConditionRef=DemEnableConditionB, DemEnableConditionRef=DemEnableConditionC, DemEnableConditionRef=DemEnableConditionE, DemEnableConditionRef=DemEnableConditionI
        EcuHwPrfmcEna: DemEnableConditionRef=DemEnableConditionC, DemEnableConditionRef=DemEnableConditionE
        EcuSwPrfmcCalDataSetNotProgdEna: DemEnableConditionRef=DemEnableConditionA, DemEnableConditionRef=DemEnableConditionB, DemEnableConditionRef=DemEnableConditionC, DemEnableConditionRef=DemEnableConditionE, DemEnableConditionRef=DemEnableConditionI
        DevPwrVltgUnderThdEna: DemEnableConditionRef=DemEnableConditionA, DemEnableConditionRef=DemEnableConditionB, DemEnableConditionRef=DemEnableConditionI
        DevPwrVltgOverMaxThdEna: DemEnableConditionRef=DemEnableConditionA, DemEnableConditionRef=DemEnableConditionB, DemEnableConditionRef=DemEnableConditionI
        DevPwrVltgUnderMinThdEna: DemEnableConditionRef=DemEnableConditionA, DemEnableConditionRef=DemEnableConditionB, DemEnableConditionRef=DemEnableConditionI
        SteerFailrMtgtnLvl1LimpHomeModEna: DemEnableConditionRef=DemEnableConditionA, DemEnableConditionRef=DemEnableConditionB, DemEnableConditionRef=DemEnableConditionD, DemEnableConditionRef=DemEnableConditionE
        SteerFailrMtgtnLvl2LimpOverEna: DemEnableConditionRef=DemEnableConditionA, DemEnableConditionRef=DemEnableConditionB, DemEnableConditionRef=DemEnableConditionD, DemEnableConditionRef=DemEnableConditionE
        SteerFailrMtgtnLvl3FadeOutEna: DemEnableConditionRef=DemEnableConditionA, DemEnableConditionRef=DemEnableConditionB, DemEnableConditionRef=DemEnableConditionD, DemEnableConditionRef=DemEnableConditionE
        CtrlrComHiSpdBusOffEna: DemEnableConditionRef=DemEnableConditionD, DemEnableConditionRef=DemEnableConditionE, DemEnableConditionRef=DemEnableConditionK
        CtrlrComChassisExpBusOffEna: DemEnableConditionRef=DemEnableConditionA, DemEnableConditionRef=DemEnableConditionB, DemEnableConditionRef=DemEnableConditionD, DemEnableConditionRef=DemEnableConditionE
        LostComWithEngCtrlModEna: DemEnableConditionRef=DemEnableConditionA, DemEnableConditionRef=DemEnableConditionB, DemEnableConditionRef=DemEnableConditionD, DemEnableConditionRef=DemEnableConditionE, DemEnableConditionRef=DemEnableConditionF, DemEnableConditionRef=DemEnableConditionG, DemEnableConditionRef=DemEnableConditionI, DemEnableConditionRef=DemEnableConditionJ
        LostComWithTrsmCtrlModEna: DemEnableConditionRef=DemEnableConditionA, DemEnableConditionRef=DemEnableConditionB, DemEnableConditionRef=DemEnableConditionD, DemEnableConditionRef=DemEnableConditionE, DemEnableConditionRef=DemEnableConditionF, DemEnableConditionRef=DemEnableConditionI, DemEnableConditionRef=DemEnableConditionJ
        LostComWithElecBrkCtrlModEna: DemEnableConditionRef=DemEnableConditionA, DemEnableConditionRef=DemEnableConditionB, DemEnableConditionRef=DemEnableConditionD, DemEnableConditionRef=DemEnableConditionE, DemEnableConditionRef=DemEnableConditionF, DemEnableConditionRef=DemEnableConditionG, DemEnableConditionRef=DemEnableConditionI, DemEnableConditionRef=DemEnableConditionJ
        LostComWithBodyCtrlModEna: DemEnableConditionRef=DemEnableConditionA, DemEnableConditionRef=DemEnableConditionB, DemEnableConditionRef=DemEnableConditionD, DemEnableConditionRef=DemEnableConditionE, DemEnableConditionRef=DemEnableConditionF, DemEnableConditionRef=DemEnableConditionG, DemEnableConditionRef=DemEnableConditionI, DemEnableConditionRef=DemEnableConditionJ
        LostComWithParkAssiCtrlModEna: DemEnableConditionRef=DemEnableConditionA, DemEnableConditionRef=DemEnableConditionB, DemEnableConditionRef=DemEnableConditionD, DemEnableConditionRef=DemEnableConditionE, DemEnableConditionRef=DemEnableConditionF, DemEnableConditionRef=DemEnableConditionH, DemEnableConditionRef=DemEnableConditionI, DemEnableConditionRef=DemEnableConditionJ
        LostComWithFrntCameraCtrlModEna: DemEnableConditionRef=DemEnableConditionA, DemEnableConditionRef=DemEnableConditionB, DemEnableConditionRef=DemEnableConditionD, DemEnableConditionRef=DemEnableConditionE, DemEnableConditionRef=DemEnableConditionF, DemEnableConditionRef=DemEnableConditionG, DemEnableConditionRef=DemEnableConditionI, DemEnableConditionRef=DemEnableConditionJ
        InvldDataRxdFromEngCtrlModEna: DemEnableConditionRef=DemEnableConditionA, DemEnableConditionRef=DemEnableConditionB, DemEnableConditionRef=DemEnableConditionD, DemEnableConditionRef=DemEnableConditionE, DemEnableConditionRef=DemEnableConditionF, DemEnableConditionRef=DemEnableConditionI, DemEnableConditionRef=DemEnableConditionJ
        InvldDataRxdFromTrsmCtrlModEna: DemEnableConditionRef=DemEnableConditionA, DemEnableConditionRef=DemEnableConditionB, DemEnableConditionRef=DemEnableConditionD, DemEnableConditionRef=DemEnableConditionE, DemEnableConditionRef=DemEnableConditionF, DemEnableConditionRef=DemEnableConditionI, DemEnableConditionRef=DemEnableConditionG, DemEnableConditionRef=DemEnableConditionJ
        InvldDataRxdFromElecBrkCtrlModEna: DemEnableConditionRef=DemEnableConditionA, DemEnableConditionRef=DemEnableConditionB, DemEnableConditionRef=DemEnableConditionD, DemEnableConditionRef=DemEnableConditionE, DemEnableConditionRef=DemEnableConditionF, DemEnableConditionRef=DemEnableConditionI, DemEnableConditionRef=DemEnableConditionJ
        InvldDataRxdFromBodtCtrlModEna: DemEnableConditionRef=DemEnableConditionA, DemEnableConditionRef=DemEnableConditionB, DemEnableConditionRef=DemEnableConditionD, DemEnableConditionRef=DemEnableConditionE, DemEnableConditionRef=DemEnableConditionF, DemEnableConditionRef=DemEnableConditionI, DemEnableConditionRef=DemEnableConditionJ
        InvldDataRxdFromParkAssiCtrlModEna: DemEnableConditionRef=DemEnableConditionA, DemEnableConditionRef=DemEnableConditionB, DemEnableConditionRef=DemEnableConditionD, DemEnableConditionRef=DemEnableConditionE, DemEnableConditionRef=DemEnableConditionF, DemEnableConditionRef=DemEnableConditionI, DemEnableConditionRef=DemEnableConditionJ
        InvldDataRxdFromFrntCameraModEna: DemEnableConditionRef=DemEnableConditionA, DemEnableConditionRef=DemEnableConditionB, DemEnableConditionRef=DemEnableConditionD, DemEnableConditionRef=DemEnableConditionE, DemEnableConditionRef=DemEnableConditionF, DemEnableConditionRef=DemEnableConditionI, DemEnableConditionRef=DemEnableConditionJ
        LostComWithElecBrkCtrlModChassisExpEna: DemEnableConditionRef=DemEnableConditionA, DemEnableConditionRef=DemEnableConditionB, DemEnableConditionRef=DemEnableConditionD, DemEnableConditionRef=DemEnableConditionE, DemEnableConditionRef=DemEnableConditionF, DemEnableConditionRef=DemEnableConditionH, DemEnableConditionRef=DemEnableConditionI, DemEnableConditionRef=DemEnableConditionJ
        InvldDataRxdFromElecBrkCtrlModChassisExpEna: DemEnableConditionRef=DemEnableConditionA, DemEnableConditionRef=DemEnableConditionB, DemEnableConditionRef=DemEnableConditionD, DemEnableConditionRef=DemEnableConditionE, DemEnableConditionRef=DemEnableConditionF, DemEnableConditionRef=DemEnableConditionI, DemEnableConditionRef=DemEnableConditionJ
      3 x DemIndicator:
        SteerAssiLimd: DemIndicatorID=2
        SteerAssiLimdLvl2: DemIndicatorID=3
        SteerAssiLimdLvl3: DemIndicatorID=0
      DemCallbackDTCStatusChanged
      DemEnableConditionJ (DemEnableCondition): DemEnableConditionId=11, DemEnableConditionStatus=true
      DemEnableConditionK (DemEnableCondition): DemEnableConditionId=1, DemEnableConditionStatus=true
    DemConfigSet
      26 x DemEventParameter, all with DemEventAvailable=true, DemEventAvailableInVariant=true, DemEventLatchTestFailed=false, DemEventTimeSeries=DEM_TIMESERIES_SNAPSHOT_NONE:
        FLS_E_COMPARE_FAILED: DemEventId=33, DemEventKind=DEM_EVENT_KIND_BSW
          DemEventClass:
            DemAgingAllowed = false
            DemConsiderPtoStatus = false
            DemEventDestination = DEM_DTC_ORIGIN_PRIMARY_MEMORY
            DemEventPriority = 2
            DemFFPrestorageSupported = false
            DemOperationCycleRef = PowerCycle
            DemDebounceAlgorithmClass
              DemDebounceCounterBased:
                DemDebounceBehavior = DEM_DEBOUNCE_FREEZE
                DemDebounceCounterDecrementStepSize = 1
                DemDebounceCounterFailedThreshold = 127
                DemDebounceCounterIncrementStepSize = 1
                DemDebounceCounterJumpDown = true
                DemDebounceCounterJumpDownValue = 0
                DemDebounceCounterJumpUp = true
                DemDebounceCounterJumpUpValue = 0
                DemDebounceCounterPassedThreshold = -128
                DemDebounceCounterStorage = false
                DemDebounceContinuous = false
        FLS_E_ERASE_FAILED: DemEventId=34, DemEventKind=DEM_EVENT_KIND_BSW
          DemEventClass:
            DemAgingAllowed = false
            DemConsiderPtoStatus = false
            DemEventDestination = DEM_DTC_ORIGIN_PRIMARY_MEMORY
            DemEventPriority = 2
            DemFFPrestorageSupported = false
            DemOperationCycleRef = PowerCycle
            DemDebounceAlgorithmClass
              DemDebounceCounterBased:
                DemDebounceBehavior = DEM_DEBOUNCE_FREEZE
                DemDebounceCounterDecrementStepSize = 1
                DemDebounceCounterFailedThreshold = 127
                DemDebounceCounterIncrementStepSize = 1
                DemDebounceCounterJumpDown = true
                DemDebounceCounterJumpDownValue = 0
                DemDebounceCounterJumpUp = true
                DemDebounceCounterJumpUpValue = 0
                DemDebounceCounterPassedThreshold = -128
                DemDebounceCounterStorage = false
                DemDebounceContinuous = false
        FLS_E_READ_FAILED: DemEventId=35, DemEventKind=DEM_EVENT_KIND_BSW
          DemEventClass:
            DemAgingAllowed = false
            DemConsiderPtoStatus = false
            DemEventDestination = DEM_DTC_ORIGIN_PRIMARY_MEMORY
            DemEventPriority = 2
            DemFFPrestorageSupported = false
            DemOperationCycleRef = PowerCycle
            DemDebounceAlgorithmClass
              DemDebounceCounterBased:
                DemDebounceBehavior = DEM_DEBOUNCE_FREEZE
                DemDebounceCounterDecrementStepSize = 1
                DemDebounceCounterFailedThreshold = 127
                DemDebounceCounterIncrementStepSize = 1
                DemDebounceCounterJumpDown = true
                DemDebounceCounterJumpDownValue = 0
                DemDebounceCounterJumpUp = true
                DemDebounceCounterJumpUpValue = 0
                DemDebounceCounterPassedThreshold = -128
                DemDebounceCounterStorage = false
                DemDebounceContinuous = false
        FLS_E_READ_FAILED_DED: DemEventId=36, DemEventKind=DEM_EVENT_KIND_BSW
          DemEventClass:
            DemAgingAllowed = false
            DemConsiderPtoStatus = false
            DemEventDestination = DEM_DTC_ORIGIN_PRIMARY_MEMORY
            DemEventPriority = 2
            DemFFPrestorageSupported = false
            DemOperationCycleRef = PowerCycle
            DemDebounceAlgorithmClass
              DemDebounceCounterBased:
                DemDebounceBehavior = DEM_DEBOUNCE_FREEZE
                DemDebounceCounterDecrementStepSize = 1
                DemDebounceCounterFailedThreshold = 127
                DemDebounceCounterIncrementStepSize = 1
                DemDebounceCounterJumpDown = true
                DemDebounceCounterJumpDownValue = 0
                DemDebounceCounterJumpUp = true
                DemDebounceCounterJumpUpValue = 0
                DemDebounceCounterPassedThreshold = -128
                DemDebounceCounterStorage = false
                DemDebounceContinuous = false
        FLS_E_WRITE_FAILED: DemEventId=37, DemEventKind=DEM_EVENT_KIND_BSW
          DemEventClass:
            DemAgingAllowed = false
            DemConsiderPtoStatus = false
            DemEventDestination = DEM_DTC_ORIGIN_PRIMARY_MEMORY
            DemEventPriority = 2
            DemFFPrestorageSupported = false
            DemOperationCycleRef = PowerCycle
            DemDebounceAlgorithmClass
              DemDebounceCounterBased:
                DemDebounceBehavior = DEM_DEBOUNCE_FREEZE
                DemDebounceCounterDecrementStepSize = 1
                DemDebounceCounterFailedThreshold = 127
                DemDebounceCounterIncrementStepSize = 1
                DemDebounceCounterJumpDown = true
                DemDebounceCounterJumpDownValue = 0
                DemDebounceCounterJumpUp = true
                DemDebounceCounterJumpUpValue = 0
                DemDebounceCounterPassedThreshold = -128
                DemDebounceCounterStorage = false
                DemDebounceContinuous = false
        MCU_E_CLM_SELFDIAG_FAILURE: DemEventId=38, DemEventKind=DEM_EVENT_KIND_BSW
          DemEventClass:
            DemAgingAllowed = false
            DemConsiderPtoStatus = false
            DemEventDestination = DEM_DTC_ORIGIN_PRIMARY_MEMORY
            DemEventPriority = 2
            DemFFPrestorageSupported = false
            DemOperationCycleRef = PowerCycle
            DemDebounceAlgorithmClass
              DemDebounceCounterBased:
                DemDebounceBehavior = DEM_DEBOUNCE_FREEZE
                DemDebounceCounterDecrementStepSize = 1
                DemDebounceCounterFailedThreshold = 127
                DemDebounceCounterIncrementStepSize = 1
                DemDebounceCounterJumpDown = true
                DemDebounceCounterJumpDownValue = 0
                DemDebounceCounterJumpUp = true
                DemDebounceCounterJumpUpValue = 0
                DemDebounceCounterPassedThreshold = -128
                DemDebounceCounterStorage = false
                DemDebounceContinuous = false
        MCU_E_CLOCK_FAILURE: DemEventId=39, DemEventKind=DEM_EVENT_KIND_BSW
          DemEventClass:
            DemAgingAllowed = false
            DemConsiderPtoStatus = false
            DemEventDestination = DEM_DTC_ORIGIN_PRIMARY_MEMORY
            DemEventPriority = 2
            DemFFPrestorageSupported = false
            DemOperationCycleRef = PowerCycle
            DemDebounceAlgorithmClass
              DemDebounceCounterBased:
                DemDebounceBehavior = DEM_DEBOUNCE_FREEZE
                DemDebounceCounterDecrementStepSize = 1
                DemDebounceCounterFailedThreshold = 127
                DemDebounceCounterIncrementStepSize = 1
                DemDebounceCounterJumpDown = true
                DemDebounceCounterJumpDownValue = 0
                DemDebounceCounterJumpUp = true
                DemDebounceCounterJumpUpValue = 0
                DemDebounceCounterPassedThreshold = -128
                DemDebounceCounterStorage = false
                DemDebounceContinuous = false
        MCU_E_CVM_SELFDIAG_FAILURE: DemEventId=40, DemEventKind=DEM_EVENT_KIND_BSW
          DemEventClass:
            DemAgingAllowed = false
            DemConsiderPtoStatus = false
            DemEventDestination = DEM_DTC_ORIGIN_PRIMARY_MEMORY
            DemEventPriority = 2
            DemFFPrestorageSupported = false
            DemOperationCycleRef = PowerCycle
            DemDebounceAlgorithmClass
              DemDebounceCounterBased:
                DemDebounceBehavior = DEM_DEBOUNCE_FREEZE
                DemDebounceCounterDecrementStepSize = 1
                DemDebounceCounterFailedThreshold = 127
                DemDebounceCounterIncrementStepSize = 1
                DemDebounceCounterJumpDown = true
                DemDebounceCounterJumpDownValue = 0
                DemDebounceCounterJumpUp = true
                DemDebounceCounterJumpUpValue = 0
                DemDebounceCounterPassedThreshold = -128
                DemDebounceCounterStorage = false
                DemDebounceContinuous = false
        MCU_E_ECM_SELFDIAG_FAILURE: DemEventId=56, DemEventKind=DEM_EVENT_KIND_BSW
          DemEventClass:
            DemAgingAllowed = false
            DemConsiderPtoStatus = false
            DemEventDestination = DEM_DTC_ORIGIN_PRIMARY_MEMORY
            DemEventPriority = 2
            DemFFPrestorageSupported = false
            DemOperationCycleRef = PowerCycle
            DemDebounceAlgorithmClass
              DemDebounceCounterBased:
                DemDebounceBehavior = DEM_DEBOUNCE_FREEZE
                DemDebounceCounterDecrementStepSize = 1
                DemDebounceCounterFailedThreshold = 127
                DemDebounceCounterIncrementStepSize = 1
                DemDebounceCounterJumpDown = true
                DemDebounceCounterJumpDownValue = 0
                DemDebounceCounterJumpUp = true
                DemDebounceCounterJumpUpValue = 0
                DemDebounceCounterPassedThreshold = -128
                DemDebounceCounterStorage = false
                DemDebounceContinuous = false
        MCU_E_LOCKSTEP_SELFDIAG_FAILURE: DemEventId=57, DemEventKind=DEM_EVENT_KIND_BSW
          DemEventClass:
            DemAgingAllowed = false
            DemConsiderPtoStatus = false
            DemEventDestination = DEM_DTC_ORIGIN_PRIMARY_MEMORY
            DemEventPriority = 2
            DemFFPrestorageSupported = false
            DemOperationCycleRef = PowerCycle
            DemDebounceAlgorithmClass
              DemDebounceCounterBased:
                DemDebounceBehavior = DEM_DEBOUNCE_FREEZE
                DemDebounceCounterDecrementStepSize = 1
                DemDebounceCounterFailedThreshold = 127
                DemDebounceCounterIncrementStepSize = 1
                DemDebounceCounterJumpDown = true
                DemDebounceCounterJumpDownValue = 0
                DemDebounceCounterJumpUp = true
                DemDebounceCounterJumpUpValue = 0
                DemDebounceCounterPassedThreshold = -128
                DemDebounceCounterStorage = false
                DemDebounceContinuous = false
        MCU_E_WRITE_TIMEOUT_FAILURE: DemEventId=41, DemEventKind=DEM_EVENT_KIND_BSW
          DemEventClass:
            DemAgingAllowed = false
            DemConsiderPtoStatus = false
            DemEventDestination = DEM_DTC_ORIGIN_PRIMARY_MEMORY
            DemEventPriority = 2
            DemFFPrestorageSupported = false
            DemOperationCycleRef = PowerCycle
            DemDebounceAlgorithmClass
              DemDebounceCounterBased:
                DemDebounceBehavior = DEM_DEBOUNCE_FREEZE
                DemDebounceCounterDecrementStepSize = 1
                DemDebounceCounterFailedThreshold = 127
                DemDebounceCounterIncrementStepSize = 1
                DemDebounceCounterJumpDown = true
                DemDebounceCounterJumpDownValue = 0
                DemDebounceCounterJumpUp = true
                DemDebounceCounterJumpUpValue = 0
                DemDebounceCounterPassedThreshold = -128
                DemDebounceCounterStorage = false
                DemDebounceContinuous = false
        NVM_E_INTEGRITY_FAILED: DemEventId=42, DemEventKind=DEM_EVENT_KIND_BSW
          DemEventClass:
            DemAgingAllowed = false
            DemConsiderPtoStatus = false
            DemEventDestination = DEM_DTC_ORIGIN_PRIMARY_MEMORY
            DemEventPriority = 2
            DemFFPrestorageSupported = false
            DemOperationCycleRef = PowerCycle
            DemDebounceAlgorithmClass
              DemDebounceCounterBased:
                DemDebounceBehavior = DEM_DEBOUNCE_FREEZE
                DemDebounceCounterDecrementStepSize = 1
                DemDebounceCounterFailedThreshold = 127
                DemDebounceCounterIncrementStepSize = 1
                DemDebounceCounterJumpDown = true
                DemDebounceCounterJumpDownValue = 0
                DemDebounceCounterJumpUp = true
                DemDebounceCounterJumpUpValue = 0
                DemDebounceCounterPassedThreshold = -128
                DemDebounceCounterStorage = false
                DemDebounceContinuous = false
        NVM_E_LOSS_OF_REDUNDANCY: DemEventId=43, DemEventKind=DEM_EVENT_KIND_BSW
          DemEventClass:
            DemAgingAllowed = false
            DemConsiderPtoStatus = false
            DemEventDestination = DEM_DTC_ORIGIN_PRIMARY_MEMORY
            DemEventPriority = 2
            DemFFPrestorageSupported = false
            DemOperationCycleRef = PowerCycle
            DemDebounceAlgorithmClass
              DemDebounceCounterBased:
                DemDebounceBehavior = DEM_DEBOUNCE_FREEZE
                DemDebounceCounterDecrementStepSize = 1
                DemDebounceCounterFailedThreshold = 127
                DemDebounceCounterIncrementStepSize = 1
                DemDebounceCounterJumpDown = true
                DemDebounceCounterJumpDownValue = 0
                DemDebounceCounterJumpUp = true
                DemDebounceCounterJumpUpValue = 0
                DemDebounceCounterPassedThreshold = -128
                DemDebounceCounterStorage = false
                DemDebounceContinuous = false
        NVM_E_QUEUE_OVERFLOW: DemEventId=44, DemEventKind=DEM_EVENT_KIND_BSW
          DemEventClass:
            DemAgingAllowed = false
            DemConsiderPtoStatus = false
            DemEventDestination = DEM_DTC_ORIGIN_PRIMARY_MEMORY
            DemEventPriority = 2
            DemFFPrestorageSupported = false
            DemOperationCycleRef = PowerCycle
            DemDebounceAlgorithmClass
              DemDebounceCounterBased:
                DemDebounceBehavior = DEM_DEBOUNCE_FREEZE
                DemDebounceCounterDecrementStepSize = 1
                DemDebounceCounterFailedThreshold = 127
                DemDebounceCounterIncrementStepSize = 1
                DemDebounceCounterJumpDown = true
                DemDebounceCounterJumpDownValue = 0
                DemDebounceCounterJumpUp = true
                DemDebounceCounterJumpUpValue = 0
                DemDebounceCounterPassedThreshold = -128
                DemDebounceCounterStorage = false
                DemDebounceContinuous = false
        NVM_E_REQ_FAILED: DemEventId=45, DemEventKind=DEM_EVENT_KIND_BSW
          DemEventClass:
            DemAgingAllowed = false
            DemConsiderPtoStatus = false
            DemEventDestination = DEM_DTC_ORIGIN_PRIMARY_MEMORY
            DemEventPriority = 2
            DemFFPrestorageSupported = false
            DemOperationCycleRef = PowerCycle
            DemDebounceAlgorithmClass
              DemDebounceCounterBased:
                DemDebounceBehavior = DEM_DEBOUNCE_FREEZE
                DemDebounceCounterDecrementStepSize = 1
                DemDebounceCounterFailedThreshold = 127
                DemDebounceCounterIncrementStepSize = 1
                DemDebounceCounterJumpDown = true
                DemDebounceCounterJumpDownValue = 0
                DemDebounceCounterJumpUp = true
                DemDebounceCounterJumpUpValue = 0
                DemDebounceCounterPassedThreshold = -128
                DemDebounceCounterStorage = false
                DemDebounceContinuous = false
        NVM_E_WRITE_PROTECTED: DemEventId=47, DemEventKind=DEM_EVENT_KIND_BSW
          DemEventClass:
            DemAgingAllowed = false
            DemConsiderPtoStatus = false
            DemEventDestination = DEM_DTC_ORIGIN_PRIMARY_MEMORY
            DemEventPriority = 2
            DemFFPrestorageSupported = false
            DemOperationCycleRef = PowerCycle
            DemDebounceAlgorithmClass
              DemDebounceCounterBased:
                DemDebounceBehavior = DEM_DEBOUNCE_FREEZE
                DemDebounceCounterDecrementStepSize = 1
                DemDebounceCounterFailedThreshold = 127
                DemDebounceCounterIncrementStepSize = 1
                DemDebounceCounterJumpDown = true
                DemDebounceCounterJumpDownValue = 0
                DemDebounceCounterJumpUp = true
                DemDebounceCounterJumpUpValue = 0
                DemDebounceCounterPassedThreshold = -128
                DemDebounceCounterStorage = false
                DemDebounceContinuous = false
        PORT_E_WRITE_TIMEOUT_FAILURE: DemEventId=49, DemEventKind=DEM_EVENT_KIND_BSW
          DemEventClass:
            DemAgingAllowed = false
            DemConsiderPtoStatus = false
            DemEventDestination = DEM_DTC_ORIGIN_PRIMARY_MEMORY
            DemEventPriority = 2
            DemFFPrestorageSupported = false
            DemOperationCycleRef = PowerCycle
            DemDebounceAlgorithmClass
              DemDebounceCounterBased:
                DemDebounceBehavior = DEM_DEBOUNCE_FREEZE
                DemDebounceCounterDecrementStepSize = 1
                DemDebounceCounterFailedThreshold = 127
                DemDebounceCounterIncrementStepSize = 1
                DemDebounceCounterJumpDown = true
                DemDebounceCounterJumpDownValue = 0
                DemDebounceCounterJumpUp = true
                DemDebounceCounterJumpUpValue = 0
                DemDebounceCounterPassedThreshold = -128
                DemDebounceCounterStorage = false
                DemDebounceContinuous = false
        SPI_E_DATA_TX_TIMEOUT_FAILURE: DemEventId=50, DemEventKind=DEM_EVENT_KIND_BSW
          DemEventClass:
            DemAgingAllowed = false
            DemConsiderPtoStatus = false
            DemEventDestination = DEM_DTC_ORIGIN_PRIMARY_MEMORY
            DemEventPriority = 2
            DemFFPrestorageSupported = false
            DemOperationCycleRef = PowerCycle
            DemDebounceAlgorithmClass
              DemDebounceCounterBased:
                DemDebounceBehavior = DEM_DEBOUNCE_FREEZE
                DemDebounceCounterDecrementStepSize = 1
                DemDebounceCounterFailedThreshold = 127
                DemDebounceCounterIncrementStepSize = 1
                DemDebounceCounterJumpDown = true
                DemDebounceCounterJumpDownValue = 0
                DemDebounceCounterJumpUp = true
                DemDebounceCounterJumpUpValue = 0
                DemDebounceCounterPassedThreshold = -128
                DemDebounceCounterStorage = false
                DemDebounceContinuous = false
        SPI_E_HARDWARE_ERROR: DemEventId=51, DemEventKind=DEM_EVENT_KIND_BSW
          DemEventClass:
            DemAgingAllowed = false
            DemConsiderPtoStatus = false
            DemEventDestination = DEM_DTC_ORIGIN_PRIMARY_MEMORY
            DemEventPriority = 2
            DemFFPrestorageSupported = false
            DemOperationCycleRef = PowerCycle
            DemDebounceAlgorithmClass
              DemDebounceCounterBased:
                DemDebounceBehavior = DEM_DEBOUNCE_FREEZE
                DemDebounceCounterDecrementStepSize = 1
                DemDebounceCounterFailedThreshold = 127
                DemDebounceCounterIncrementStepSize = 1
                DemDebounceCounterJumpDown = true
                DemDebounceCounterJumpDownValue = 0
                DemDebounceCounterJumpUp = true
                DemDebounceCounterJumpUpValue = 0
                DemDebounceCounterPassedThreshold = -128
                DemDebounceCounterStorage = false
                DemDebounceContinuous = false
        WDG_E_DISABLE_REJECTED: DemEventId=52, DemEventKind=DEM_EVENT_KIND_BSW
          DemEventClass:
            DemAgingAllowed = false
            DemConsiderPtoStatus = false
            DemEventDestination = DEM_DTC_ORIGIN_PRIMARY_MEMORY
            DemEventPriority = 2
            DemFFPrestorageSupported = false
            DemOperationCycleRef = PowerCycle
            DemDebounceAlgorithmClass
              DemDebounceCounterBased:
                DemDebounceBehavior = DEM_DEBOUNCE_FREEZE
                DemDebounceCounterDecrementStepSize = 1
                DemDebounceCounterFailedThreshold = 127
                DemDebounceCounterIncrementStepSize = 1
                DemDebounceCounterJumpDown = true
                DemDebounceCounterJumpDownValue = 0
                DemDebounceCounterJumpUp = true
                DemDebounceCounterJumpUpValue = 0
                DemDebounceCounterPassedThreshold = -128
                DemDebounceCounterStorage = false
                DemDebounceContinuous = false
        WDG_E_MODE_FAILED: DemEventId=53, DemEventKind=DEM_EVENT_KIND_BSW
          DemEventClass:
            DemAgingAllowed = false
            DemConsiderPtoStatus = false
            DemEventDestination = DEM_DTC_ORIGIN_PRIMARY_MEMORY
            DemEventPriority = 2
            DemFFPrestorageSupported = false
            DemOperationCycleRef = PowerCycle
            DemDebounceAlgorithmClass
              DemDebounceCounterBased:
                DemDebounceBehavior = DEM_DEBOUNCE_FREEZE
                DemDebounceCounterDecrementStepSize = 1
                DemDebounceCounterFailedThreshold = 127
                DemDebounceCounterIncrementStepSize = 1
                DemDebounceCounterJumpDown = true
                DemDebounceCounterJumpDownValue = 0
                DemDebounceCounterJumpUp = true
                DemDebounceCounterJumpUpValue = 0
                DemDebounceCounterPassedThreshold = -128
                DemDebounceCounterStorage = false
                DemDebounceContinuous = false
        WDG_E_READBACK_FAILURE: DemEventId=54, DemEventKind=DEM_EVENT_KIND_BSW
          DemEventClass:
            DemAgingAllowed = false
            DemConsiderPtoStatus = false
            DemEventDestination = DEM_DTC_ORIGIN_PRIMARY_MEMORY
            DemEventPriority = 2
            DemFFPrestorageSupported = false
            DemOperationCycleRef = PowerCycle
            DemDebounceAlgorithmClass
              DemDebounceCounterBased:
                DemDebounceBehavior = DEM_DEBOUNCE_FREEZE
                DemDebounceCounterDecrementStepSize = 1
                DemDebounceCounterFailedThreshold = 127
                DemDebounceCounterIncrementStepSize = 1
                DemDebounceCounterJumpDown = true
                DemDebounceCounterJumpDownValue = 0
                DemDebounceCounterJumpUp = true
                DemDebounceCounterJumpUpValue = 0
                DemDebounceCounterPassedThreshold = -128
                DemDebounceCounterStorage = false
                DemDebounceContinuous = false
        WDG_E_TRIGGER_TIMEOUT: DemEventId=55, DemEventKind=DEM_EVENT_KIND_BSW
          DemEventClass:
            DemAgingAllowed = false
            DemConsiderPtoStatus = false
            DemEventDestination = DEM_DTC_ORIGIN_PRIMARY_MEMORY
            DemEventPriority = 2
            DemFFPrestorageSupported = false
            DemOperationCycleRef = PowerCycle
            DemDebounceAlgorithmClass
              DemDebounceCounterBased:
                DemDebounceBehavior = DEM_DEBOUNCE_FREEZE
                DemDebounceCounterDecrementStepSize = 1
                DemDebounceCounterFailedThreshold = 127
                DemDebounceCounterIncrementStepSize = 1
                DemDebounceCounterJumpDown = true
                DemDebounceCounterJumpDownValue = 0
                DemDebounceCounterJumpUp = true
                DemDebounceCounterJumpUpValue = 0
                DemDebounceCounterPassedThreshold = -128
                DemDebounceCounterStorage = false
                DemDebounceContinuous = false
        NVM_E_VERIFY_FAILED: DemEventId=46, DemEventKind=DEM_EVENT_KIND_BSW
          DemEventClass:
            DemAgingAllowed = false
            DemConsiderPtoStatus = false
            DemEventDestination = DEM_DTC_ORIGIN_PRIMARY_MEMORY
            DemEventPriority = 2
            DemFFPrestorageSupported = false
            DemOperationCycleRef = PowerCycle
            DemDebounceAlgorithmClass
              DemDebounceCounterBased:
                DemDebounceBehavior = DEM_DEBOUNCE_FREEZE
                DemDebounceCounterDecrementStepSize = 1
                DemDebounceCounterFailedThreshold = 127
                DemDebounceCounterIncrementStepSize = 1
                DemDebounceCounterJumpDown = true
                DemDebounceCounterJumpDownValue = 0
                DemDebounceCounterJumpUp = true
                DemDebounceCounterJumpUpValue = 0
                DemDebounceCounterPassedThreshold = -128
                DemDebounceCounterStorage = false
                DemDebounceContinuous = false
        NVM_E_WRONG_BLOCK_ID: DemEventId=48, DemEventKind=DEM_EVENT_KIND_BSW
          DemEventClass:
            DemAgingAllowed = false
            DemConsiderPtoStatus = false
            DemEventDestination = DEM_DTC_ORIGIN_PRIMARY_MEMORY
            DemEventPriority = 2
            DemFFPrestorageSupported = false
            DemOperationCycleRef = PowerCycle
            DemDebounceAlgorithmClass
              DemDebounceCounterBased:
                DemDebounceBehavior = DEM_DEBOUNCE_FREEZE
                DemDebounceCounterDecrementStepSize = 1
                DemDebounceCounterFailedThreshold = 127
                DemDebounceCounterIncrementStepSize = 1
                DemDebounceCounterJumpDown = true
                DemDebounceCounterJumpDownValue = 0
                DemDebounceCounterJumpUp = true
                DemDebounceCounterJumpUpValue = 0
                DemDebounceCounterPassedThreshold = -128
                DemDebounceCounterStorage = false
                DemDebounceContinuous = false
        DevPwrVltgUnderMinThd: DemEventId=32, DemEventKind=DEM_EVENT_KIND_SWC, DemMaxNumberFreezeFrameRecords=1, DemDTCClassRef=DevPwrVltgUnderMinThdClass, DemFreezeFrameClassRef=DemFreezeFrameClass
          DemEventClass:
            DemAgingAllowed = true
            DemConsiderPtoStatus = false
            DemEventDestination = DEM_DTC_ORIGIN_PRIMARY_MEMORY
            DemEventPriority = 2
            DemFFPrestorageSupported = false
            DemAgingCycleCounterThreshold = 50
            DemOperationCycleRef = PowerCycle
            DemEnableConditionGroupRef = DevPwrVltgUnderMinThdEna
            DemAgingCycleRef = PowerCycle
            DemDebounceAlgorithmClass
              DemDebounceCounterBased:
                DemDebounceBehavior = DEM_DEBOUNCE_FREEZE
                DemDebounceCounterDecrementStepSize = 1
                DemDebounceCounterFailedThreshold = 127
                DemDebounceCounterIncrementStepSize = 1
                DemDebounceCounterJumpDown = true
                DemDebounceCounterJumpDownValue = 0
                DemDebounceCounterJumpUp = true
                DemDebounceCounterJumpUpValue = 0
                DemDebounceCounterPassedThreshold = -128
                DemDebounceCounterStorage = false
                DemDebounceContinuous = false
            PwrSteerIndcr (DemIndicatorAttribute):
              DemIndicatorFailureCycleSource = DEM_FAILURE_CYCLE_EVENT
              DemIndicatorBehaviour = DEM_INDICATOR_CONTINUOUS
              DemIndicatorHealingCycleCounterThreshold = 0
              DemIndicatorHealingCycleRef = PowerCycle
              DemIndicatorRef = DemGeneral/PwrSteerIndcr
      DevPwrVltgUnderMinThdClass (DemDTCClass): DemImmediateNvStorage=false, DemUdsDTC=4718610
      SysThermErrTHi (DemEventParameter):
        DemEventAvailable = true
        DemEventId = 2
        DemEventKind = DEM_EVENT_KIND_SWC
        DemEventAvailableInVariant = true
        DemEventLatchTestFailed = false
        DemMaxNumberFreezeFrameRecords = 1
        DemEventTimeSeries = DEM_TIMESERIES_SNAPSHOT_NONE
        DemDTCClassRef = SysThermErrTHiClass
        DemFreezeFrameClassRef = DemFreezeFrameClass
        DemEventClass:
          DemAgingAllowed = true
          DemConsiderPtoStatus = false
          DemEventDestination = DEM_DTC_ORIGIN_PRIMARY_MEMORY
          DemEventPriority = 2
          DemFFPrestorageSupported = false
          DemAgingCycleCounterThreshold = 50
          DemOperationCycleRef = PowerCycle
          DemEnableConditionGroupRef = SysThermErrTHiEna
          DemAgingCycleRef = PowerCycle
          DemDebounceAlgorithmClass
            DemDebounceCounterBased:
              DemDebounceBehavior = DEM_DEBOUNCE_FREEZE
              DemDebounceCounterDecrementStepSize = 1
              DemDebounceCounterFailedThreshold = 127
              DemDebounceCounterIncrementStepSize = 1
              DemDebounceCounterJumpDown = true
              DemDebounceCounterJumpDownValue = 0
              DemDebounceCounterJumpUp = true
              DemDebounceCounterJumpUpValue = 0
              DemDebounceCounterPassedThreshold = -128
              DemDebounceCounterStorage = false
              DemDebounceContinuous = false
          IndcrSteerAssiLimd (DemIndicatorAttribute):
            DemIndicatorFailureCycleSource = DEM_FAILURE_CYCLE_EVENT
            DemIndicatorBehaviour = DEM_INDICATOR_CONTINUOUS
            DemIndicatorHealingCycleCounterThreshold = 0
            DemIndicatorHealingCycleRef = PowerCycle
            DemIndicatorRef = DemGeneral/PwrSteerIndcr
      SysThermErrTHiClass (DemDTCClass): DemImmediateNvStorage=false, DemUdsDTC=4290132
      SteerWheelAgSnsrCalNorPrfmd (DemEventParameter):
        DemEventAvailable = true
        DemEventId = 1
        DemEventKind = DEM_EVENT_KIND_SWC
        DemEventAvailableInVariant = true
        DemEventLatchTestFailed = false
        DemMaxNumberFreezeFrameRecords = 1
        DemEventTimeSeries = DEM_TIMESERIES_SNAPSHOT_NONE
        DemDTCClassRef = SteerWheelAgSnsrCalNorPrfmdClass
        DemFreezeFrameClassRef = DemFreezeFrameClass
        DemEventClass:
          DemAgingAllowed = true
          DemConsiderPtoStatus = false
          DemEventDestination = DEM_DTC_ORIGIN_PRIMARY_MEMORY
          DemEventPriority = 2
          DemFFPrestorageSupported = false
          DemAgingCycleCounterThreshold = 50
          DemOperationCycleRef = PowerCycle
          DemAgingCycleRef = PowerCycle
          DemEnableConditionGroupRef = SteerWheelAgSnsrCalNorPrfmdEna
          DemDebounceAlgorithmClass
            DemDebounceCounterBased:
              DemDebounceBehavior = DEM_DEBOUNCE_FREEZE
              DemDebounceCounterDecrementStepSize = 1
              DemDebounceCounterFailedThreshold = 127
              DemDebounceCounterIncrementStepSize = 1
              DemDebounceCounterJumpDown = true
              DemDebounceCounterJumpDownValue = 0
              DemDebounceCounterJumpUp = true
              DemDebounceCounterJumpUpValue = 0
              DemDebounceCounterPassedThreshold = -128
              DemDebounceCounterStorage = false
              DemDebounceContinuous = false
          IndcrSteerAssiLimd (DemIndicatorAttribute):
            DemIndicatorFailureCycleSource = DEM_FAILURE_CYCLE_EVENT
            DemIndicatorBehaviour = DEM_INDICATOR_CONTINUOUS
            DemIndicatorHealingCycleCounterThreshold = 0
            DemIndicatorHealingCycleRef = PowerCycle
            DemIndicatorRef = DemGeneral/SteerAssiLimd
      30 x DemDTCClass, all with DemImmediateNvStorage=false:
        SteerWheelAgSnsrCalNorPrfmdClass: DemUdsDTC=4481099
        SteerWheelAgSnsrHwFltClass: DemUdsDTC=4481112
        SteerWheelAgSnsrPlauslyClass: DemUdsDTC=4481114
        ElecSteerMotCircClass: DemUdsDTC=4486400
        ElecSteerMotPosSnsrCirClass: DemUdsDTC=4487680
        SteerWhlTqInpSnsrClass: DemUdsDTC=4539648
        SteerWhlTqInpSnsrCalNoLrndClass: DemUdsDTC=4539723
        EcuHwPrfmcClass: DemUdsDTC=4549888
        EcuSwPrfmcCalDataSetNotProgdClass: DemUdsDTC=4550210
        DevPwrVltgUnderThdClass: DemUdsDTC=4718595
        DevPwrVltgOverMaxThdClass: DemUdsDTC=4718609
        SteerFailrMtgtnLvl1LimpHomeModClass: DemUdsDTC=5609216
        SteerFailrMtgtnLvl2LimpOverClass: DemUdsDTC=5609472
        SteerFailrMtgtnLvl3FadeOutClass: DemUdsDTC=5609728
        CtrlrComHiSpdBusOffClass: DemUdsDTC=12612352
        CtrlrComChassisExpBusOffClass: DemUdsDTC=12613376
        LostComWithEngCtrlModClass: DemUdsDTC=12648448
        LostComWithTrsmCtrlModClass: DemUdsDTC=12648704
        LostComWithElecBrkCtrlModClass: DemUdsDTC=12656896
        LostComWithBodyCtrlModClass: DemUdsDTC=12664832
        LostComWithParkAssiCtrlModClass: DemUdsDTC=12671232
        LostComWithFrntCameraCtrlModClass: DemUdsDTC=12741120
        InvldDataRxdFromEngCtrlModClass: DemUdsDTC=12845425
        InvldDataRxdFromTrsmCtrlModClass: DemUdsDTC=12845681
        InvldDataRxdFromElecBrkCtrlModClass: DemUdsDTC=12850545
        InvldDataRxdFromBodtCtrlModClass: DemUdsDTC=12853873
        InvldDataRxdFromParkAssiCtrlModClass: DemUdsDTC=12868209
        InvldDataRxdFromFrntCameraModClass: DemUdsDTC=12938097
        LostComWithElecBrkCtrlModChassisExpClass: DemUdsDTC=14168832
        InvldDataRxdFromElecBrkCtrlModChassisExpClass: DemUdsDTC=15008369
      35 x DemEventParameter, all with DemEventAvailable=true, DemEventAvailableInVariant=true, DemEventLatchTestFailed=false, DemEventTimeSeries=DEM_TIMESERIES_SNAPSHOT_NONE:
        SteerWheelAgSnsrHwFlt: DemEventId=28, DemEventKind=DEM_EVENT_KIND_SWC, DemMaxNumberFreezeFrameRecords=1, DemDTCClassRef=SteerWheelAgSnsrHwFltClass, DemFreezeFrameClassRef=DemFreezeFrameClass
          DemEventClass:
            DemAgingAllowed = true
            DemConsiderPtoStatus = false
            DemEventDestination = DEM_DTC_ORIGIN_PRIMARY_MEMORY
            DemEventPriority = 2
            DemFFPrestorageSupported = false
            DemAgingCycleCounterThreshold = 50
            DemOperationCycleRef = PowerCycle
            DemEnableConditionGroupRef = SteerWheelAgSnsrHwFltEna
            DemAgingCycleRef = PowerCycle
            DemDebounceAlgorithmClass
              DemDebounceCounterBased:
                DemDebounceBehavior = DEM_DEBOUNCE_FREEZE
                DemDebounceCounterDecrementStepSize = 1
                DemDebounceCounterFailedThreshold = 127
                DemDebounceCounterIncrementStepSize = 1
                DemDebounceCounterJumpDown = true
                DemDebounceCounterJumpDownValue = 0
                DemDebounceCounterJumpUp = true
                DemDebounceCounterJumpUpValue = 0
                DemDebounceCounterPassedThreshold = -128
                DemDebounceCounterStorage = false
                DemDebounceContinuous = false
            SteerAssiLimd (DemIndicatorAttribute):
              DemIndicatorFailureCycleSource = DEM_FAILURE_CYCLE_EVENT
              DemIndicatorBehaviour = DEM_INDICATOR_CONTINUOUS
              DemIndicatorHealingCycleCounterThreshold = 0
              DemIndicatorHealingCycleRef = PowerCycle
              DemIndicatorRef = DemGeneral/SteerAssiLimd
        SteerWheelAgSnsrPlausly: DemEventId=29, DemEventKind=DEM_EVENT_KIND_SWC, DemMaxNumberFreezeFrameRecords=1, DemDTCClassRef=SteerWheelAgSnsrPlauslyClass, DemFreezeFrameClassRef=DemFreezeFrameClass
          DemEventClass:
            DemAgingAllowed = true
            DemConsiderPtoStatus = false
            DemEventDestination = DEM_DTC_ORIGIN_PRIMARY_MEMORY
            DemEventPriority = 2
            DemFFPrestorageSupported = false
            DemAgingCycleCounterThreshold = 50
            DemOperationCycleRef = PowerCycle
            DemEnableConditionGroupRef = SteerWheelAgSnsrPlauslyEna
            DemAgingCycleRef = PowerCycle
            DemDebounceAlgorithmClass
              DemDebounceCounterBased:
                DemDebounceBehavior = DEM_DEBOUNCE_FREEZE
                DemDebounceCounterDecrementStepSize = 1
                DemDebounceCounterFailedThreshold = 127
                DemDebounceCounterIncrementStepSize = 1
                DemDebounceCounterJumpDown = true
                DemDebounceCounterJumpDownValue = 0
                DemDebounceCounterJumpUp = true
                DemDebounceCounterJumpUpValue = 0
                DemDebounceCounterPassedThreshold = -128
                DemDebounceCounterStorage = false
                DemDebounceContinuous = false
            SteerAssiLimd (DemIndicatorAttribute):
              DemIndicatorFailureCycleSource = DEM_FAILURE_CYCLE_EVENT
              DemIndicatorBehaviour = DEM_INDICATOR_CONTINUOUS
              DemIndicatorHealingCycleCounterThreshold = 0
              DemIndicatorHealingCycleRef = PowerCycle
              DemIndicatorRef = DemGeneral/SteerAssiLimd
        ElecSteerMotCirc: DemEventId=9, DemEventKind=DEM_EVENT_KIND_SWC, DemMaxNumberFreezeFrameRecords=1, DemDTCClassRef=ElecSteerMotCircClass, DemFreezeFrameClassRef=DemFreezeFrameClass
          DemEventClass:
            DemAgingAllowed = true
            DemConsiderPtoStatus = false
            DemEventDestination = DEM_DTC_ORIGIN_PRIMARY_MEMORY
            DemEventPriority = 2
            DemFFPrestorageSupported = false
            DemAgingCycleCounterThreshold = 50
            DemOperationCycleRef = PowerCycle
            DemEnableConditionGroupRef = ElecSteerMotCircEna
            DemAgingCycleRef = PowerCycle
            DemDebounceAlgorithmClass
              DemDebounceCounterBased:
                DemDebounceBehavior = DEM_DEBOUNCE_FREEZE
                DemDebounceCounterDecrementStepSize = 1
                DemDebounceCounterFailedThreshold = 127
                DemDebounceCounterIncrementStepSize = 1
                DemDebounceCounterJumpDown = true
                DemDebounceCounterJumpDownValue = 0
                DemDebounceCounterJumpUp = true
                DemDebounceCounterJumpUpValue = 0
                DemDebounceCounterPassedThreshold = -128
                DemDebounceCounterStorage = false
                DemDebounceContinuous = false
            PwrSteerIndcr (DemIndicatorAttribute):
              DemIndicatorFailureCycleSource = DEM_FAILURE_CYCLE_EVENT
              DemIndicatorBehaviour = DEM_INDICATOR_CONTINUOUS
              DemIndicatorHealingCycleCounterThreshold = 0
              DemIndicatorHealingCycleRef = PowerCycle
              DemIndicatorRef = DemGeneral/PwrSteerIndcr
        ElecSteerMotPosSnsrCir: DemEventId=10, DemEventKind=DEM_EVENT_KIND_SWC, DemMaxNumberFreezeFrameRecords=1, DemDTCClassRef=ElecSteerMotPosSnsrCirClass, DemFreezeFrameClassRef=DemFreezeFrameClass
          DemEventClass:
            DemAgingAllowed = true
            DemConsiderPtoStatus = false
            DemEventDestination = DEM_DTC_ORIGIN_PRIMARY_MEMORY
            DemEventPriority = 2
            DemFFPrestorageSupported = false
            DemAgingCycleCounterThreshold = 50
            DemOperationCycleRef = PowerCycle
            DemEnableConditionGroupRef = ElecSteerMotPosSnsrCirEna
            DemAgingCycleRef = PowerCycle
            DemDebounceAlgorithmClass
              DemDebounceCounterBased:
                DemDebounceBehavior = DEM_DEBOUNCE_FREEZE
                DemDebounceCounterDecrementStepSize = 1
                DemDebounceCounterFailedThreshold = 127
                DemDebounceCounterIncrementStepSize = 1
                DemDebounceCounterJumpDown = true
                DemDebounceCounterJumpDownValue = 0
                DemDebounceCounterJumpUp = true
                DemDebounceCounterJumpUpValue = 0
                DemDebounceCounterPassedThreshold = -128
                DemDebounceCounterStorage = false
                DemDebounceContinuous = false
            PwrSteerIndcr (DemIndicatorAttribute):
              DemIndicatorFailureCycleSource = DEM_FAILURE_CYCLE_EVENT
              DemIndicatorBehaviour = DEM_INDICATOR_CONTINUOUS
              DemIndicatorHealingCycleCounterThreshold = 0
              DemIndicatorHealingCycleRef = PowerCycle
              DemIndicatorRef = DemGeneral/PwrSteerIndcr
        SteerWhlTqInpSnsr: DemEventId=30, DemEventKind=DEM_EVENT_KIND_SWC, DemMaxNumberFreezeFrameRecords=1, DemDTCClassRef=SteerWhlTqInpSnsrClass, DemFreezeFrameClassRef=DemFreezeFrameClass
          DemEventClass:
            DemAgingAllowed = true
            DemConsiderPtoStatus = false
            DemEventDestination = DEM_DTC_ORIGIN_PRIMARY_MEMORY
            DemEventPriority = 2
            DemFFPrestorageSupported = false
            DemAgingCycleCounterThreshold = 50
            DemOperationCycleRef = PowerCycle
            DemEnableConditionGroupRef = SteerWhlTqInpSnsrEna
            DemAgingCycleRef = PowerCycle
            DemDebounceAlgorithmClass
              DemDebounceCounterBased:
                DemDebounceBehavior = DEM_DEBOUNCE_FREEZE
                DemDebounceCounterDecrementStepSize = 1
                DemDebounceCounterFailedThreshold = 127
                DemDebounceCounterIncrementStepSize = 1
                DemDebounceCounterJumpDown = true
                DemDebounceCounterJumpDownValue = 0
                DemDebounceCounterJumpUp = true
                DemDebounceCounterJumpUpValue = 0
                DemDebounceCounterPassedThreshold = -128
                DemDebounceCounterStorage = false
                DemDebounceContinuous = false
            PwrSteerIndcr (DemIndicatorAttribute):
              DemIndicatorFailureCycleSource = DEM_FAILURE_CYCLE_EVENT
              DemIndicatorBehaviour = DEM_INDICATOR_CONTINUOUS
              DemIndicatorHealingCycleCounterThreshold = 0
              DemIndicatorHealingCycleRef = PowerCycle
              DemIndicatorRef = DemGeneral/PwrSteerIndcr
        SteerWhlTqInpSnsrCalNoLrnd: DemEventId=31, DemEventKind=DEM_EVENT_KIND_SWC, DemMaxNumberFreezeFrameRecords=1, DemDTCClassRef=SteerWhlTqInpSnsrCalNoLrndClass, DemFreezeFrameClassRef=DemFreezeFrameClass
          DemEventClass:
            DemAgingAllowed = true
            DemConsiderPtoStatus = false
            DemEventDestination = DEM_DTC_ORIGIN_PRIMARY_MEMORY
            DemEventPriority = 2
            DemFFPrestorageSupported = false
            DemAgingCycleCounterThreshold = 50
            DemOperationCycleRef = PowerCycle
            DemEnableConditionGroupRef = SteerWhlTqInpSnsrCalNoLrndEna
            DemAgingCycleRef = PowerCycle
            DemDebounceAlgorithmClass
              DemDebounceCounterBased:
                DemDebounceBehavior = DEM_DEBOUNCE_FREEZE
                DemDebounceCounterDecrementStepSize = 1
                DemDebounceCounterFailedThreshold = 127
                DemDebounceCounterIncrementStepSize = 1
                DemDebounceCounterJumpDown = true
                DemDebounceCounterJumpDownValue = 0
                DemDebounceCounterJumpUp = true
                DemDebounceCounterJumpUpValue = 0
                DemDebounceCounterPassedThreshold = -128
                DemDebounceCounterStorage = false
                DemDebounceContinuous = false
            PwrSteerIndcr (DemIndicatorAttribute):
              DemIndicatorFailureCycleSource = DEM_FAILURE_CYCLE_EVENT
              DemIndicatorBehaviour = DEM_INDICATOR_CONTINUOUS
              DemIndicatorHealingCycleCounterThreshold = 0
              DemIndicatorHealingCycleRef = PowerCycle
              DemIndicatorRef = DemGeneral/PwrSteerIndcr
        EcuHwPrfmc: DemEventId=7, DemEventKind=DEM_EVENT_KIND_SWC, DemMaxNumberFreezeFrameRecords=1, DemDTCClassRef=EcuHwPrfmcClass, DemFreezeFrameClassRef=DemFreezeFrameClass
          DemEventClass:
            DemAgingAllowed = true
            DemConsiderPtoStatus = false
            DemEventDestination = DEM_DTC_ORIGIN_PRIMARY_MEMORY
            DemEventPriority = 2
            DemFFPrestorageSupported = false
            DemAgingCycleCounterThreshold = 50
            DemOperationCycleRef = PowerCycle
            DemEnableConditionGroupRef = EcuHwPrfmcEna
            DemAgingCycleRef = PowerCycle
            DemDebounceAlgorithmClass
              DemDebounceCounterBased:
                DemDebounceBehavior = DEM_DEBOUNCE_FREEZE
                DemDebounceCounterDecrementStepSize = 1
                DemDebounceCounterFailedThreshold = 127
                DemDebounceCounterIncrementStepSize = 1
                DemDebounceCounterJumpDown = true
                DemDebounceCounterJumpDownValue = 0
                DemDebounceCounterJumpUp = true
                DemDebounceCounterJumpUpValue = 0
                DemDebounceCounterPassedThreshold = -128
                DemDebounceCounterStorage = false
                DemDebounceContinuous = false
            PwrSteerIndcr (DemIndicatorAttribute):
              DemIndicatorFailureCycleSource = DEM_FAILURE_CYCLE_EVENT
              DemIndicatorBehaviour = DEM_INDICATOR_CONTINUOUS
              DemIndicatorHealingCycleCounterThreshold = 0
              DemIndicatorHealingCycleRef = PowerCycle
              DemIndicatorRef = DemGeneral/PwrSteerIndcr
        EcuSwPrfmcCalDataSetNotProgd: DemEventId=8, DemEventKind=DEM_EVENT_KIND_SWC, DemMaxNumberFreezeFrameRecords=1, DemDTCClassRef=EcuSwPrfmcCalDataSetNotProgdClass, DemFreezeFrameClassRef=DemFreezeFrameClass
          DemEventClass:
            DemAgingAllowed = true
            DemConsiderPtoStatus = false
            DemEventDestination = DEM_DTC_ORIGIN_PRIMARY_MEMORY
            DemEventPriority = 2
            DemFFPrestorageSupported = false
            DemAgingCycleCounterThreshold = 50
            DemOperationCycleRef = PowerCycle
            DemEnableConditionGroupRef = EcuSwPrfmcCalDataSetNotProgdEna
            DemAgingCycleRef = PowerCycle
            DemDebounceAlgorithmClass
              DemDebounceCounterBased:
                DemDebounceBehavior = DEM_DEBOUNCE_FREEZE
                DemDebounceCounterDecrementStepSize = 1
                DemDebounceCounterFailedThreshold = 127
                DemDebounceCounterIncrementStepSize = 1
                DemDebounceCounterJumpDown = true
                DemDebounceCounterJumpDownValue = 0
                DemDebounceCounterJumpUp = true
                DemDebounceCounterJumpUpValue = 0
                DemDebounceCounterPassedThreshold = -128
                DemDebounceCounterStorage = false
                DemDebounceContinuous = false
            PwrSteerIndcr (DemIndicatorAttribute):
              DemIndicatorFailureCycleSource = DEM_FAILURE_CYCLE_EVENT
              DemIndicatorBehaviour = DEM_INDICATOR_CONTINUOUS
              DemIndicatorHealingCycleCounterThreshold = 0
              DemIndicatorHealingCycleRef = PowerCycle
              DemIndicatorRef = DemGeneral/PwrSteerIndcr
        DevPwrVltgUnderThd: DemEventId=6, DemEventKind=DEM_EVENT_KIND_SWC, DemMaxNumberFreezeFrameRecords=1, DemDTCClassRef=DevPwrVltgUnderThdClass, DemFreezeFrameClassRef=DemFreezeFrameClass
          DemEventClass:
            DemAgingAllowed = true
            DemConsiderPtoStatus = false
            DemEventDestination = DEM_DTC_ORIGIN_PRIMARY_MEMORY
            DemEventPriority = 2
            DemFFPrestorageSupported = false
            DemAgingCycleCounterThreshold = 50
            DemOperationCycleRef = PowerCycle
            DemEnableConditionGroupRef = DevPwrVltgUnderThdEna
            DemAgingCycleRef = PowerCycle
            DemDebounceAlgorithmClass
              DemDebounceCounterBased:
                DemDebounceBehavior = DEM_DEBOUNCE_FREEZE
                DemDebounceCounterDecrementStepSize = 1
                DemDebounceCounterFailedThreshold = 127
                DemDebounceCounterIncrementStepSize = 1
                DemDebounceCounterJumpDown = true
                DemDebounceCounterJumpDownValue = 0
                DemDebounceCounterJumpUp = true
                DemDebounceCounterJumpUpValue = 0
                DemDebounceCounterPassedThreshold = -128
                DemDebounceCounterStorage = false
                DemDebounceContinuous = false
            SteerAssiLimd (DemIndicatorAttribute):
              DemIndicatorFailureCycleSource = DEM_FAILURE_CYCLE_EVENT
              DemIndicatorBehaviour = DEM_INDICATOR_CONTINUOUS
              DemIndicatorHealingCycleCounterThreshold = 0
              DemIndicatorHealingCycleRef = PowerCycle
              DemIndicatorRef = DemGeneral/SteerAssiLimd
        DevPwrVltgOverMaxThd: DemEventId=5, DemEventKind=DEM_EVENT_KIND_SWC, DemMaxNumberFreezeFrameRecords=1, DemDTCClassRef=DevPwrVltgOverMaxThdClass, DemFreezeFrameClassRef=DemFreezeFrameClass
          DemEventClass:
            DemAgingAllowed = true
            DemConsiderPtoStatus = false
            DemEventDestination = DEM_DTC_ORIGIN_PRIMARY_MEMORY
            DemEventPriority = 2
            DemFFPrestorageSupported = false
            DemAgingCycleCounterThreshold = 50
            DemOperationCycleRef = PowerCycle
            DemEnableConditionGroupRef = DevPwrVltgOverMaxThdEna
            DemAgingCycleRef = PowerCycle
            DemDebounceAlgorithmClass
              DemDebounceCounterBased:
                DemDebounceBehavior = DEM_DEBOUNCE_FREEZE
                DemDebounceCounterDecrementStepSize = 1
                DemDebounceCounterFailedThreshold = 127
                DemDebounceCounterIncrementStepSize = 1
                DemDebounceCounterJumpDown = true
                DemDebounceCounterJumpDownValue = 0
                DemDebounceCounterJumpUp = true
                DemDebounceCounterJumpUpValue = 0
                DemDebounceCounterPassedThreshold = -128
                DemDebounceCounterStorage = false
                DemDebounceContinuous = false
            PwrSteerIndcr (DemIndicatorAttribute):
              DemIndicatorFailureCycleSource = DEM_FAILURE_CYCLE_EVENT
              DemIndicatorBehaviour = DEM_INDICATOR_CONTINUOUS
              DemIndicatorHealingCycleCounterThreshold = 0
              DemIndicatorHealingCycleRef = PowerCycle
              DemIndicatorRef = DemGeneral/PwrSteerIndcr
        SteerFailrMtgtnLvl1LimpHomeMod: DemEventId=25, DemEventKind=DEM_EVENT_KIND_SWC, DemMaxNumberFreezeFrameRecords=1, DemDTCClassRef=SteerFailrMtgtnLvl1LimpHomeModClass, DemFreezeFrameClassRef=DemFreezeFrameClass
          DemEventClass:
            DemAgingAllowed = true
            DemConsiderPtoStatus = false
            DemEventDestination = DEM_DTC_ORIGIN_PRIMARY_MEMORY
            DemEventPriority = 2
            DemFFPrestorageSupported = false
            DemAgingCycleCounterThreshold = 50
            DemOperationCycleRef = PowerCycle
            DemEnableConditionGroupRef = SteerFailrMtgtnLvl1LimpHomeModEna
            DemAgingCycleRef = PowerCycle
            DemDebounceAlgorithmClass
              DemDebounceCounterBased:
                DemDebounceBehavior = DEM_DEBOUNCE_FREEZE
                DemDebounceCounterDecrementStepSize = 1
                DemDebounceCounterFailedThreshold = 127
                DemDebounceCounterIncrementStepSize = 1
                DemDebounceCounterJumpDown = true
                DemDebounceCounterJumpDownValue = 0
                DemDebounceCounterJumpUp = true
                DemDebounceCounterJumpUpValue = 0
                DemDebounceCounterPassedThreshold = -128
                DemDebounceCounterStorage = false
                DemDebounceContinuous = false
            SteerAssiLimdLvl2 (DemIndicatorAttribute):
              DemIndicatorFailureCycleSource = DEM_FAILURE_CYCLE_EVENT
              DemIndicatorBehaviour = DEM_INDICATOR_CONTINUOUS
              DemIndicatorHealingCycleCounterThreshold = 0
              DemIndicatorHealingCycleRef = PowerCycle
              DemIndicatorRef = DemGeneral/SteerAssiLimdLvl2
        SteerFailrMtgtnLvl2LimpOver: DemEventId=26, DemEventKind=DEM_EVENT_KIND_SWC, DemMaxNumberFreezeFrameRecords=1, DemDTCClassRef=SteerFailrMtgtnLvl2LimpOverClass, DemFreezeFrameClassRef=DemFreezeFrameClass
          DemEventClass:
            DemAgingAllowed = true
            DemConsiderPtoStatus = false
            DemEventDestination = DEM_DTC_ORIGIN_PRIMARY_MEMORY
            DemEventPriority = 2
            DemFFPrestorageSupported = false
            DemAgingCycleCounterThreshold = 50
            DemOperationCycleRef = PowerCycle
            DemEnableConditionGroupRef = SteerFailrMtgtnLvl2LimpOverEna
            DemAgingCycleRef = PowerCycle
            DemDebounceAlgorithmClass
              DemDebounceCounterBased:
                DemDebounceBehavior = DEM_DEBOUNCE_FREEZE
                DemDebounceCounterDecrementStepSize = 1
                DemDebounceCounterFailedThreshold = 127
                DemDebounceCounterIncrementStepSize = 1
                DemDebounceCounterJumpDown = true
                DemDebounceCounterJumpDownValue = 0
                DemDebounceCounterJumpUp = true
                DemDebounceCounterJumpUpValue = 0
                DemDebounceCounterPassedThreshold = -128
                DemDebounceCounterStorage = false
                DemDebounceContinuous = false
            SteerAssiLimdLvl2 (DemIndicatorAttribute):
              DemIndicatorFailureCycleSource = DEM_FAILURE_CYCLE_EVENT
              DemIndicatorBehaviour = DEM_INDICATOR_CONTINUOUS
              DemIndicatorHealingCycleCounterThreshold = 0
              DemIndicatorHealingCycleRef = PowerCycle
              DemIndicatorRef = DemGeneral/SteerAssiLimdLvl2
        SteerFailrMtgtnLvl3FadeOut: DemEventId=27, DemEventKind=DEM_EVENT_KIND_SWC, DemMaxNumberFreezeFrameRecords=1, DemDTCClassRef=SteerFailrMtgtnLvl3FadeOutClass, DemFreezeFrameClassRef=DemFreezeFrameClass
          DemEventClass:
            DemAgingAllowed = true
            DemConsiderPtoStatus = false
            DemEventDestination = DEM_DTC_ORIGIN_PRIMARY_MEMORY
            DemEventPriority = 2
            DemFFPrestorageSupported = false
            DemAgingCycleCounterThreshold = 50
            DemOperationCycleRef = PowerCycle
            DemEnableConditionGroupRef = SteerFailrMtgtnLvl3FadeOutEna
            DemAgingCycleRef = PowerCycle
            DemDebounceAlgorithmClass
              DemDebounceCounterBased:
                DemDebounceBehavior = DEM_DEBOUNCE_FREEZE
                DemDebounceCounterDecrementStepSize = 1
                DemDebounceCounterFailedThreshold = 127
                DemDebounceCounterIncrementStepSize = 1
                DemDebounceCounterJumpDown = true
                DemDebounceCounterJumpDownValue = 0
                DemDebounceCounterJumpUp = true
                DemDebounceCounterJumpUpValue = 0
                DemDebounceCounterPassedThreshold = -128
                DemDebounceCounterStorage = false
                DemDebounceContinuous = false
            SteerAssiLimdLvl2 (DemIndicatorAttribute):
              DemIndicatorFailureCycleSource = DEM_FAILURE_CYCLE_EVENT
              DemIndicatorBehaviour = DEM_INDICATOR_CONTINUOUS
              DemIndicatorHealingCycleCounterThreshold = 0
              DemIndicatorHealingCycleRef = PowerCycle
              DemIndicatorRef = DemGeneral/SteerAssiLimdLvl2
        CtrlrComHiSpdBusOff: DemEventId=4, DemEventKind=DEM_EVENT_KIND_SWC, DemMaxNumberFreezeFrameRecords=1, DemDTCClassRef=CtrlrComHiSpdBusOffClass, DemFreezeFrameClassRef=DemFreezeFrameClass
          DemEventClass:
            DemAgingAllowed = true
            DemConsiderPtoStatus = false
            DemEventDestination = DEM_DTC_ORIGIN_PRIMARY_MEMORY
            DemEventPriority = 2
            DemFFPrestorageSupported = false
            DemAgingCycleCounterThreshold = 50
            DemOperationCycleRef = PowerCycle
            DemEnableConditionGroupRef = CtrlrComHiSpdBusOffEna
            DemAgingCycleRef = PowerCycle
            DemDebounceAlgorithmClass
              DemDebounceCounterBased:
                DemDebounceBehavior = DEM_DEBOUNCE_FREEZE
                DemDebounceCounterDecrementStepSize = 1
                DemDebounceCounterFailedThreshold = 127
                DemDebounceCounterIncrementStepSize = 1
                DemDebounceCounterJumpDown = true
                DemDebounceCounterJumpDownValue = 0
                DemDebounceCounterJumpUp = true
                DemDebounceCounterJumpUpValue = 0
                DemDebounceCounterPassedThreshold = -128
                DemDebounceCounterStorage = false
                DemDebounceContinuous = false
            PwrSteerIndcr (DemIndicatorAttribute):
              DemIndicatorFailureCycleSource = DEM_FAILURE_CYCLE_EVENT
              DemIndicatorBehaviour = DEM_INDICATOR_CONTINUOUS
              DemIndicatorHealingCycleCounterThreshold = 0
              DemIndicatorHealingCycleRef = PowerCycle
              DemIndicatorRef = DemGeneral/PwrSteerIndcr
        CtrlrComChassisExpBusOff: DemEventId=3, DemEventKind=DEM_EVENT_KIND_SWC, DemMaxNumberFreezeFrameRecords=1, DemDTCClassRef=CtrlrComChassisExpBusOffClass, DemFreezeFrameClassRef=DemFreezeFrameClass
          DemEventClass:
            DemAgingAllowed = true
            DemConsiderPtoStatus = false
            DemEventDestination = DEM_DTC_ORIGIN_PRIMARY_MEMORY
            DemEventPriority = 2
            DemFFPrestorageSupported = false
            DemAgingCycleCounterThreshold = 50
            DemOperationCycleRef = PowerCycle
            DemEnableConditionGroupRef = CtrlrComChassisExpBusOffEna
            DemAgingCycleRef = PowerCycle
            DemDebounceAlgorithmClass
              DemDebounceCounterBased:
                DemDebounceBehavior = DEM_DEBOUNCE_FREEZE
                DemDebounceCounterDecrementStepSize = 1
                DemDebounceCounterFailedThreshold = 127
                DemDebounceCounterIncrementStepSize = 1
                DemDebounceCounterJumpDown = true
                DemDebounceCounterJumpDownValue = 0
                DemDebounceCounterJumpUp = true
                DemDebounceCounterJumpUpValue = 0
                DemDebounceCounterPassedThreshold = -128
                DemDebounceCounterStorage = false
                DemDebounceContinuous = false
            PwrSteerIndcr (DemIndicatorAttribute):
              DemIndicatorFailureCycleSource = DEM_FAILURE_CYCLE_EVENT
              DemIndicatorBehaviour = DEM_INDICATOR_CONTINUOUS
              DemIndicatorHealingCycleCounterThreshold = 0
              DemIndicatorHealingCycleRef = PowerCycle
              DemIndicatorRef = DemGeneral/PwrSteerIndcr
        LostComWithEngCtrlMod: DemEventId=21, DemEventKind=DEM_EVENT_KIND_SWC, DemMaxNumberFreezeFrameRecords=1, DemDTCClassRef=LostComWithEngCtrlModClass, DemFreezeFrameClassRef=DemFreezeFrameClass
          DemEventClass:
            DemAgingAllowed = true
            DemConsiderPtoStatus = false
            DemEventDestination = DEM_DTC_ORIGIN_PRIMARY_MEMORY
            DemEventPriority = 2
            DemFFPrestorageSupported = false
            DemAgingCycleCounterThreshold = 50
            DemOperationCycleRef = PowerCycle
            DemEnableConditionGroupRef = LostComWithEngCtrlModEna
            DemAgingCycleRef = PowerCycle
            DemDebounceAlgorithmClass
              DemDebounceCounterBased:
                DemDebounceBehavior = DEM_DEBOUNCE_FREEZE
                DemDebounceCounterDecrementStepSize = 1
                DemDebounceCounterFailedThreshold = 127
                DemDebounceCounterIncrementStepSize = 1
                DemDebounceCounterJumpDown = true
                DemDebounceCounterJumpDownValue = 0
                DemDebounceCounterJumpUp = true
                DemDebounceCounterJumpUpValue = 0
                DemDebounceCounterPassedThreshold = -128
                DemDebounceCounterStorage = false
                DemDebounceContinuous = false
            SteerAssiLimd (DemIndicatorAttribute):
              DemIndicatorFailureCycleSource = DEM_FAILURE_CYCLE_EVENT
              DemIndicatorBehaviour = DEM_INDICATOR_CONTINUOUS
              DemIndicatorHealingCycleCounterThreshold = 0
              DemIndicatorHealingCycleRef = PowerCycle
              DemIndicatorRef = DemGeneral/SteerAssiLimd
        LostComWithTrsmCtrlMod: DemEventId=24, DemEventKind=DEM_EVENT_KIND_SWC, DemMaxNumberFreezeFrameRecords=1, DemDTCClassRef=LostComWithTrsmCtrlModClass, DemFreezeFrameClassRef=DemFreezeFrameClass
          DemEventClass:
            DemAgingAllowed = true
            DemConsiderPtoStatus = false
            DemEventDestination = DEM_DTC_ORIGIN_PRIMARY_MEMORY
            DemEventPriority = 2
            DemFFPrestorageSupported = false
            DemAgingCycleCounterThreshold = 50
            DemOperationCycleRef = PowerCycle
            DemEnableConditionGroupRef = LostComWithTrsmCtrlModEna
            DemAgingCycleRef = PowerCycle
            DemDebounceAlgorithmClass
              DemDebounceCounterBased:
                DemDebounceBehavior = DEM_DEBOUNCE_FREEZE
                DemDebounceCounterDecrementStepSize = 1
                DemDebounceCounterFailedThreshold = 127
                DemDebounceCounterIncrementStepSize = 1
                DemDebounceCounterJumpDown = true
                DemDebounceCounterJumpDownValue = 0
                DemDebounceCounterJumpUp = true
                DemDebounceCounterJumpUpValue = 0
                DemDebounceCounterPassedThreshold = -128
                DemDebounceCounterStorage = false
                DemDebounceContinuous = false
        LostComWithElecBrkCtrlMod: DemEventId=19, DemEventKind=DEM_EVENT_KIND_SWC, DemMaxNumberFreezeFrameRecords=1, DemDTCClassRef=LostComWithElecBrkCtrlModClass, DemFreezeFrameClassRef=DemFreezeFrameClass
          DemEventClass:
            DemAgingAllowed = true
            DemConsiderPtoStatus = false
            DemEventDestination = DEM_DTC_ORIGIN_PRIMARY_MEMORY
            DemEventPriority = 2
            DemFFPrestorageSupported = false
            DemAgingCycleCounterThreshold = 50
            DemOperationCycleRef = PowerCycle
            DemEnableConditionGroupRef = LostComWithElecBrkCtrlModEna
            DemAgingCycleRef = PowerCycle
            DemDebounceAlgorithmClass
              DemDebounceCounterBased:
                DemDebounceBehavior = DEM_DEBOUNCE_FREEZE
                DemDebounceCounterDecrementStepSize = 1
                DemDebounceCounterFailedThreshold = 127
                DemDebounceCounterIncrementStepSize = 1
                DemDebounceCounterJumpDown = true
                DemDebounceCounterJumpDownValue = 0
                DemDebounceCounterJumpUp = true
                DemDebounceCounterJumpUpValue = 0
                DemDebounceCounterPassedThreshold = -128
                DemDebounceCounterStorage = false
                DemDebounceContinuous = false
        LostComWithBodyCtrlMod: DemEventId=18, DemEventKind=DEM_EVENT_KIND_SWC, DemMaxNumberFreezeFrameRecords=1, DemDTCClassRef=LostComWithBodyCtrlModClass, DemFreezeFrameClassRef=DemFreezeFrameClass
          DemEventClass:
            DemAgingAllowed = true
            DemConsiderPtoStatus = false
            DemEventDestination = DEM_DTC_ORIGIN_PRIMARY_MEMORY
            DemEventPriority = 2
            DemFFPrestorageSupported = false
            DemAgingCycleCounterThreshold = 50
            DemOperationCycleRef = PowerCycle
            DemEnableConditionGroupRef = LostComWithBodyCtrlModEna
            DemAgingCycleRef = PowerCycle
            DemDebounceAlgorithmClass
              DemDebounceCounterBased:
                DemDebounceBehavior = DEM_DEBOUNCE_FREEZE
                DemDebounceCounterDecrementStepSize = 1
                DemDebounceCounterFailedThreshold = 127
                DemDebounceCounterIncrementStepSize = 1
                DemDebounceCounterJumpDown = true
                DemDebounceCounterJumpDownValue = 0
                DemDebounceCounterJumpUp = true
                DemDebounceCounterJumpUpValue = 0
                DemDebounceCounterPassedThreshold = -128
                DemDebounceCounterStorage = false
                DemDebounceContinuous = false
        LostComWithParkAssiCtrlMod: DemEventId=23, DemEventKind=DEM_EVENT_KIND_SWC, DemMaxNumberFreezeFrameRecords=1, DemDTCClassRef=LostComWithParkAssiCtrlModClass, DemFreezeFrameClassRef=DemFreezeFrameClass
          DemEventClass:
            DemAgingAllowed = true
            DemConsiderPtoStatus = false
            DemEventDestination = DEM_DTC_ORIGIN_PRIMARY_MEMORY
            DemEventPriority = 2
            DemFFPrestorageSupported = false
            DemAgingCycleCounterThreshold = 50
            DemOperationCycleRef = PowerCycle
            DemEnableConditionGroupRef = LostComWithParkAssiCtrlModEna
            DemAgingCycleRef = PowerCycle
            DemDebounceAlgorithmClass
              DemDebounceCounterBased:
                DemDebounceBehavior = DEM_DEBOUNCE_FREEZE
                DemDebounceCounterDecrementStepSize = 1
                DemDebounceCounterFailedThreshold = 127
                DemDebounceCounterIncrementStepSize = 1
                DemDebounceCounterJumpDown = true
                DemDebounceCounterJumpDownValue = 0
                DemDebounceCounterJumpUp = true
                DemDebounceCounterJumpUpValue = 0
                DemDebounceCounterPassedThreshold = -128
                DemDebounceCounterStorage = false
                DemDebounceContinuous = false
        LostComWithFrntCameraCtrlMod: DemEventId=22, DemEventKind=DEM_EVENT_KIND_SWC, DemMaxNumberFreezeFrameRecords=1, DemDTCClassRef=LostComWithFrntCameraCtrlModClass, DemFreezeFrameClassRef=DemFreezeFrameClass
          DemEventClass:
            DemAgingAllowed = true
            DemConsiderPtoStatus = false
            DemEventDestination = DEM_DTC_ORIGIN_PRIMARY_MEMORY
            DemEventPriority = 2
            DemFFPrestorageSupported = false
            DemAgingCycleCounterThreshold = 50
            DemOperationCycleRef = PowerCycle
            DemEnableConditionGroupRef = LostComWithFrntCameraCtrlModEna
            DemAgingCycleRef = PowerCycle
            DemDebounceAlgorithmClass
              DemDebounceCounterBased:
                DemDebounceBehavior = DEM_DEBOUNCE_FREEZE
                DemDebounceCounterDecrementStepSize = 1
                DemDebounceCounterFailedThreshold = 127
                DemDebounceCounterIncrementStepSize = 1
                DemDebounceCounterJumpDown = true
                DemDebounceCounterJumpDownValue = 0
                DemDebounceCounterJumpUp = true
                DemDebounceCounterJumpUpValue = 0
                DemDebounceCounterPassedThreshold = -128
                DemDebounceCounterStorage = false
                DemDebounceContinuous = false
        InvldDataRxdFromEngCtrlMod: DemEventId=14, DemEventKind=DEM_EVENT_KIND_SWC, DemMaxNumberFreezeFrameRecords=1, DemDTCClassRef=InvldDataRxdFromEngCtrlModClass, DemFreezeFrameClassRef=DemFreezeFrameClass
          DemEventClass:
            DemAgingAllowed = true
            DemConsiderPtoStatus = false
            DemEventDestination = DEM_DTC_ORIGIN_PRIMARY_MEMORY
            DemEventPriority = 2
            DemFFPrestorageSupported = false
            DemAgingCycleCounterThreshold = 50
            DemOperationCycleRef = PowerCycle
            DemEnableConditionGroupRef = InvldDataRxdFromEngCtrlModEna
            DemAgingCycleRef = PowerCycle
            DemDebounceAlgorithmClass
              DemDebounceCounterBased:
                DemDebounceBehavior = DEM_DEBOUNCE_FREEZE
                DemDebounceCounterDecrementStepSize = 1
                DemDebounceCounterFailedThreshold = 127
                DemDebounceCounterIncrementStepSize = 1
                DemDebounceCounterJumpDown = true
                DemDebounceCounterJumpDownValue = 0
                DemDebounceCounterJumpUp = true
                DemDebounceCounterJumpUpValue = 0
                DemDebounceCounterPassedThreshold = -128
                DemDebounceCounterStorage = false
                DemDebounceContinuous = false
            SteerAssiLimd (DemIndicatorAttribute):
              DemIndicatorFailureCycleSource = DEM_FAILURE_CYCLE_EVENT
              DemIndicatorBehaviour = DEM_INDICATOR_CONTINUOUS
              DemIndicatorHealingCycleCounterThreshold = 0
              DemIndicatorHealingCycleRef = PowerCycle
              DemIndicatorRef = DemGeneral/SteerAssiLimd
        InvldDataRxdFromTrsmCtrlMod: DemEventId=17, DemEventKind=DEM_EVENT_KIND_SWC, DemMaxNumberFreezeFrameRecords=1, DemDTCClassRef=InvldDataRxdFromTrsmCtrlModClass, DemFreezeFrameClassRef=DemFreezeFrameClass
          DemEventClass:
            DemAgingAllowed = true
            DemConsiderPtoStatus = false
            DemEventDestination = DEM_DTC_ORIGIN_PRIMARY_MEMORY
            DemEventPriority = 2
            DemFFPrestorageSupported = false
            DemAgingCycleCounterThreshold = 20
            DemOperationCycleRef = PowerCycle
            DemEnableConditionGroupRef = InvldDataRxdFromTrsmCtrlModEna
            DemAgingCycleRef = PowerCycle
            DemDebounceAlgorithmClass
              DemDebounceCounterBased:
                DemDebounceBehavior = DEM_DEBOUNCE_FREEZE
                DemDebounceCounterDecrementStepSize = 1
                DemDebounceCounterFailedThreshold = 127
                DemDebounceCounterIncrementStepSize = 1
                DemDebounceCounterJumpDown = true
                DemDebounceCounterJumpDownValue = 0
                DemDebounceCounterJumpUp = true
                DemDebounceCounterJumpUpValue = 0
                DemDebounceCounterPassedThreshold = -128
                DemDebounceCounterStorage = false
                DemDebounceContinuous = false
        InvldDataRxdFromElecBrkCtrlMod: DemEventId=12, DemEventKind=DEM_EVENT_KIND_SWC, DemMaxNumberFreezeFrameRecords=1, DemDTCClassRef=InvldDataRxdFromElecBrkCtrlModClass, DemFreezeFrameClassRef=DemFreezeFrameClass
          DemEventClass:
            DemAgingAllowed = true
            DemConsiderPtoStatus = false
            DemEventDestination = DEM_DTC_ORIGIN_PRIMARY_MEMORY
            DemEventPriority = 2
            DemFFPrestorageSupported = false
            DemAgingCycleCounterThreshold = 50
            DemOperationCycleRef = PowerCycle
            DemEnableConditionGroupRef = InvldDataRxdFromElecBrkCtrlModEna
            DemAgingCycleRef = PowerCycle
            DemDebounceAlgorithmClass
              DemDebounceCounterBased:
                DemDebounceBehavior = DEM_DEBOUNCE_FREEZE
                DemDebounceCounterDecrementStepSize = 1
                DemDebounceCounterFailedThreshold = 127
                DemDebounceCounterIncrementStepSize = 1
                DemDebounceCounterJumpDown = true
                DemDebounceCounterJumpDownValue = 0
                DemDebounceCounterJumpUp = true
                DemDebounceCounterJumpUpValue = 0
                DemDebounceCounterPassedThreshold = -128
                DemDebounceCounterStorage = false
                DemDebounceContinuous = false
            SteerAssiLimd (DemIndicatorAttribute):
              DemIndicatorFailureCycleSource = DEM_FAILURE_CYCLE_EVENT
              DemIndicatorBehaviour = DEM_INDICATOR_CONTINUOUS
              DemIndicatorHealingCycleCounterThreshold = 0
              DemIndicatorHealingCycleRef = PowerCycle
              DemIndicatorRef = DemGeneral/SteerAssiLimd
        InvldDataRxdFromBodtCtrlMod: DemEventId=11, DemEventKind=DEM_EVENT_KIND_SWC, DemMaxNumberFreezeFrameRecords=1, DemDTCClassRef=InvldDataRxdFromBodtCtrlModClass, DemFreezeFrameClassRef=DemFreezeFrameClass
          DemEventClass:
            DemAgingAllowed = true
            DemConsiderPtoStatus = false
            DemEventDestination = DEM_DTC_ORIGIN_PRIMARY_MEMORY
            DemEventPriority = 2
            DemFFPrestorageSupported = false
            DemAgingCycleCounterThreshold = 50
            DemOperationCycleRef = PowerCycle
            DemEnableConditionGroupRef = InvldDataRxdFromBodtCtrlModEna
            DemAgingCycleRef = PowerCycle
            DemDebounceAlgorithmClass
              DemDebounceCounterBased:
                DemDebounceBehavior = DEM_DEBOUNCE_FREEZE
                DemDebounceCounterDecrementStepSize = 1
                DemDebounceCounterFailedThreshold = 127
                DemDebounceCounterIncrementStepSize = 1
                DemDebounceCounterJumpDown = true
                DemDebounceCounterJumpDownValue = 0
                DemDebounceCounterJumpUp = true
                DemDebounceCounterJumpUpValue = 0
                DemDebounceCounterPassedThreshold = -128
                DemDebounceCounterStorage = false
                DemDebounceContinuous = false
        InvldDataRxdFromParkAssiCtrlMod: DemEventId=16, DemEventKind=DEM_EVENT_KIND_SWC, DemMaxNumberFreezeFrameRecords=1, DemDTCClassRef=InvldDataRxdFromParkAssiCtrlModClass, DemFreezeFrameClassRef=DemFreezeFrameClass
          DemEventClass:
            DemAgingAllowed = true
            DemConsiderPtoStatus = false
            DemEventDestination = DEM_DTC_ORIGIN_PRIMARY_MEMORY
            DemEventPriority = 2
            DemFFPrestorageSupported = false
            DemAgingCycleCounterThreshold = 50
            DemOperationCycleRef = PowerCycle
            DemEnableConditionGroupRef = InvldDataRxdFromParkAssiCtrlModEna
            DemAgingCycleRef = PowerCycle
            DemDebounceAlgorithmClass
              DemDebounceCounterBased:
                DemDebounceBehavior = DEM_DEBOUNCE_FREEZE
                DemDebounceCounterDecrementStepSize = 1
                DemDebounceCounterFailedThreshold = 127
                DemDebounceCounterIncrementStepSize = 1
                DemDebounceCounterJumpDown = true
                DemDebounceCounterJumpDownValue = 0
                DemDebounceCounterJumpUp = true
                DemDebounceCounterJumpUpValue = 0
                DemDebounceCounterPassedThreshold = -128
                DemDebounceCounterStorage = false
                DemDebounceContinuous = false
        InvldDataRxdFromFrntCameraMod: DemEventId=15, DemEventKind=DEM_EVENT_KIND_SWC, DemMaxNumberFreezeFrameRecords=1, DemDTCClassRef=InvldDataRxdFromFrntCameraModClass, DemFreezeFrameClassRef=DemFreezeFrameClass
          DemEventClass:
            DemAgingAllowed = true
            DemConsiderPtoStatus = false
            DemEventDestination = DEM_DTC_ORIGIN_PRIMARY_MEMORY
            DemEventPriority = 2
            DemFFPrestorageSupported = false
            DemAgingCycleCounterThreshold = 50
            DemOperationCycleRef = PowerCycle
            DemEnableConditionGroupRef = InvldDataRxdFromFrntCameraModEna
            DemAgingCycleRef = PowerCycle
            DemDebounceAlgorithmClass
              DemDebounceCounterBased:
                DemDebounceBehavior = DEM_DEBOUNCE_FREEZE
                DemDebounceCounterDecrementStepSize = 1
                DemDebounceCounterFailedThreshold = 127
                DemDebounceCounterIncrementStepSize = 1
                DemDebounceCounterJumpDown = true
                DemDebounceCounterJumpDownValue = 0
                DemDebounceCounterJumpUp = true
                DemDebounceCounterJumpUpValue = 0
                DemDebounceCounterPassedThreshold = -128
                DemDebounceCounterStorage = false
                DemDebounceContinuous = false
        LostComWithElecBrkCtrlModChassisExp: DemEventId=20, DemEventKind=DEM_EVENT_KIND_SWC, DemMaxNumberFreezeFrameRecords=1, DemDTCClassRef=LostComWithElecBrkCtrlModChassisExpClass, DemFreezeFrameClassRef=DemFreezeFrameClass
          DemEventClass:
            DemAgingAllowed = true
            DemConsiderPtoStatus = false
            DemEventDestination = DEM_DTC_ORIGIN_PRIMARY_MEMORY
            DemEventPriority = 2
            DemFFPrestorageSupported = false
            DemAgingCycleCounterThreshold = 50
            DemOperationCycleRef = PowerCycle
            DemEnableConditionGroupRef = LostComWithElecBrkCtrlModChassisExpEna
            DemAgingCycleRef = PowerCycle
            DemDebounceAlgorithmClass
              DemDebounceCounterBased:
                DemDebounceBehavior = DEM_DEBOUNCE_FREEZE
                DemDebounceCounterDecrementStepSize = 1
                DemDebounceCounterFailedThreshold = 127
                DemDebounceCounterIncrementStepSize = 1
                DemDebounceCounterJumpDown = true
                DemDebounceCounterJumpDownValue = 0
                DemDebounceCounterJumpUp = true
                DemDebounceCounterJumpUpValue = 0
                DemDebounceCounterPassedThreshold = -128
                DemDebounceCounterStorage = false
                DemDebounceContinuous = false
        InvldDataRxdFromElecBrkCtrlModChassisExp: DemEventId=13, DemEventKind=DEM_EVENT_KIND_SWC, DemMaxNumberFreezeFrameRecords=1, DemDTCClassRef=InvldDataRxdFromElecBrkCtrlModChassisExpClass, DemFreezeFrameClassRef=DemFreezeFrameClass
          DemEventClass:
            DemAgingAllowed = true
            DemConsiderPtoStatus = false
            DemEventDestination = DEM_DTC_ORIGIN_PRIMARY_MEMORY
            DemEventPriority = 2
            DemFFPrestorageSupported = false
            DemAgingCycleCounterThreshold = 50
            DemOperationCycleRef = PowerCycle
            DemEnableConditionGroupRef = InvldDataRxdFromElecBrkCtrlModChassisExpEna
            DemAgingCycleRef = PowerCycle
            DemDebounceAlgorithmClass
              DemDebounceCounterBased:
                DemDebounceBehavior = DEM_DEBOUNCE_FREEZE
                DemDebounceCounterDecrementStepSize = 1
                DemDebounceCounterFailedThreshold = 127
                DemDebounceCounterIncrementStepSize = 1
                DemDebounceCounterJumpDown = true
                DemDebounceCounterJumpDownValue = 0
                DemDebounceCounterJumpUp = true
                DemDebounceCounterJumpUpValue = 0
                DemDebounceCounterPassedThreshold = -128
                DemDebounceCounterStorage = false
                DemDebounceContinuous = false
        DIO_E_REG_WRITE_VERIFY: DemEventId=58, DemEventKind=DEM_EVENT_KIND_BSW
          DemEventClass:
            DemAgingAllowed = false
            DemConsiderPtoStatus = false
            DemEventDestination = DEM_DTC_ORIGIN_PRIMARY_MEMORY
            DemEventPriority = 2
            DemFFPrestorageSupported = false
            DemOperationCycleRef = PowerCycle
            DemDebounceAlgorithmClass
              DemDebounceCounterBased:
                DemDebounceBehavior = DEM_DEBOUNCE_FREEZE
                DemDebounceCounterDecrementStepSize = 1
                DemDebounceCounterFailedThreshold = 127
                DemDebounceCounterIncrementStepSize = 1
                DemDebounceCounterJumpDown = true
                DemDebounceCounterJumpDownValue = 0
                DemDebounceCounterJumpUp = true
                DemDebounceCounterJumpUpValue = 0
                DemDebounceCounterPassedThreshold = -128
                DemDebounceCounterStorage = false
                DemDebounceContinuous = false
        MCU_E_INT_INCONSISTENT: DemEventId=59, DemEventKind=DEM_EVENT_KIND_BSW
          DemEventClass:
            DemAgingAllowed = false
            DemConsiderPtoStatus = false
            DemEventDestination = DEM_DTC_ORIGIN_PRIMARY_MEMORY
            DemEventPriority = 2
            DemFFPrestorageSupported = false
            DemOperationCycleRef = PowerCycle
            DemDebounceAlgorithmClass
              DemDebounceCounterBased:
                DemDebounceBehavior = DEM_DEBOUNCE_FREEZE
                DemDebounceCounterDecrementStepSize = 1
                DemDebounceCounterFailedThreshold = 127
                DemDebounceCounterIncrementStepSize = 1
                DemDebounceCounterJumpDown = true
                DemDebounceCounterJumpDownValue = 0
                DemDebounceCounterJumpUp = true
                DemDebounceCounterJumpUpValue = 0
                DemDebounceCounterPassedThreshold = -128
                DemDebounceCounterStorage = false
                DemDebounceContinuous = false
        MCU_E_REG_WRITE_VERIFY: DemEventId=60, DemEventKind=DEM_EVENT_KIND_BSW
          DemEventClass:
            DemAgingAllowed = false
            DemConsiderPtoStatus = false
            DemEventDestination = DEM_DTC_ORIGIN_PRIMARY_MEMORY
            DemEventPriority = 2
            DemFFPrestorageSupported = false
            DemOperationCycleRef = PowerCycle
            DemDebounceAlgorithmClass
              DemDebounceCounterBased:
                DemDebounceBehavior = DEM_DEBOUNCE_FREEZE
                DemDebounceCounterDecrementStepSize = 1
                DemDebounceCounterFailedThreshold = 127
                DemDebounceCounterIncrementStepSize = 1
                DemDebounceCounterJumpDown = true
                DemDebounceCounterJumpDownValue = 0
                DemDebounceCounterJumpUp = true
                DemDebounceCounterJumpUpValue = 0
                DemDebounceCounterPassedThreshold = -128
                DemDebounceCounterStorage = false
                DemDebounceContinuous = false
        PORT_E_REG_WRITE_VERIFY: DemEventId=61, DemEventKind=DEM_EVENT_KIND_BSW
          DemEventClass:
            DemAgingAllowed = false
            DemConsiderPtoStatus = false
            DemEventDestination = DEM_DTC_ORIGIN_PRIMARY_MEMORY
            DemEventPriority = 2
            DemFFPrestorageSupported = false
            DemOperationCycleRef = PowerCycle
            DemDebounceAlgorithmClass
              DemDebounceCounterBased:
                DemDebounceBehavior = DEM_DEBOUNCE_FREEZE
                DemDebounceCounterDecrementStepSize = 1
                DemDebounceCounterFailedThreshold = 127
                DemDebounceCounterIncrementStepSize = 1
                DemDebounceCounterJumpDown = true
                DemDebounceCounterJumpDownValue = 0
                DemDebounceCounterJumpUp = true
                DemDebounceCounterJumpUpValue = 0
                DemDebounceCounterPassedThreshold = -128
                DemDebounceCounterStorage = false
                DemDebounceContinuous = false
        WDG_59_DRIVERA_E_INT_INCONSISTENT: DemEventId=62, DemEventKind=DEM_EVENT_KIND_BSW
          DemEventClass:
            DemAgingAllowed = false
            DemConsiderPtoStatus = false
            DemEventDestination = DEM_DTC_ORIGIN_PRIMARY_MEMORY
            DemEventPriority = 2
            DemFFPrestorageSupported = false
            DemOperationCycleRef = PowerCycle
            DemDebounceAlgorithmClass
              DemDebounceCounterBased:
                DemDebounceBehavior = DEM_DEBOUNCE_FREEZE
                DemDebounceCounterDecrementStepSize = 1
                DemDebounceCounterFailedThreshold = 127
                DemDebounceCounterIncrementStepSize = 1
                DemDebounceCounterJumpDown = true
                DemDebounceCounterJumpDownValue = 0
                DemDebounceCounterJumpUp = true
                DemDebounceCounterJumpUpValue = 0
                DemDebounceCounterPassedThreshold = -128
                DemDebounceCounterStorage = false
                DemDebounceContinuous = false
        Wdg_E_REG_WRITE_VERIFY: DemEventId=63, DemEventKind=DEM_EVENT_KIND_BSW
          DemEventClass:
            DemAgingAllowed = false
            DemConsiderPtoStatus = false
            DemEventDestination = DEM_DTC_ORIGIN_PRIMARY_MEMORY
            DemEventPriority = 2
            DemFFPrestorageSupported = false
            DemOperationCycleRef = PowerCycle
            DemDebounceAlgorithmClass
              DemDebounceCounterBased:
                DemDebounceBehavior = DEM_DEBOUNCE_FREEZE
                DemDebounceCounterDecrementStepSize = 1
                DemDebounceCounterFailedThreshold = 127
                DemDebounceCounterIncrementStepSize = 1
                DemDebounceCounterJumpDown = true
                DemDebounceCounterJumpDownValue = 0
                DemDebounceCounterJumpUp = true
                DemDebounceCounterJumpUpValue = 0
                DemDebounceCounterPassedThreshold = -128
                DemDebounceCounterStorage = false
                DemDebounceContinuous = false
