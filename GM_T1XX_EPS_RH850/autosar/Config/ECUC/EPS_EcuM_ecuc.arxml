AUTOSAR XML (schema 4-0-3)
package /ActiveEcuC
  module config EcuM: implementation-config-variant=VARIANT-PRE-COMPILE, module-description=EcuM_Impl
    EcuMFlexGeneral: EcuMAlarmClockPresent=false, EcuMResetLoopDetection=false, EcuMEnableDefBehaviour=false, EcuMModeHandling=false
    EcuMGeneral:
      EcuMDevErrorDetect = true
      EcuMIncludeDem = false
      EcuMIncludeDet = true
      EcuMVersionInfoApi = false
      EcuMMainFunctionPeriod = 0.01
      EcuMDeferredBswMNotification = false
      EcuMSlaveCoreHandling = false
      EcuMEnableFixBehavior = false
      EcuMAdditionalIncludes = Dem.h
      EcuMAdditionalIncludes = Port.h
      EcuMAdditionalIncludes = Mcu.h
      EcuMAdditionalIncludes = Dio.h
      EcuMAdditionalIncludes = Wdg_59_DriverA.h
      EcuMAdditionalIncludes = Fls.h
      EcuMAdditionalIncludes = osekext.h
      EcuMAdditionalIncludes = Spi.h
      EcuMAdditionalIncludes = CDD_ExcpnHndlg.h
      EcuMAdditionalIncludes = CDD_EcmOutpAndDiagc.h
      EcuMAdditionalIncludes = CDD_NxtrTi.h
      EcuMAdditionalIncludes = CDD_McuCoreCfgAndDiagc.h
      EcuMAdditionalIncludes = CDD_DataAndAdrPar.h
      EcuMGeneration: EcuMOutOfBoundsWriteSanitizer=false, EcuMOutOfBoundsReadSanitizer=false, EcuMInterfacesForDeactivatedData=false
    EcuMConfiguration
      EcuMCommonConfiguration: EcuMConfigConsistencyHash=2194765921570667545, EcuMDefaultAppMode=OSDEFAULTAPPMODE, EcuMOSResource=RES_SCHEDULER
        5 x EcuMWakeupSource, all with EcuMValidationTimeout=0, EcuMWakeupSourcePolling=false, EcuMCheckWakeupTimeout=0:
          ECUM_WKSOURCE_POWER: EcuMWakeupSourceId=0
          ECUM_WKSOURCE_RESET: EcuMWakeupSourceId=1
          ECUM_WKSOURCE_INTERNAL_RESET: EcuMWakeupSourceId=2
          ECUM_WKSOURCE_INTERNAL_WDG: EcuMWakeupSourceId=3
          ECUM_WKSOURCE_EXTERNAL_WDG: EcuMWakeupSourceId=4
        EcuMDefaultShutdownTarget: EcuMDefaultState=EcuMStateOff
        EcuMDriverInitListOne
          18 x EcuMDriverInitItem, all with EcuMModuleID=Code:
            osInitialize: EcuMAdditionalInitCode=osInitialize()
            osInitINTC: EcuMAdditionalInitCode=osInitINTC()
            Dem_PreInit: EcuMAdditionalInitCode=Dem_PreInit(NULL_PTR)
            EcmOutpAndDiagcInit3: EcuMAdditionalInitCode=EcmOutpAndDiagcInit3()
            Mcu_Init: EcuMAdditionalInitCode=Mcu_Init(McuModuleConfiguration)
            Mcu_InitClock: EcuMAdditionalInitCode=Mcu_InitClock(McuConf_McuClockSettingConfig_McuClockSettingConfig)
            EcmOutpAndDiagcInit4: EcuMAdditionalInitCode=EcmOutpAndDiagcInit4()
            EcmOutpAndDiagcInit1: EcuMAdditionalInitCode=EcmOutpAndDiagcInit1()
            Spi_Init: EcuMAdditionalInitCode=Spi_Init(SpiDriver)
            Port_Init: EcuMAdditionalInitCode=Port_Init(PortConfigSet)
            EnableWdgISR: EcuMAdditionalInitCode=osClearIMRmEI(9U)
            Wdg_59_DriverA_Init: EcuMAdditionalInitCode=Wdg_59_DriverA_Init(WdgSettingsConfig)
            GuardCfgAndDiagcInit3: EcuMAdditionalInitCode=GuardCfgAndDiagcInit3()
            DataAndAdrParInit1: EcuMAdditionalInitCode=DataAndAdrParInit1()
            Dio_Init: EcuMAdditionalInitCode=Dio_Init(DioConfig)
            Fls_Init: EcuMAdditionalInitCode=Fls_Init(FlsConfigSet)
            ExcpnHndlgInit1: EcuMAdditionalInitCode=ExcpnHndlgInit1()
            NxtrTiInit0: EcuMAdditionalInitCode=NxtrTiInit0()
        EcuMDriverInitListZero
          4 x EcuMDriverInitItem:
            Det_InitMemory: EcuMModuleID=Code, EcuMAdditionalInitCode=Det_InitMemory()
            Det_Init: EcuMModuleID=Det, EcuMModuleService=Det_Init
            McuCoreCfgAndDiagcInit1: EcuMModuleID=Code, EcuMAdditionalInitCode=McuCoreCfgAndDiagcInit1()
            McuCoreCfgAndDiagcInit2: EcuMModuleID=Code, EcuMAdditionalInitCode=McuCoreCfgAndDiagcInit2()
      EcuMFlexConfiguration: EcuMNormalMcuModeRef=McuModeSettingConf
        3 x EcuMResetMode:
          ECUM_RESET_MCU: EcuMResetModeId=0
          ECUM_RESET_WDG: EcuMResetModeId=1
          ECUM_RESET_IO: EcuMResetModeId=2
        4 x EcuMShutdownCause:
          ECUM_CAUSE_UNKNOWN: EcuMShutdownCauseId=0
          ECUM_CAUSE_ECU_STATE: EcuMShutdownCauseId=1
          ECUM_CAUSE_WDGM: EcuMShutdownCauseId=2
          ECUM_CAUSE_DCM: EcuMShutdownCauseId=3
        ECUM_RESET_WAKEUP (EcuMResetMode): EcuMResetModeId=3
        EcuMGoDownAllowedUsers: EcuMGoDownAllowedUserRef=FlexUser_BswM
        FlexUser_BswM (EcuMFlexUserConfig): EcuMFlexUser=0, EcuMGoDownRequestID=42
