AUTOSAR XML (schema 4-0-3)
package /ActiveEcuC
  module config HwAg1Meas: implementation-config-variant=VARIANT-PRE-COMPILE
    HwAg1MeasGeneral: NTC_HwAg1MfgFlt=NTCNR_0X1FA, NTC_HwAg1IfFlt=NTCNR_0X098, NTC_HwAg1Snsr0PrtclFlt=NTCNR_0X097, NTC_HwAg1Snsr1PrtclFlt=NTCNR_0X099
