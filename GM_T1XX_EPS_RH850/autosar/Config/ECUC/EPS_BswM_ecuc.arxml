AUTOSAR XML (schema 4-0-3)
package /ActiveEcuC
  module config BswM: implementation-config-variant=VARIANT-PRE-COMPILE, module-description=BswM_Impl
    BswMGeneral:
      BswMMainFunctionPeriod = 0.01
      BswMVersionInfoApi = false
      BswMDevErrorDetect = true
      BswMJ1939NmEnabled = false
      BswMNmEnabled = false
      BswMPduREnabled = false
      BswMSdEnabled = false
      BswMModeCheck = true
      BswMEcuMEnabled = true
      BswMGenericRequestEnabled = true
      BswMNvMEnabled = true
      BswMRuleControlEnabled = true
      BswMCanSMEnabled = false
      BswMComMEnabled = false
      BswMDcmEnabled = false
      BswMEthSMEnabled = false
      BswMFrSMEnabled = false
      BswMJ1939DcmEnabled = false
      BswMLinSMEnabled = false
      BswMLinTPEnabled = false
      BswMWdgMEnabled = false
      BswMCommonData
      BswMGeneration:
        BswMOutOfBoundsWriteSanitizer = false
        BswMOutOfBoundsReadSanitizer = false
        BswMReduceConstantData2Define = true
        BswMReduceDataByStreaming = false
        BswMBoolDataInArrayOfStructStrategy = BITMASKING
        BswMInterfacesForDeactivatedData = false
      BswMUserIncludeFiles: BswMUserIncludeFile=BswM_UserTypes.h
    BswMConfig
      BswMArbitration
        3 x BswMLogicalExpression:
          LogicalExpression_GoOff: BswMLogicalOperator=BSWM_OR, BswMArgumentRef=ModeCondition_GoOffOne_HardReset, BswMArgumentRef=ModeCondition_GoOffOne_Reprogram, BswMArgumentRef=ModeCondition_GoOffOne_Switchoff, BswMArgumentRef=BswM_ShutdownStates_BSWM_EQUALS_GOOFFONE_SOFTRESET
          LogicalExpression_Prepshutdown: BswMLogicalOperator=BSWM_OR, BswMArgumentRef=ModeCondition_PrepShutdown_Reprogram, BswMArgumentRef=ModeCondition_SysStMod, BswMArgumentRef=ModeCondition_PrepShutdown_SoftReset, BswMArgumentRef=BswM_PrepShutdownStatesDef_BSWM_EQUALS_PREPSHUTDOWN_HARDRESET
          LogicalExpression_Run: BswMArgumentRef=ModeCondition_Run
        ModeCondition_GoOffOne_HardReset (BswMModeCondition): BswMConditionType=BSWM_EQUALS, BswMConditionMode=BswM_ShutdownStates
          BswMConditionValue
            BswMBswMode: BswMBswRequestedMode=GOOFFONE_HARDRESET
        BSWM_STATE (BswMModeRequestPort): BswMArbitrateOnInit=false, BswMRequestProcessing=BSWM_FORCED_IMMEDIATE
          BswMModeRequestSource
            BswMGenericRequest: BswMModeRequesterId=0, BswMRequestedModeMax=9
              9 x BswMGenericRequestMode:
                BSWM_GO_OFF_ONE: BswMGenericRequestModeValue=6
                BSWM_GO_OFF_TWO: BswMGenericRequestModeValue=7
                BSWM_PREP_SHUTDOWN: BswMGenericRequestModeValue=4
                BSWM_RUN: BswMGenericRequestModeValue=3
                BSWM_STARTUP_ONE: BswMGenericRequestModeValue=0
                BSWM_STARTUP_TWO: BswMGenericRequestModeValue=1
                BSWM_STARTUP_TWO_A: BswMGenericRequestModeValue=2
                BSWM_GO_OFF_ONE_A: BswMGenericRequestModeValue=5
                BSWM_RESTART: BswMGenericRequestModeValue=8
          BswMModeInitValue
            BswMBswModeInitValue: BswMBswModeInitValueMode=BSWM_STARTUP_TWO_A
        BswM_ShutdownStates (BswMModeRequestPort): BswMArbitrateOnInit=false, BswMRequestProcessing=BSWM_IMMEDIATE
          BswMModeRequestSource
            BswMGenericRequest: BswMModeRequesterId=1, BswMRequestedModeMax=10
              10 x BswMGenericRequestMode:
                DEFAULT: BswMGenericRequestModeValue=9
                GOOFFONE_REPROGRAM: BswMGenericRequestModeValue=6
                GOOFFONE_HARDRESET: BswMGenericRequestModeValue=5
                GOOFFONE_SWITCHOFF: BswMGenericRequestModeValue=4
                PREPSHUTDOWN_HARDRESET: BswMGenericRequestModeValue=1
                PREPSHUTDOWN_REPROGRAM: BswMGenericRequestModeValue=2
                PREPSHUTDOWN_SWITCHOFF: BswMGenericRequestModeValue=0
                GOOFFONE_SOFTRESET: BswMGenericRequestModeValue=7
                PREPSHUTDOWN_SOFTRESET: BswMGenericRequestModeValue=3
                RESTART: BswMGenericRequestModeValue=8
          BswMModeInitValue
            BswMBswModeInitValue: BswMBswModeInitValueMode=DEFAULT
        5 x BswMModeCondition, all with BswMConditionType=BSWM_EQUALS:
          ModeCondition_GoOffOne_Reprogram: BswMConditionMode=BswM_ShutdownStates
            BswMConditionValue
              BswMBswMode: BswMBswRequestedMode=GOOFFONE_REPROGRAM
          ModeCondition_GoOffOne_Switchoff: BswMConditionMode=BswM_ShutdownStates
            BswMConditionValue
              BswMBswMode: BswMBswRequestedMode=GOOFFONE_SWITCHOFF
          ModeCondition_PrepShutdown_Reprogram: BswMConditionMode=BswM_PrepShutdownStatesDef
            BswMConditionValue
              BswMBswMode: BswMBswRequestedMode=PREPSHUTDOWN_REPROGRAM
          ModeCondition_Run: BswMConditionMode=BSWM_STATE
            BswMConditionValue
              BSWM_RUN (BswMBswMode): BswMBswRequestedMode=BSWM_RUN
          ModeCondition_SysStMod: BswMConditionMode=ModeRequest_SysStMod
            BswMConditionValue
              BswMBswMode: BswMBswRequestedMode=1
        3 x BswMRule, all with BswMRuleInitState=BSWM_FALSE:
          BSWM_GOOFFONE: BswMRuleId=0, BswMNestedExecutionOnly=true, BswMRuleExpressionRef=LogicalExpression_GoOff, BswMRuleTrueActionList=GOOFFONE
          BSWM_PREPSHUTDOWN: BswMNestedExecutionOnly=false, BswMRuleId=1, BswMRuleExpressionRef=LogicalExpression_Prepshutdown, BswMRuleTrueActionList=PREPSHUTDOWN
          BSWM_RUN: BswMNestedExecutionOnly=false, BswMRuleId=3, BswMRuleExpressionRef=LogicalExpression_Run, BswMRuleTrueActionList=RUN
        ModeCondition_EngRunng (BswMModeCondition): BswMConditionType=BSWM_EQUALS, BswMConditionMode=ModeRequest_EngRunActv
          BswMConditionValue
            BswMBswMode: BswMBswRequestedMode=TRUE
        EnaCdnA (BswMRule):
          BswMNestedExecutionOnly = false
          BswMRuleId = 4
          BswMRuleInitState = BSWM_UNDEFINED
          BswMRuleExpressionRef = LogicalExpression_EnaCdnA
          BswMRuleTrueActionList = EnaCdnATrue
          BswMRuleFalseActionList = EnaCdnAFalse
        LogicalExpression_EnaCdnA (BswMLogicalExpression): BswMLogicalOperator=BSWM_OR, BswMArgumentRef=ModeCondition_SysPwrModRun, BswMArgumentRef=LogicalExpression_EnaCdnA_AND
        3 x BswMModeRequestPort, all with BswMArbitrateOnInit=false, BswMRequestProcessing=BSWM_DEFERRED:
          ModeRequest_SysStMod
            BswMModeRequestSource
              BswMUserConditionRequest: BswMUserCondition=Rte_SysStMod_SysSt_Val
          ModeRequest_EngRunActv
            BswMModeRequestSource
              BswMUserConditionRequest: BswMUserCondition=Rte_GmMsg0C9BusHiSpd_EngRunActv_Logl
            BswMModeInitValue
              BswMBswModeInitValue: BswMBswModeInitValueMode=FALSE
          ModeRequest_MissMsg1F1
            BswMModeRequestSource
              BswMUserConditionRequest: BswMUserCondition=Rte_GmMsg1F1BusHiSpd_MissMsg1F1_Logl
            BswMModeInitValue
              BswMBswModeInitValue: BswMBswModeInitValueMode=FALSE
        ModeCondition_SysPwrModRun (BswMModeCondition): BswMConditionType=BSWM_EQUALS, BswMConditionMode=ModeRequest_SysPwrMod
          BswMConditionValue
            BswMBswMode: BswMBswRequestedMode=GMSYSPWRMOD_RUN
        ModeCondition_MissMsg1F1 (BswMModeCondition): BswMConditionType=BSWM_EQUALS, BswMConditionMode=ModeRequest_MissMsg1F1
          BswMConditionValue
            BswMBswMode: BswMBswRequestedMode=TRUE
        ModeRequest_MissMsg0C9 (BswMModeRequestPort): BswMArbitrateOnInit=false, BswMRequestProcessing=BSWM_DEFERRED
          BswMModeRequestSource
            BswMUserConditionRequest: BswMUserCondition=Rte_GmMsg0C9BusHiSpd_MissMsg0C9_Logl
          BswMModeInitValue
            BswMBswModeInitValue: BswMBswModeInitValueMode=FALSE
        ModeCondition_MissMsg0C9 (BswMModeCondition): BswMConditionType=BSWM_EQUALS, BswMConditionMode=ModeRequest_MissMsg0C9
          BswMConditionValue
            BswMBswMode: BswMBswRequestedMode=TRUE
        LogicalExpression_EnaCdnB (BswMLogicalExpression): BswMLogicalOperator=BSWM_OR, BswMArgumentRef=LogicalExpression_EnaCdnB_AND, BswMArgumentRef=ModeCondition_EngRunng
        EnaCdnB (BswMRule):
          BswMNestedExecutionOnly = false
          BswMRuleId = 5
          BswMRuleInitState = BSWM_UNDEFINED
          BswMRuleExpressionRef = LogicalExpression_EnaCdnB
          BswMRuleTrueActionList = EnaCdnBTrue
          BswMRuleFalseActionList = EnaCdnBFalse
        ModeRequest_BattVltgLow (BswMModeRequestPort): BswMArbitrateOnInit=false, BswMRequestProcessing=BSWM_DEFERRED
          BswMModeRequestSource
            BswMUserConditionRequest: BswMUserCondition=(Rte_BattVltg_BrdgVltg_Val > 6.0f)
          BswMModeInitValue
            BswMBswModeInitValue: BswMBswModeInitValueMode=FALSE
        EnaCdnC (BswMRule):
          BswMNestedExecutionOnly = false
          BswMRuleId = 6
          BswMRuleInitState = BSWM_UNDEFINED
          BswMRuleExpressionRef = LogicalExpression_EnaCdnC
          BswMRuleTrueActionList = EnaCdnCTrue
          BswMRuleFalseActionList = EnaCdnCFalse
        ModeCondition_BattVltgLow (BswMModeCondition): BswMConditionType=BSWM_EQUALS, BswMConditionMode=ModeRequest_BattVltgLow
          BswMConditionValue
            BswMBswMode: BswMBswRequestedMode=TRUE
        LogicalExpression_EnaCdnC (BswMLogicalExpression): BswMArgumentRef=ModeCondition_BattVltgLow
        ModeRequest_BattVltgMed (BswMModeRequestPort): BswMArbitrateOnInit=false, BswMRequestProcessing=BSWM_DEFERRED
          BswMModeRequestSource
            BswMUserConditionRequest: BswMUserCondition=(Rte_BattVltg_BrdgVltg_Val > 9.0f)
          BswMModeInitValue
            BswMBswModeInitValue: BswMBswModeInitValueMode=FALSE
        ModeRequest_BattVltgHigh (BswMModeRequestPort): BswMArbitrateOnInit=false, BswMRequestProcessing=BSWM_DEFERRED
          BswMModeRequestSource
            BswMUserConditionRequest: BswMUserCondition=(Rte_BattVltg_BrdgVltg_Val < 16.0f)
          BswMModeInitValue
            BswMBswModeInitValue: BswMBswModeInitValueMode=FALSE
        EnaCdnD (BswMRule):
          BswMNestedExecutionOnly = false
          BswMRuleId = 7
          BswMRuleInitState = BSWM_UNDEFINED
          BswMRuleExpressionRef = LogicalExpression_EnaCdnD
          BswMRuleTrueActionList = EnaCdnDTrue
          BswMRuleFalseActionList = EnaCdnDFalse
        ModeCondition_BattVltgMed (BswMModeCondition): BswMConditionType=BSWM_EQUALS, BswMConditionMode=ModeRequest_BattVltgMed
          BswMConditionValue
            BswMBswMode: BswMBswRequestedMode=TRUE
        LogicalExpression_EnaCdnD (BswMLogicalExpression): BswMArgumentRef=ModeCondition_BattVltgMed
        ModeCondition_BattVltgHigh (BswMModeCondition): BswMConditionType=BSWM_EQUALS, BswMConditionMode=ModeRequest_BattVltgHigh
          BswMConditionValue
            BswMBswMode: BswMBswRequestedMode=TRUE
        LogicalExpression_EnaCdnE (BswMLogicalExpression): BswMArgumentRef=ModeCondition_BattVltgHigh
        5 x BswMRule, all with BswMNestedExecutionOnly=false, BswMRuleInitState=BSWM_UNDEFINED:
          EnaCdnE: BswMRuleId=8, BswMRuleExpressionRef=LogicalExpression_EnaCdnE, BswMRuleTrueActionList=EnaCdnETrue, BswMRuleFalseActionList=EnaCdnEFalse
          EnaCdnF: BswMRuleId=9, BswMRuleExpressionRef=LogicalExpression_EnaCdnF, BswMRuleTrueActionList=EnaCdnFStrt
          EnaCdnG: BswMRuleId=11, BswMRuleExpressionRef=LogicalExpression_EnaCdnG, BswMRuleTrueActionList=EnaCdnGTrue, BswMRuleFalseActionList=EnaCdnGFalse
          EnaCdnH: BswMRuleId=12, BswMRuleExpressionRef=LogicalExpression_EnaCdnH, BswMRuleTrueActionList=EnaCdnHTrue, BswMRuleFalseActionList=EnaCdnHFalse
          EnaCdnI: BswMRuleId=13, BswMRuleExpressionRef=LogicalExpression_EnaCdnI, BswMRuleTrueActionList=EnaCdnITrue, BswMRuleFalseActionList=EnaCdnIFalse
        EnaCdnFTmr (BswMModeRequestPort): BswMArbitrateOnInit=false, BswMRequestProcessing=BSWM_DEFERRED
          BswMModeRequestSource
            BswMTimer
          BswMModeInitValue
            BswMBswModeInitValue: BswMBswModeInitValueMode=BSWM_TIMER_STOPPED
        EnaCdnFTiOut (BswMRule):
          BswMNestedExecutionOnly = false
          BswMRuleId = 10
          BswMRuleInitState = BSWM_UNDEFINED
          BswMRuleExpressionRef = LogicalExpression_EnaCdnFTiOut
          BswMRuleTrueActionList = EnaCdnFTrue
        ModeCondition_EnaCdnFTmr (BswMModeCondition): BswMConditionType=BSWM_EQUALS, BswMConditionMode=EnaCdnFTmr
          BswMConditionValue
            BswMBswMode: BswMBswRequestedMode=BSWM_TIMER_EXPIRED
        LogicalExpression_EnaCdnFTiOut (BswMLogicalExpression): BswMArgumentRef=ModeCondition_EnaCdnFTmr
        EnaCdnStrtUp (BswMRule):
          BswMNestedExecutionOnly = false
          BswMRuleId = 17
          BswMRuleInitState = BSWM_UNDEFINED
          BswMRuleExpressionRef = LogicalExpression_AlwaysTrue
          BswMRuleTrueActionList = BswMModeControl/EnaCdnStrtUp
        ModeRequest_AlwaysTrue (BswMModeRequestPort): BswMArbitrateOnInit=false, BswMRequestProcessing=BSWM_DEFERRED
          BswMModeRequestSource
            BswMUserConditionRequest: BswMUserCondition=TRUE
          BswMModeInitValue
            BswMBswModeInitValue: BswMBswModeInitValueMode=TRUE
        ModeCondition_AlwaysTrue (BswMModeCondition): BswMConditionType=BSWM_EQUALS, BswMConditionMode=ModeRequest_AlwaysTrue
          BswMConditionValue
            BswMBswMode: BswMBswRequestedMode=TRUE
        LogicalExpression_AlwaysTrue (BswMLogicalExpression): BswMArgumentRef=ModeCondition_AlwaysTrue
        ModeRequest_SysPwrMod (BswMModeRequestPort): BswMArbitrateOnInit=false, BswMRequestProcessing=BSWM_DEFERRED
          BswMModeRequestSource
            BswMUserConditionRequest: BswMUserCondition=Rte_GmMsg1F1BusHiSpd_SysPwrMod_Val
          BswMModeInitValue
            BswMBswModeInitValue: BswMBswModeInitValueMode=0
        ModeCondition_SysPwrModCrk (BswMModeCondition): BswMConditionType=BSWM_EQUALS, BswMConditionMode=ModeRequest_SysPwrMod
          BswMConditionValue
            BswMBswMode: BswMBswRequestedMode=GMSYSPWRMOD_CRK
        LogicalExpression_EnaCdnF (BswMLogicalExpression): BswMLogicalOperator=BSWM_OR, BswMArgumentRef=ModeCondition_SysPwrModCrk, BswMArgumentRef=ModeRequest_Dtc480012Faild_BSWM_EQUALS_TRUE
        ModeRequest_BusOffHiSpd (BswMModeRequestPort): BswMArbitrateOnInit=false, BswMRequestProcessing=BSWM_DEFERRED
          BswMModeRequestSource
            BswMUserConditionRequest: BswMUserCondition=Rte_SerlComOutpProxy_BusOffHiSpd_Logl
          BswMModeInitValue
            BswMBswModeInitValue: BswMBswModeInitValueMode=TRUE
        ModeRequest_BusOffChassisExp (BswMModeRequestPort): BswMArbitrateOnInit=false, BswMRequestProcessing=BSWM_DEFERRED
          BswMModeRequestSource
            BswMUserConditionRequest: BswMUserCondition=Rte_SerlComOutpProxy_BusOffChassisExp_Logl
          BswMModeInitValue
            BswMBswModeInitValue: BswMBswModeInitValueMode=TRUE
        Mode_BusOffHiSpd (BswMModeCondition): BswMConditionType=BSWM_EQUALS, BswMConditionMode=ModeRequest_BusOffHiSpd
          BswMConditionValue
            BswMBswMode: BswMBswRequestedMode=FALSE
        LogicalExpression_EnaCdnG (BswMLogicalExpression): BswMArgumentRef=Mode_BusOffHiSpd
        ModeCondition_BusOffChassisExp (BswMModeCondition): BswMConditionType=BSWM_EQUALS, BswMConditionMode=ModeRequest_BusOffChassisExp
          BswMConditionValue
            BswMBswMode: BswMBswRequestedMode=FALSE
        LogicalExpression_EnaCdnH (BswMLogicalExpression): BswMArgumentRef=ModeCondition_BusOffChassisExp
        ModeRequest_CustMfgEnaSt (BswMModeRequestPort): BswMArbitrateOnInit=false, BswMRequestProcessing=BSWM_DEFERRED
          BswMModeRequestSource
            BswMUserConditionRequest: BswMUserCondition=Rte_PartNr_CustMfgEnSt_Val
          BswMModeInitValue
            BswMBswModeInitValue: BswMBswModeInitValueMode=1
        ModeCondition_CustMfgEnaSt_Prdn (BswMModeCondition): BswMConditionType=BSWM_EQUALS, BswMConditionMode=ModeRequest_CustMfgEnaSt
          BswMConditionValue
            BswMBswMode: BswMBswRequestedMode=MFGENAST_PRDNMOD
        ModeCondition_CustMfgEnaSt_Test (BswMModeCondition): BswMConditionType=BSWM_EQUALS, BswMConditionMode=ModeRequest_CustMfgEnaSt
          BswMConditionValue
            BswMBswMode: BswMBswRequestedMode=MFGENAST_TESTMOD
        LogicalExpression_EnaCdnI (BswMLogicalExpression): BswMLogicalOperator=BSWM_OR, BswMArgumentRef=ModeCondition_CustMfgEnaSt_Prdn, BswMArgumentRef=ModeCondition_CustMfgEnaSt_Test
        ModeRequest_Dtc480012Faild (BswMModeRequestPort): BswMArbitrateOnInit=false, BswMRequestProcessing=BSWM_DEFERRED
          BswMModeRequestSource
            BswMUserConditionRequest: BswMUserCondition=BswMUser_GetDtcFailed(DemConf_DemEventParameter_DevPwrVltgUnderMinThd)
          BswMModeInitValue
            BswMBswModeInitValue: BswMBswModeInitValueMode=TRUE
        ModeRequest_Dtc480012Faild_BSWM_EQUALS_TRUE (BswMModeCondition): BswMConditionType=BSWM_EQUALS, BswMConditionMode=ModeRequest_Dtc480012Faild
          BswMConditionValue
            BswMBswMode: BswMBswRequestedMode=TRUE
        EnaCdnJ (BswMRule):
          BswMNestedExecutionOnly = false
          BswMRuleId = 14
          BswMRuleInitState = BSWM_UNDEFINED
          BswMRuleExpressionRef = LogicalExpression_EnaCdnJ
          BswMRuleTrueActionList = EnaCdnJTrue
          BswMRuleFalseActionList = EnaCdnJFalse
        ModeRequest_SerlComDi (BswMModeRequestPort): BswMArbitrateOnInit=false, BswMRequestProcessing=BSWM_DEFERRED
          BswMModeRequestSource
            BswMUserConditionRequest: BswMUserCondition=Rte_CustDiagc_SerlComDi_Logl
        EnaCdnJTmr (BswMModeRequestPort): BswMArbitrateOnInit=false, BswMRequestProcessing=BSWM_DEFERRED
          BswMModeRequestSource
            BswMTimer
          BswMModeInitValue
            BswMBswModeInitValue: BswMBswModeInitValueMode=BSWM_TIMER_STOPPED
        ModeCondition_SerlComDi (BswMModeCondition): BswMConditionType=BSWM_EQUALS, BswMConditionMode=ModeRequest_SerlComDi
          BswMConditionValue
            BswMBswMode: BswMBswRequestedMode=FALSE
        LogicalExpression_EnaCdnJ (BswMLogicalExpression): BswMArgumentRef=ModeCondition_SerlComDi
        EnaCdnJTiOut (BswMRule):
          BswMNestedExecutionOnly = false
          BswMRuleId = 15
          BswMRuleInitState = BSWM_UNDEFINED
          BswMRuleExpressionRef = LogicalExpression_EnaCdnJTiOut
          BswMRuleTrueActionList = EnaCdnJDly
        ModeCondition_EnaCdnJTiOut (BswMModeCondition): BswMConditionType=BSWM_EQUALS, BswMConditionMode=EnaCdnJTmr
          BswMConditionValue
            BswMBswMode: BswMBswRequestedMode=BSWM_TIMER_EXPIRED
        3 x BswMLogicalExpression:
          LogicalExpression_EnaCdnJTiOut: BswMArgumentRef=ModeCondition_EnaCdnJTiOut
          LogicalExpression_EnaCdnA_AND: BswMLogicalOperator=BSWM_AND, BswMArgumentRef=ModeCondition_MissMsg1F1, BswMArgumentRef=Mode_BusOffHiSpd
          LogicalExpression_EnaCdnB_AND: BswMLogicalOperator=BSWM_AND, BswMArgumentRef=ModeCondition_MissMsg0C9, BswMArgumentRef=Mode_BusOffHiSpd
        EnaCdnK (BswMRule):
          BswMNestedExecutionOnly = false
          BswMRuleId = 16
          BswMRuleInitState = BSWM_UNDEFINED
          BswMRuleExpressionRef = LogicalExpression_EnaCdnK
          BswMRuleTrueActionList = EnaCdnKTrue
          BswMRuleFalseActionList = EnaCdnKFalse
        LogicalExpression_EnaCdnK (BswMLogicalExpression): BswMLogicalOperator=BSWM_AND, BswMArgumentRef=ModeCondition_SysPwrModRun, BswMArgumentRef=ModeCondition_EngRunng
        BswM_PrepShutdownStatesDef (BswMModeRequestPort): BswMArbitrateOnInit=false, BswMRequestProcessing=BSWM_DEFERRED
          BswMModeRequestSource
            BswMGenericRequest: BswMModeRequesterId=2, BswMRequestedModeMax=3
              4 x BswMGenericRequestMode:
                DEFAULT: BswMGenericRequestModeValue=2
                PREPSHUTDOWN_REPROGRAM: BswMGenericRequestModeValue=0
                PREPSHUTDOWN_SOFTRESET: BswMGenericRequestModeValue=1
                PREPSHUTDOWN_HARDRESET: BswMGenericRequestModeValue=3
          BswMModeInitValue
            BswMBswModeInitValue: BswMBswModeInitValueMode=DEFAULT
        LogicalExpression_Restart (BswMLogicalExpression): BswMArgumentRef=BSWM_STATE_BSWM_EQUALS_BSWM_RESTART
        4 x BswMModeCondition, all with BswMConditionType=BSWM_EQUALS:
          BswM_ShutdownStates_BSWM_EQUALS_GOOFFONE_SOFTRESET: BswMConditionMode=BswM_ShutdownStates
            BswMConditionValue
              BswMBswMode: BswMBswRequestedMode=GOOFFONE_SOFTRESET
          BSWM_STATE_BSWM_EQUALS_BSWM_RESTART: BswMConditionMode=BSWM_STATE
            BswMConditionValue
              BswMBswMode: BswMBswRequestedMode=BSWM_RESTART
          ModeCondition_PrepShutdown_SoftReset: BswMConditionMode=BswM_PrepShutdownStatesDef
            BswMConditionValue
              BswMBswMode: BswMBswRequestedMode=PREPSHUTDOWN_SOFTRESET
          BswM_PrepShutdownStatesDef_BSWM_EQUALS_PREPSHUTDOWN_HARDRESET: BswMConditionMode=BswM_PrepShutdownStatesDef
            BswMConditionValue
              BswMBswMode: BswMBswRequestedMode=PREPSHUTDOWN_HARDRESET
        BSWM_RESTART (BswMRule):
          BswMNestedExecutionOnly = false
          BswMRuleId = 2
          BswMRuleInitState = BSWM_FALSE
          BswMRuleExpressionRef = LogicalExpression_Restart
          BswMRuleTrueActionList = BswMModeControl/RESTART
        ModeCondition_GoOffOne_SoftReset (BswMModeCondition): BswMConditionType=BSWM_EQUALS, BswMConditionMode=BswM_ShutdownStates
          BswMConditionValue
            BswMBswMode: BswMBswRequestedMode=GOOFFONE_SOFTRESET
        ModeCondition_Restart (BswMModeCondition): BswMConditionType=BSWM_EQUALS, BswMConditionMode=BSWM_STATE
          BswMConditionValue
            BswMBswMode: BswMBswRequestedMode=BSWM_RESTART
      BswMModeControl: BswMInitActionListRef=INIT_AL_Initialize
        4 x BswMActionList:
          GOOFFONE: BswMActionListExecution=BSWM_CONDITION
            3 x BswMActionListItem, all with BswMAbortOnFail=false:
              ChangeMode_GoOffOne: BswMActionListItemIndex=0, BswMActionListItemRef=BswMModeControl/ChangeMode_GoOffOne
              NvMWriteAll: BswMActionListItemIndex=1, BswMActionListItemRef=BswMModeControl/NvMWriteAll
              BswM_FinalizeShtdwn: BswMActionListItemIndex=2, BswMActionListItemRef=BswMModeControl/BswM_FinalizeShtdwn
          INIT_AL_Initialize: BswMActionListExecution=BSWM_CONDITION
            13 x BswMActionListItem, all with BswMAbortOnFail=false:
              INIT_Action_Fee_Init: BswMActionListItemIndex=0, BswMActionListItemRef=BswMModeControl/INIT_Action_Fee_Init
              INIT_Action_NvM_Init: BswMActionListItemIndex=1, BswMActionListItemRef=BswMModeControl/INIT_Action_NvM_Init
              INIT_Action_NvMReadAll: BswMActionListItemIndex=2, BswMActionListItemRef=BswMModeControl/INIT_Action_NvMReadAll
              Action_Dem_Init: BswMActionListItemIndex=3, BswMActionListItemRef=BswMModeControl/Action_Dem_Init
              INIT_Action_RteStart: BswMActionListItemIndex=6, BswMActionListItemRef=BswMModeControl/INIT_Action_RteStart
              ChangeMode_Run: BswMActionListItemIndex=9, BswMActionListItemRef=BswMModeControl/ChangeMode_Run
              INIT_Action_FlsMem_Init: BswMActionListItemIndex=12, BswMActionListItemRef=BswMModeControl/INIT_Action_FlsMem_Init
              INIT_Action_NxtrWdgM_Init: BswMActionListItemIndex=4, BswMActionListItemRef=BswMModeControl/INIT_Action_NxtrWdgM_Init
              INIT_Action_GMLAN: BswMActionListItemIndex=5, BswMActionListItemRef=BswMModeControl/INIT_Action_GMLAN
              INIT_Action_SyncCrc_Init: BswMActionListItemIndex=11, BswMActionListItemRef=BswMModeControl/INIT_Action_SyncCrc_Init
              EnableOsTimer: BswMActionListItemIndex=8, BswMActionListItemRef=BswMModeControl/EnableOsTimer
              GuardCfgAndDiagcInit1: BswMActionListItemIndex=10, BswMActionListItemRef=BswMModeControl/GuardCfgAndDiagcInit1
              EnableMotCtrlIsr: BswMActionListItemIndex=7, BswMActionListItemRef=BswMModeControl/EnableMotCtrlIsr
          PREPSHUTDOWN: BswMActionListExecution=BSWM_CONDITION
            6 x BswMActionListItem, all with BswMAbortOnFail=false:
              ChangeMode_PrepShutdown: BswMActionListItemIndex=0, BswMActionListItemRef=BswMModeControl/ChangeMode_PrepShutdown
              DemShutdown: BswMActionListItemIndex=1, BswMActionListItemRef=BswMModeControl/DemShutdown
              BswM_ShtdwnHndlg_PrepShutdown: BswMActionListItemIndex=3, BswMActionListItemRef=BswMModeControl/BswM_ShtdwnHndlg_PrepShutdown
              BSWM_GOOFFONE: BswMActionListItemIndex=5, BswMActionListItemRef=BswMArbitration/BSWM_GOOFFONE
              GetResource_ShutdownOngoing: BswMActionListItemIndex=2, BswMActionListItemRef=BswMModeControl/GetResource_ShutdownOngoing
              DiagcMgrPwrDwn: BswMActionListItemIndex=4, BswMActionListItemRef=BswMModeControl/DiagcMgrPwrDwn
          RUN: BswMActionListExecution=BSWM_TRIGGER
        19 x BswMAction:
          INIT_Action_RteStart
            BswMAvailableActions
              BswMUserCallout: BswMUserCalloutFunction=Rte_Start(), BswMCreateCallout=false, BswMUserIncludeFile=Rte_Main.h
          INIT_Action_Fee_Init
            BswMAvailableActions
              BswMUserCallout: BswMUserCalloutFunction=Fee_Init(), BswMCreateCallout=false, BswMUserIncludeFile=Fee.h
          INIT_Action_NvM_Init
            BswMAvailableActions
              BswMUserCallout: BswMUserCalloutFunction=NvM_Init(), BswMCreateCallout=false, BswMUserIncludeFile=NvM.h
          INIT_Action_NvMReadAll
            BswMAvailableActions
              BswMUserCallout: BswMUserCalloutFunction=BswM_INIT_NvMReadAll(), BswMCreateCallout=true, BswMUserIncludeFile=Fls.h
          INIT_Action_NxtrWdgM_Init
            BswMAvailableActions
              BswMUserCallout: BswMUserCalloutFunction=Call_NxtrWdgM_Init(), BswMCreateCallout=false, BswMUserIncludeFile=NxtrWdgM.h
          INIT_Action_GMLAN
            BswMAvailableActions
              BswMUserCallout: BswMUserCalloutFunction=(void)CallNonTrustedFunction(NtWrapS_GMLANInit , NULL_PTR), BswMCreateCallout=false, BswMUserIncludeFile=Os.h
          NvMWriteAll
            BswMAvailableActions
              BswMUserCallout: BswMUserCalloutFunction=BswM_SHUTDOWN_NvMWriteAll(), BswMCreateCallout=true
          DemShutdown
            BswMAvailableActions
              BswMUserCallout: BswMUserCalloutFunction=Dem_Shutdown(), BswMCreateCallout=false, BswMUserIncludeFile=Dem.h
          ChangeMode_PrepShutdown
            BswMAvailableActions
              BswMGenericModeSwitch: BswMGenericRequestRef=BSWM_STATE, BswMGenericRequestModeRef=BSWM_PREP_SHUTDOWN
          ChangeMode_GoOffOne
            BswMAvailableActions
              BswMGenericModeSwitch: BswMGenericRequestRef=BSWM_STATE, BswMGenericRequestModeRef=BSWM_GO_OFF_ONE
          ChangeMode_Run
            BswMAvailableActions
              BswMGenericModeSwitch: BswMGenericRequestRef=BSWM_STATE, BswMGenericRequestModeRef=BswMGenericRequest/BSWM_RUN
          BswM_ShtdwnHndlg_PrepShutdown
            BswMAvailableActions
              BswMUserCallout: BswMUserCalloutFunction=BswM_ShtdwnHndlg_PrepShutdown(), BswMCreateCallout=true
          EnableMotCtrlIsr
            BswMAvailableActions
              BswMUserCallout: BswMUserCalloutFunction=osClearIMRmEI(16U), BswMCreateCallout=false, BswMUserIncludeFile=osekext.h
          GuardCfgAndDiagcInit1
            BswMAvailableActions
              BswMUserCallout: BswMUserCalloutFunction=GuardCfgAndDiagcInit1(), BswMCreateCallout=false, BswMUserIncludeFile=CDD_GuardCfgAndDiagc.h
          EnableOsTimer
            BswMAvailableActions
              BswMUserCallout: BswMUserCalloutFunction=OSTM0TS = 1U, BswMCreateCallout=false, BswMUserIncludeFile=ostm_regs.h
          INIT_Action_SyncCrc_Init
            BswMAvailableActions
              BswMUserCallout: BswMUserCalloutFunction=SyncCrcInit0(), BswMCreateCallout=false, BswMUserIncludeFile=CDD_SyncCrc.h
          INIT_Action_FlsMem_Init
            BswMAvailableActions
              BswMUserCallout: BswMUserCalloutFunction=FlsMemInit2(), BswMCreateCallout=false, BswMUserIncludeFile=CDD_FlsMem.h
          EnaCdnAEnaDiagcMgr
            BswMAvailableActions
              BswMUserCallout: BswMUserCalloutFunction=UpdDtcEnaCdn(TRUE, 0), BswMCreateCallout=false, BswMUserIncludeFile=DiagcMgr.h
          EnaCdnADiDiagcMgr
            BswMAvailableActions
              BswMUserCallout: BswMUserCalloutFunction=UpdDtcEnaCdn(FALSE, 0), BswMCreateCallout=false, BswMUserIncludeFile=DiagcMgr.h
        EnaCdnATrue (BswMActionList): BswMActionListExecution=BSWM_TRIGGER
          EnaCdnAEnaDiagcMgr (BswMActionListItem): BswMAbortOnFail=false, BswMActionListItemIndex=0, BswMActionListItemRef=BswMModeControl/EnaCdnAEnaDiagcMgr
          EnaCdnAEnaDem (BswMActionListItem): BswMAbortOnFail=false, BswMActionListItemIndex=1, BswMActionListItemRef=BswMModeControl/EnaCdnAEnaDem
        EnaCdnAFalse (BswMActionList): BswMActionListExecution=BSWM_TRIGGER
          EnaCdnADiDiagcMgr (BswMActionListItem): BswMAbortOnFail=false, BswMActionListItemIndex=0, BswMActionListItemRef=BswMModeControl/EnaCdnADiDiagcMgr
          EnaCdnADiDem (BswMActionListItem): BswMAbortOnFail=false, BswMActionListItemIndex=1, BswMActionListItemRef=BswMModeControl/EnaCdnADiDem
        34 x BswMAction:
          EnaCdnAEnaDem
            BswMAvailableActions
              BswMUserCallout:
                BswMUserCalloutFunction = Dem_SetEnableCondition(DemConf_DemEnableCondition_DemEnableConditionA, TRUE)
                BswMCreateCallout = false
                BswMUserIncludeFile = Dem.h
          EnaCdnADiDem
            BswMAvailableActions
              BswMUserCallout:
                BswMUserCalloutFunction = Dem_SetEnableCondition(DemConf_DemEnableCondition_DemEnableConditionA, FALSE)
                BswMCreateCallout = false
                BswMUserIncludeFile = Dem.h
          EnaCdnBEnaDiagcMgr
            BswMAvailableActions
              BswMUserCallout: BswMUserCalloutFunction=UpdDtcEnaCdn(TRUE, 1), BswMCreateCallout=false, BswMUserIncludeFile=DiagcMgr.h
          EnaCdnBDiDiagcMgr
            BswMAvailableActions
              BswMUserCallout: BswMUserCalloutFunction=UpdDtcEnaCdn(FALSE, 1), BswMCreateCallout=false, BswMUserIncludeFile=DiagcMgr.h
          EnaCdnBEnaDem
            BswMAvailableActions
              BswMUserCallout:
                BswMUserCalloutFunction = Dem_SetEnableCondition(DemConf_DemEnableCondition_DemEnableConditionB, TRUE)
                BswMCreateCallout = false
                BswMUserIncludeFile = Dem.h
          EnaCdnBDiDem
            BswMAvailableActions
              BswMUserCallout:
                BswMUserCalloutFunction = Dem_SetEnableCondition(DemConf_DemEnableCondition_DemEnableConditionB, FALSE)
                BswMCreateCallout = false
                BswMUserIncludeFile = Dem.h
          EnaCdnCEnaDiagcMgr
            BswMAvailableActions
              BswMUserCallout: BswMUserCalloutFunction=UpdDtcEnaCdn(TRUE, 2), BswMCreateCallout=false, BswMUserIncludeFile=DiagcMgr.h
          EnaCdnCDiDiagcMgr
            BswMAvailableActions
              BswMUserCallout: BswMUserCalloutFunction=UpdDtcEnaCdn(FALSE, 2), BswMCreateCallout=false, BswMUserIncludeFile=DiagcMgr.h
          EnaCdnCEnaDem
            BswMAvailableActions
              BswMUserCallout:
                BswMUserCalloutFunction = Dem_SetEnableCondition(DemConf_DemEnableCondition_DemEnableConditionC, TRUE)
                BswMCreateCallout = false
                BswMUserIncludeFile = Dem.h
          EnaCdnCDiDem
            BswMAvailableActions
              BswMUserCallout:
                BswMUserCalloutFunction = Dem_SetEnableCondition(DemConf_DemEnableCondition_DemEnableConditionC, FALSE)
                BswMCreateCallout = false
                BswMUserIncludeFile = Dem.h
          EnaCdnDEnaDiagcMgr
            BswMAvailableActions
              BswMUserCallout: BswMUserCalloutFunction=UpdDtcEnaCdn(TRUE, 3), BswMCreateCallout=false, BswMUserIncludeFile=DiagcMgr.h
          EnaCdnDDiDiagcMgr
            BswMAvailableActions
              BswMUserCallout: BswMUserCalloutFunction=UpdDtcEnaCdn(FALSE, 3), BswMCreateCallout=false, BswMUserIncludeFile=DiagcMgr.h
          EnaCdnDEnaDem
            BswMAvailableActions
              BswMUserCallout:
                BswMUserCalloutFunction = Dem_SetEnableCondition(DemConf_DemEnableCondition_DemEnableConditionD, TRUE)
                BswMCreateCallout = false
                BswMUserIncludeFile = Dem.h
          EnaCdnDDiDem
            BswMAvailableActions
              BswMUserCallout:
                BswMUserCalloutFunction = Dem_SetEnableCondition(DemConf_DemEnableCondition_DemEnableConditionD, FALSE)
                BswMCreateCallout = false
                BswMUserIncludeFile = Dem.h
          EnaCdnEEnaDiagcMgr
            BswMAvailableActions
              BswMUserCallout: BswMUserCalloutFunction=UpdDtcEnaCdn(TRUE, 4), BswMCreateCallout=false, BswMUserIncludeFile=DiagcMgr.h
          EnaCdnEDiDiagcMgr
            BswMAvailableActions
              BswMUserCallout: BswMUserCalloutFunction=UpdDtcEnaCdn(FALSE, 4), BswMCreateCallout=false, BswMUserIncludeFile=DiagcMgr.h
          EnaCdnEEnaDem
            BswMAvailableActions
              BswMUserCallout:
                BswMUserCalloutFunction = Dem_SetEnableCondition(DemConf_DemEnableCondition_DemEnableConditionE, TRUE)
                BswMCreateCallout = false
                BswMUserIncludeFile = Dem.h
          EnaCdnEDiDem
            BswMAvailableActions
              BswMUserCallout:
                BswMUserCalloutFunction = Dem_SetEnableCondition(DemConf_DemEnableCondition_DemEnableConditionE, FALSE)
                BswMCreateCallout = false
                BswMUserIncludeFile = Dem.h
          EnaCdnFEnaDiagcMgr
            BswMAvailableActions
              BswMUserCallout: BswMUserCalloutFunction=UpdDtcEnaCdn(TRUE, 5), BswMCreateCallout=false, BswMUserIncludeFile=DiagcMgr.h
          EnaCdnFDiDiagcMgr
            BswMAvailableActions
              BswMUserCallout: BswMUserCalloutFunction=UpdDtcEnaCdn(FALSE, 5), BswMCreateCallout=false, BswMUserIncludeFile=DiagcMgr.h
          EnaCdnFEnaDem
            BswMAvailableActions
              BswMUserCallout:
                BswMUserCalloutFunction = Dem_SetEnableCondition(DemConf_DemEnableCondition_DemEnableConditionF, TRUE)
                BswMCreateCallout = false
                BswMUserIncludeFile = Dem.h
          EnaCdnFDiDem
            BswMAvailableActions
              BswMUserCallout:
                BswMUserCalloutFunction = Dem_SetEnableCondition(DemConf_DemEnableCondition_DemEnableConditionF, FALSE)
                BswMCreateCallout = false
                BswMUserIncludeFile = Dem.h
          EnaCdnGEnaDiagcMgr
            BswMAvailableActions
              BswMUserCallout: BswMUserCalloutFunction=UpdDtcEnaCdn(TRUE, 6), BswMCreateCallout=false, BswMUserIncludeFile=DiagcMgr.h
          EnaCdnGDiDiagcMgr
            BswMAvailableActions
              BswMUserCallout: BswMUserCalloutFunction=UpdDtcEnaCdn(FALSE, 6), BswMCreateCallout=false, BswMUserIncludeFile=DiagcMgr.h
          EnaCdnGEnaDem
            BswMAvailableActions
              BswMUserCallout:
                BswMUserCalloutFunction = Dem_SetEnableCondition(DemConf_DemEnableCondition_DemEnableConditionG, TRUE)
                BswMCreateCallout = false
                BswMUserIncludeFile = Dem.h
          EnaCdnGDiDem
            BswMAvailableActions
              BswMUserCallout:
                BswMUserCalloutFunction = Dem_SetEnableCondition(DemConf_DemEnableCondition_DemEnableConditionG, FALSE)
                BswMCreateCallout = false
                BswMUserIncludeFile = Dem.h
          EnaCdnHEnaDiagcMgr
            BswMAvailableActions
              BswMUserCallout: BswMUserCalloutFunction=UpdDtcEnaCdn(TRUE, 7), BswMCreateCallout=false, BswMUserIncludeFile=DiagcMgr.h
          EnaCdnHDiDiagcMgr
            BswMAvailableActions
              BswMUserCallout: BswMUserCalloutFunction=UpdDtcEnaCdn(FALSE, 7), BswMCreateCallout=false, BswMUserIncludeFile=DiagcMgr.h
          EnaCdnHEnaDem
            BswMAvailableActions
              BswMUserCallout:
                BswMUserCalloutFunction = Dem_SetEnableCondition(DemConf_DemEnableCondition_DemEnableConditionH, TRUE)
                BswMCreateCallout = false
                BswMUserIncludeFile = Dem.h
          EnaCdnHDiDem
            BswMAvailableActions
              BswMUserCallout:
                BswMUserCalloutFunction = Dem_SetEnableCondition(DemConf_DemEnableCondition_DemEnableConditionH, FALSE)
                BswMCreateCallout = false
                BswMUserIncludeFile = Dem.h
          EnaCdnIEnaDiagcMgr
            BswMAvailableActions
              BswMUserCallout: BswMUserCalloutFunction=UpdDtcEnaCdn(TRUE, 8), BswMCreateCallout=false, BswMUserIncludeFile=DiagcMgr.h
          EnaCdnIDiDiagcMgr
            BswMAvailableActions
              BswMUserCallout: BswMUserCalloutFunction=UpdDtcEnaCdn(FALSE, 8), BswMCreateCallout=false, BswMUserIncludeFile=DiagcMgr.h
          EnaCdnIEnaDem
            BswMAvailableActions
              BswMUserCallout:
                BswMUserCalloutFunction = Dem_SetEnableCondition(DemConf_DemEnableCondition_DemEnableConditionI, TRUE)
                BswMCreateCallout = false
                BswMUserIncludeFile = Dem.h
          EnaCdnIDiDem
            BswMAvailableActions
              BswMUserCallout:
                BswMUserCalloutFunction = Dem_SetEnableCondition(DemConf_DemEnableCondition_DemEnableConditionI, FALSE)
                BswMCreateCallout = false
                BswMUserIncludeFile = Dem.h
        15 x BswMActionList, all with BswMActionListExecution=BSWM_TRIGGER:
          EnaCdnBTrue
            EnaCdnBEnaDiagcMgr (BswMActionListItem): BswMAbortOnFail=false, BswMActionListItemIndex=0, BswMActionListItemRef=BswMModeControl/EnaCdnBEnaDiagcMgr
            EnaCdnBEnaDem (BswMActionListItem): BswMAbortOnFail=false, BswMActionListItemIndex=1, BswMActionListItemRef=BswMModeControl/EnaCdnBEnaDem
          EnaCdnBFalse
            EnaCdnBDiDiagcMgr (BswMActionListItem): BswMAbortOnFail=false, BswMActionListItemIndex=0, BswMActionListItemRef=BswMModeControl/EnaCdnBDiDiagcMgr
            EnaCdnBDiDem (BswMActionListItem): BswMAbortOnFail=false, BswMActionListItemIndex=1, BswMActionListItemRef=BswMModeControl/EnaCdnBDiDem
          EnaCdnCTrue
            EnaCdnCEnaDiagcMgr (BswMActionListItem): BswMAbortOnFail=false, BswMActionListItemIndex=0, BswMActionListItemRef=BswMModeControl/EnaCdnCEnaDiagcMgr
            EnaCdnCEnaDem (BswMActionListItem): BswMAbortOnFail=false, BswMActionListItemIndex=1, BswMActionListItemRef=BswMModeControl/EnaCdnCEnaDem
          EnaCdnCFalse
            EnaCdnCDiDiagcMgr (BswMActionListItem): BswMAbortOnFail=false, BswMActionListItemIndex=0, BswMActionListItemRef=BswMModeControl/EnaCdnCDiDiagcMgr
            EnaCdnCDiDem (BswMActionListItem): BswMAbortOnFail=false, BswMActionListItemIndex=1, BswMActionListItemRef=BswMModeControl/EnaCdnCDiDem
          EnaCdnDTrue
            EnaCdnDEnaDiagcMgr (BswMActionListItem): BswMAbortOnFail=false, BswMActionListItemIndex=0, BswMActionListItemRef=BswMModeControl/EnaCdnDEnaDiagcMgr
            EnaCdnDEnaDem (BswMActionListItem): BswMAbortOnFail=false, BswMActionListItemIndex=1, BswMActionListItemRef=BswMModeControl/EnaCdnDEnaDem
          EnaCdnDFalse
            EnaCdnDDiDiagcMgr (BswMActionListItem): BswMAbortOnFail=false, BswMActionListItemIndex=0, BswMActionListItemRef=BswMModeControl/EnaCdnDDiDiagcMgr
            EnaCdnDDiDem (BswMActionListItem): BswMAbortOnFail=false, BswMActionListItemIndex=1, BswMActionListItemRef=BswMModeControl/EnaCdnDDiDem
          EnaCdnETrue
            EnaCdnEEnaDiagcMgr (BswMActionListItem): BswMAbortOnFail=false, BswMActionListItemIndex=0, BswMActionListItemRef=BswMModeControl/EnaCdnEEnaDiagcMgr
            EnaCdnEEnaDem (BswMActionListItem): BswMAbortOnFail=false, BswMActionListItemIndex=1, BswMActionListItemRef=BswMModeControl/EnaCdnEEnaDem
          EnaCdnEFalse
            EnaCdnEDiDiagcMgr (BswMActionListItem): BswMAbortOnFail=false, BswMActionListItemIndex=0, BswMActionListItemRef=BswMModeControl/EnaCdnEDiDiagcMgr
            EnaCdnEDiDem (BswMActionListItem): BswMAbortOnFail=false, BswMActionListItemIndex=1, BswMActionListItemRef=BswMModeControl/EnaCdnEDiDem
          EnaCdnFTrue
            3 x BswMActionListItem, all with BswMAbortOnFail=false:
              EnaCdnFEnaDiagcMgr: BswMActionListItemIndex=1, BswMActionListItemRef=BswMModeControl/EnaCdnFEnaDiagcMgr
              EnaCdnFEnaDem: BswMActionListItemIndex=2, BswMActionListItemRef=BswMModeControl/EnaCdnFEnaDem
              EnaCdnFTmrStop: BswMActionListItemIndex=0, BswMActionListItemRef=BswMModeControl/EnaCdnFTmrStop
          EnaCdnGTrue
            EnaCdnGEnaDiagcMgr (BswMActionListItem): BswMAbortOnFail=false, BswMActionListItemIndex=0, BswMActionListItemRef=BswMModeControl/EnaCdnGEnaDiagcMgr
            EnaCdnGEnaDem (BswMActionListItem): BswMAbortOnFail=false, BswMActionListItemIndex=1, BswMActionListItemRef=BswMModeControl/EnaCdnGEnaDem
          EnaCdnGFalse
            EnaCdnGDiDiagcMgr (BswMActionListItem): BswMAbortOnFail=false, BswMActionListItemIndex=0, BswMActionListItemRef=BswMModeControl/EnaCdnGDiDiagcMgr
            EnaCdnGDiDem (BswMActionListItem): BswMAbortOnFail=false, BswMActionListItemIndex=1, BswMActionListItemRef=BswMModeControl/EnaCdnGDiDem
          EnaCdnHTrue
            EnaCdnHEnaDiagcMgr (BswMActionListItem): BswMAbortOnFail=false, BswMActionListItemIndex=0, BswMActionListItemRef=BswMModeControl/EnaCdnHEnaDiagcMgr
            EnaCdnHEnaDem (BswMActionListItem): BswMAbortOnFail=false, BswMActionListItemIndex=1, BswMActionListItemRef=BswMModeControl/EnaCdnHEnaDem
          EnaCdnHFalse
            EnaCdnHDiDiagcMgr (BswMActionListItem): BswMAbortOnFail=false, BswMActionListItemIndex=0, BswMActionListItemRef=BswMModeControl/EnaCdnHDiDiagcMgr
            EnaCdnHDiDem (BswMActionListItem): BswMAbortOnFail=false, BswMActionListItemIndex=1, BswMActionListItemRef=BswMModeControl/EnaCdnHDiDem
          EnaCdnITrue
            EnaCdnIEnaDiagcMgr (BswMActionListItem): BswMAbortOnFail=false, BswMActionListItemIndex=0, BswMActionListItemRef=BswMModeControl/EnaCdnIEnaDiagcMgr
            EnaCdnIEnaDem (BswMActionListItem): BswMAbortOnFail=false, BswMActionListItemIndex=1, BswMActionListItemRef=BswMModeControl/EnaCdnIEnaDem
          EnaCdnIFalse
            EnaCdnIDiDiagcMgr (BswMActionListItem): BswMAbortOnFail=false, BswMActionListItemIndex=0, BswMActionListItemRef=BswMModeControl/EnaCdnIDiDiagcMgr
            EnaCdnIDiDem (BswMActionListItem): BswMAbortOnFail=false, BswMActionListItemIndex=1, BswMActionListItemRef=BswMModeControl/EnaCdnIDiDem
        EnaCdnFTmrStrt (BswMAction)
          BswMAvailableActions
            BswMTimerControl: BswMTimerAction=BSWM_TIMER_START, BswMTimerValue=5, BswMTimerRef=EnaCdnFTmr
        EnaCdnFTmrStop (BswMAction)
          BswMAvailableActions
            BswMTimerControl: BswMTimerAction=BSWM_TIMER_STOP, BswMTimerValue=0, BswMTimerRef=EnaCdnFTmr
        EnaCdnFStrt (BswMActionList): BswMActionListExecution=BSWM_CONDITION
          3 x BswMActionListItem, all with BswMAbortOnFail=false:
            EnaCdnFTmrStrt: BswMActionListItemIndex=0, BswMActionListItemRef=BswMModeControl/EnaCdnFTmrStrt
            EnaCdnFDiDiagcMgr: BswMActionListItemIndex=1, BswMActionListItemRef=BswMModeControl/EnaCdnFDiDiagcMgr
            EnaCdnFDiDem: BswMActionListItemIndex=2, BswMActionListItemRef=BswMModeControl/EnaCdnFDiDem
        EnaCdnStrtUp (BswMActionList): BswMActionListExecution=BSWM_TRIGGER
          EnaCdnFTmrStrt (BswMActionListItem): BswMAbortOnFail=false, BswMActionListItemIndex=0, BswMActionListItemRef=BswMModeControl/EnaCdnFTmrStrt
        4 x BswMAction:
          EnaCdnJEnaDiagcMgr
            BswMAvailableActions
              BswMUserCallout: BswMUserCalloutFunction=UpdDtcEnaCdn(TRUE, 9), BswMCreateCallout=false, BswMUserIncludeFile=DiagcMgr.h
          EnaCdnJDiDiagcMgr
            BswMAvailableActions
              BswMUserCallout: BswMUserCalloutFunction=UpdDtcEnaCdn(FALSE, 9), BswMCreateCallout=false, BswMUserIncludeFile=DiagcMgr.h
          EnaCdnJEnaDem
            BswMAvailableActions
              BswMUserCallout:
                BswMUserCalloutFunction = Dem_SetEnableCondition(DemConf_DemEnableCondition_DemEnableConditionJ, TRUE)
                BswMCreateCallout = false
                BswMUserIncludeFile = Dem.h
          EnaCdnJDiDem
            BswMAvailableActions
              BswMUserCallout:
                BswMUserCalloutFunction = Dem_SetEnableCondition(DemConf_DemEnableCondition_DemEnableConditionJ, FALSE)
                BswMCreateCallout = false
                BswMUserIncludeFile = Dem.h
        EnaCdnJTrue (BswMActionList): BswMActionListExecution=BSWM_TRIGGER
          EnaCdnJTmrStrt (BswMActionListItem): BswMAbortOnFail=false, BswMActionListItemIndex=0, BswMActionListItemRef=BswMModeControl/EnaCdnJTmrStrt
        EnaCdnJFalse (BswMActionList): BswMActionListExecution=BSWM_TRIGGER
          EnaCdnJDiDiagcMgr (BswMActionListItem): BswMAbortOnFail=false, BswMActionListItemIndex=0, BswMActionListItemRef=BswMModeControl/EnaCdnJDiDiagcMgr
          EnaCdnJDiDem (BswMActionListItem): BswMAbortOnFail=false, BswMActionListItemIndex=1, BswMActionListItemRef=BswMModeControl/EnaCdnJDiDem
        EnaCdnJTmrStrt (BswMAction)
          BswMAvailableActions
            BswMTimerControl: BswMTimerAction=BSWM_TIMER_START, BswMTimerValue=0.5, BswMTimerRef=EnaCdnJTmr
        EnaCdnJTmrStop (BswMAction)
          BswMAvailableActions
            BswMTimerControl: BswMTimerAction=BSWM_TIMER_STOP, BswMTimerValue=0, BswMTimerRef=EnaCdnJTmr
        EnaCdnJDly (BswMActionList): BswMActionListExecution=BSWM_TRIGGER
          3 x BswMActionListItem, all with BswMAbortOnFail=false:
            EnaCdnJEnaDiagcMgr: BswMActionListItemIndex=0, BswMActionListItemRef=BswMModeControl/EnaCdnJEnaDiagcMgr
            EnaCdnJEnaDem: BswMActionListItemIndex=1, BswMActionListItemRef=BswMModeControl/EnaCdnJEnaDem
            EnaCdnJTmrStop: BswMActionListItemIndex=2, BswMActionListItemRef=BswMModeControl/EnaCdnJTmrStop
        4 x BswMAction:
          EnaCdnKEnaDiagcMgr
            BswMAvailableActions
              BswMUserCallout: BswMUserCalloutFunction=UpdDtcEnaCdn(TRUE, 10), BswMCreateCallout=false, BswMUserIncludeFile=DiagcMgr.h
          EnaCdnKDiDiagcMgr
            BswMAvailableActions
              BswMUserCallout: BswMUserCalloutFunction=UpdDtcEnaCdn(FALSE, 10), BswMCreateCallout=false, BswMCalloutParameterList=, BswMUserIncludeFile=DiagcMgr.h
          EnaCdnKEnaDem
            BswMAvailableActions
              BswMUserCallout:
                BswMUserCalloutFunction = Dem_SetEnableCondition(DemConf_DemEnableCondition_DemEnableConditionK, TRUE)
                BswMCreateCallout = false
                BswMUserIncludeFile = Dem.h
          EnaCdnKDiDem
            BswMAvailableActions
              BswMUserCallout:
                BswMUserCalloutFunction = Dem_SetEnableCondition(DemConf_DemEnableCondition_DemEnableConditionK, FALSE)
                BswMCreateCallout = false
                BswMUserIncludeFile = Dem.h
        EnaCdnKTrue (BswMActionList): BswMActionListExecution=BSWM_TRIGGER
          EnaCdnKEnaDiagcMgr (BswMActionListItem): BswMAbortOnFail=false, BswMActionListItemIndex=0, BswMActionListItemRef=BswMModeControl/EnaCdnKEnaDiagcMgr
          EnaCdnKEnaDem (BswMActionListItem): BswMAbortOnFail=false, BswMActionListItemIndex=1, BswMActionListItemRef=BswMModeControl/EnaCdnKEnaDem
        EnaCdnKFalse (BswMActionList): BswMActionListExecution=BSWM_TRIGGER
          EnaCdnKDiDiagcMgr (BswMActionListItem): BswMAbortOnFail=false, BswMActionListItemIndex=0, BswMActionListItemRef=BswMModeControl/EnaCdnKDiDiagcMgr
          EnaCdnKDiDem (BswMActionListItem): BswMAbortOnFail=false, BswMActionListItemIndex=1, BswMActionListItemRef=BswMModeControl/EnaCdnKDiDem
        3 x BswMAction:
          BswMRestart
            BswMAvailableActions
              BswMUserCallout: BswMUserCalloutFunction=BswM_Restart(), BswMCreateCallout=true, BswMCalloutParameterList=
          BswM_FinalizeShtdwn
            BswMAvailableActions
              BswMUserCallout: BswMUserCalloutFunction=BswM_FinalizeShtdwn(), BswMCreateCallout=true
          Action_Dem_Init
            BswMAvailableActions
              BswMUserCallout: BswMUserCalloutFunction=Dem_Init(NULL_PTR), BswMCreateCallout=false, BswMUserIncludeFile=Dem.h
        RESTART (BswMActionList): BswMActionListExecution=BSWM_TRIGGER
          3 x BswMActionListItem, all with BswMAbortOnFail=false:
            ChangeMode_Run: BswMActionListItemIndex=1, BswMActionListItemRef=BswMModeControl/ChangeMode_Run
            Action_Dem_Init: BswMActionListItemIndex=0, BswMActionListItemRef=BswMModeControl/Action_Dem_Init
            BswMRestart: BswMActionListItemIndex=2, BswMActionListItemRef=BswMModeControl/BswMRestart
        3 x BswMAction:
          DiagcMgrPwrDwn
            BswMAvailableActions
              BswMUserCallout: BswMUserCalloutFunction=BswM_DiagcMgrPwrDwn(), BswMCreateCallout=true, BswMCalloutParameterList=, BswMUserIncludeFile=DiagcMgr.h
          GetResource_ShutdownOngoing
            BswMAvailableActions
              BswMUserCallout: BswMUserCalloutFunction=BwmM_GetShutdownOngoing(), BswMCreateCallout=true
          ShtdwnHndlg_PrepShutdown
            BswMAvailableActions
              BswMUserCallout: BswMUserCalloutFunction=BswM_ShtdwnHndlg_PrepShutdown(), BswMCreateCallout=true
      BswMDataTypeMappingSets: BswMDataTypeMappingSetRef=Nexteer
