AUTOSAR XML (schema 4-0-3)
package /ActiveEcuC
  module config Wdg: implementation-config-variant=VARIANT-POST-BUILD-LOADABLE, module-description=Wdg_Impl
    WdgGeneral:
      WdgDevErrorDetect = true
      WdgDisableAllowed = false
      WdgIndex = 0
      WdgInitialTimeout = 10
      WdgMaxTimeout = 10
      WdgRunArea = ROM
      WdgTriggerLocation = NULL
      WdgCriticalSectionProtection = true
      WdgVaryingActivationCodeMode = DISABLE
      WdgVersionCheckExternalModules = false
      WdgDeviceName = R7F701311
      WdgWriteVerify = WV_INIT_RUNTIME
      WdgWriteVerifyErrorInterface = WdgWrVrfyFailr
      WdgInterruptConsistencyCheck = true
      WdgUseWriteVerifyErrorInterface = true
      WdgVersionInfoApi = false
      WdgClockRef = McuWdtacounterClk
    WdgPublishedInformation: WdgTriggerMode=WDG_WINDOW
    WdgSettingsConfig: WdgDefaultMode=WDGIF_SLOW_MODE
      WdgSettingsFast: WdgClkSettingsFast=WDGCLK_DIVBY_2POWOF_15
      WdgSettingsOff
      WdgSettingsSlow: WdgClkSettingsSlow=WDGCLK_DIVBY_2POWOF_16
    WdgDemEventParameterRefs:
      WDG_E_DISABLE_REJECTED = WDG_E_DISABLE_REJECTED
      WDG_E_MODE_FAILED = WDG_E_MODE_FAILED
      WDG_E_INT_INCONSISTENT = WDG_59_DRIVERA_E_INT_INCONSISTENT
      WDG_E_REG_WRITE_VERIFY = Wdg_E_REG_WRITE_VERIFY
