AUTOSAR XML (schema 4-0-3)
package /ActiveEcuC
  module config NvM: implementation-config-variant=VARIANT-PRE-COMPILE, module-description=NvM_Impl
    NvMConfigBlock (NvMBlockDescriptor):
      NvMBlockCrcType = NVM_CRC16
      NvMInitBlockCallback = NULL_PTR
      NvMResistantToChangedSw = true
      NvMSelectBlockForReadAll = true
      NvMSelectBlockForWriteAll = true
      NvMWriteRamBlockToNvCallback = NULL_PTR
      NvMUseInitCallback = false
      NvMUseJobendCallback = false
      NvMSingleBlockCallback = NULL_PTR
      NvMBswMBlockStatusInformation = false
      NvMBlockUseSyncMechanism = false
      NvMCalcRamBlockCrc = false
      NvMUseServicePorts = false
      NvMBlockJobPriority = 127
      NvMBlockWriteProt = false
      NvMRamBlockDataAddress = NULL_PTR
      NvMReadRamBlockFromNvCallback = NULL_PTR
      NvMRomBlockDataAddress = NULL_PTR
      NvMWriteBlockOnce = false
      NvMNvramBlockIdentifier = 1
      NvMBlockManagementType = NVM_BLOCK_REDUNDANT
      NvMNvBlockNum = 2
      NvMBlockUseCrc = true
      NvMNvBlockLength = 2
      NvMAutomaticBlockLength = false
      NvMBlockLengthCheck = false
      NvMBlockLengthCheckType = true
      NvMTargetBlockReference
        NvMFeeRef: NvMNameOfFeeBlock=FeeConfigBlock
    NvMCommon:
      NvMDevErrorDetect = true
      NvMVersionInfoApi = false
      NvMApiConfigClass = NVM_API_CONFIG_CLASS_3
      NvMBswMMultiBlockJobStatusInformation = false
      NvMCompiledConfigId = 1
      NvMCrcNumOfBytes = 64
      NvMDatasetSelectionBits = 1
      NvMDrvModeSwitch = true
      NvMDynamicConfiguration = true
      NvMJobPrioritization = false
      NvMMultiBlockCallback = 
      NvMPollingMode = true
      NvMSetRamBlockStatusApi = true
      NvMSizeStandardJobQueue = 8
      NvMMaxNoOfWriteRetries = 3
      NvMMainFunctionPeriod = 0.01
      NvMUseBlockIdCheck = false
      NvMRepairRedundantBlocksApi = false
    NvMCommonVendorParams:
      NvMMultiblockId = MultiBlockRequest
      NvMCrcIntBuffer = true
      NvMKillWriteAllApi = true
      NvMCfgCbkIncludeList = CDD_CurrMeas.h
      NvMCfgCbkIncludeList = CDD_NvMProxy_Cbk.h
      NvMCfgCbkIncludeList = CDD_NvMProxyDftDataGroup.h
      NvMCfgCbkIncludeList = Dem_Cbk.h
      NvMCfgCbkIncludeList = DiagcMgr.h
    NvmDemEventParameterRefs:
      NVM_E_INTEGRITY_FAILED = NVM_E_INTEGRITY_FAILED
      NVM_E_LOSS_OF_REDUNDANCY = NVM_E_LOSS_OF_REDUNDANCY
      NVM_E_QUEUE_OVERFLOW = NVM_E_QUEUE_OVERFLOW
      NVM_E_REQ_FAILED = NVM_E_REQ_FAILED
      NVM_E_WRITE_PROTECTED = NVM_E_WRITE_PROTECTED
    116 x NvMBlockDescriptor, all with NvMBlockCrcType=NVM_CRC16, NvMBlockManagementType=NVM_BLOCK_NATIVE, NvMResistantToChangedSw=true, NvMUseJobendCallback=false, NvMBswMBlockStatusInformation=false, NvMCalcRamBlockCrc=false, NvMBlockJobPriority=127, NvMBlockWriteProt=false, NvMNvBlockNum=1, NvMWriteBlockOnce=false:
      CurrMeasMotEol_Deprecated: NvMInitBlockCallback=NULL_PTR, NvMSelectBlockForReadAll=false, NvMSelectBlockForWriteAll=false, NvMWriteRamBlockToNvCallback=NULL_PTR, NvMUseInitCallback=false, NvMSingleBlockCallback=NULL_PTR, NvMBlockUseCrc=false, NvMBlockUseSyncMechanism=false, NvMNvBlockLength=76, NvMNvramBlockIdentifier=2, NvMRamBlockDataAddress=NULL_PTR, NvMReadRamBlockFromNvCallback=NULL_PTR, NvMRomBlockDataAddress=NULL_PTR, NvMUseServicePorts=true, NvMAutomaticBlockLength=false, NvMBlockLengthCheck=false, NvMBlockLengthCheckType=true
        NvMTargetBlockReference
          NvMFeeRef: NvMNameOfFeeBlock=FeeCurrMeasMotEol_Deprecated
      PolarityCfgSaved: NvMInitBlockCallback=NULL_PTR, NvMSelectBlockForReadAll=true, NvMSelectBlockForWriteAll=true, NvMWriteRamBlockToNvCallback=NULL_PTR, NvMUseInitCallback=false, NvMSingleBlockCallback=NULL_PTR, NvMBlockUseCrc=true, NvMBlockUseSyncMechanism=false, NvMNvBlockLength=4, NvMNvramBlockIdentifier=117, NvMRamBlockDataAddress=Rte_PolarityCfg_PolarityCfgSaved, NvMReadRamBlockFromNvCallback=NULL_PTR, NvMRomBlockDataAddress=NULL_PTR, NvMUseServicePorts=false, NvMAutomaticBlockLength=false, NvMBlockLengthCheck=true, NvMBlockLengthCheckType=true
        NvMTargetBlockReference
          NvMFeeRef: NvMNameOfFeeBlock=FeePolarityCfgSaved
      Rte_NvmBlock_CDD_MotAg0Meas_MotAg0CoeffTbl: NvMInitBlockCallback=NULL_PTR, NvMSelectBlockForReadAll=true, NvMSelectBlockForWriteAll=true, NvMWriteRamBlockToNvCallback=NULL_PTR, NvMUseInitCallback=false, NvMSingleBlockCallback=NULL_PTR, NvMBlockUseCrc=true, NvMBlockUseSyncMechanism=false, NvMNvBlockLength=104, NvMNvramBlockIdentifier=116, NvMRamBlockDataAddress=Rte_CDD_MotAg0Meas_MotAg0CoeffTbl, NvMReadRamBlockFromNvCallback=NULL_PTR, NvMRomBlockDataAddress=Rte_CalprmRom_CDD_MotAg0Meas_DEFAULT_RTE_CDATA_GROUP.MotAg0CoeffTblDft, NvMUseServicePorts=false, NvMAutomaticBlockLength=false, NvMBlockLengthCheck=true, NvMBlockLengthCheckType=true
        NvMTargetBlockReference
          NvMFeeRef: NvMNameOfFeeBlock=FeeRte_NvmBlock_CDD_MotAg0Meas_MotAg0CoeffTbl
      Rte_NvmBlock_CDD_MotAgCmp_MotAgCmpMotAgBackEmf: NvMInitBlockCallback=NULL_PTR, NvMSelectBlockForReadAll=true, NvMSelectBlockForWriteAll=true, NvMWriteRamBlockToNvCallback=NULL_PTR, NvMUseInitCallback=false, NvMSingleBlockCallback=NULL_PTR, NvMBlockUseCrc=true, NvMBlockUseSyncMechanism=false, NvMNvBlockLength=2, NvMNvramBlockIdentifier=115, NvMRamBlockDataAddress=Rte_CDD_MotAgCmp_MotAgCmpMotAgBackEmf, NvMReadRamBlockFromNvCallback=NULL_PTR, NvMRomBlockDataAddress=Rte_CalprmRom_CDD_MotAgCmp_DEFAULT_RTE_CDATA_GROUP.MotAgCmpMotAgBackEmfDft, NvMUseServicePorts=true, NvMAutomaticBlockLength=false, NvMBlockLengthCheck=true, NvMBlockLengthCheckType=true
        NvMTargetBlockReference
          NvMFeeRef: NvMNameOfFeeBlock=FeeRte_NvmBlock_CDD_MotAgCmp_MotAgCmpMotAgBackEmf
      MotPrmNom: NvMInitBlockCallback=NULL_PTR, NvMSelectBlockForReadAll=true, NvMSelectBlockForWriteAll=true, NvMWriteRamBlockToNvCallback=NULL_PTR, NvMUseInitCallback=false, NvMSingleBlockCallback=NULL_PTR, NvMBlockUseCrc=true, NvMBlockUseSyncMechanism=false, NvMNvBlockLength=8, NvMNvramBlockIdentifier=114, NvMRamBlockDataAddress=Rte_MotCtrlPrmEstimn_MotPrmNom, NvMReadRamBlockFromNvCallback=NULL_PTR, NvMRomBlockDataAddress=NULL_PTR, NvMUseServicePorts=false, NvMAutomaticBlockLength=false, NvMBlockLengthCheck=true, NvMBlockLengthCheckType=true
        NvMTargetBlockReference
          NvMFeeRef: NvMNameOfFeeBlock=FeeMotPrmNom
      Rte_NvmBlock_CmnMfgSrv_NxtrMfgEnaCntr: NvMInitBlockCallback=NULL_PTR, NvMSelectBlockForReadAll=true, NvMSelectBlockForWriteAll=true, NvMWriteRamBlockToNvCallback=NULL_PTR, NvMUseInitCallback=false, NvMSingleBlockCallback=NULL_PTR, NvMBlockUseCrc=false, NvMBlockUseSyncMechanism=false, NvMNvBlockLength=1, NvMNvramBlockIdentifier=112, NvMRamBlockDataAddress=Rte_CmnMfgSrv_NxtrMfgEnaCntr, NvMReadRamBlockFromNvCallback=NULL_PTR, NvMRomBlockDataAddress=Rte_CalprmRom_CmnMfgSrv_DEFAULT_RTE_CDATA_GROUP.NvmMfgEnaCntr_DefaultValue, NvMUseServicePorts=true, NvMAutomaticBlockLength=false, NvMBlockLengthCheck=true, NvMBlockLengthCheckType=true
        NvMTargetBlockReference
          NvMFeeRef: NvMNameOfFeeBlock=FeeRte_NvmBlock_CmnMfgSrv_NxtrMfgEnaCntr
      Rte_NvmBlock_CmnMfgSrv_IgnCntr: NvMInitBlockCallback=NULL_PTR, NvMSelectBlockForReadAll=true, NvMSelectBlockForWriteAll=true, NvMWriteRamBlockToNvCallback=NULL_PTR, NvMUseInitCallback=false, NvMSingleBlockCallback=NULL_PTR, NvMBlockUseCrc=false, NvMBlockUseSyncMechanism=false, NvMNvBlockLength=4, NvMNvramBlockIdentifier=113, NvMRamBlockDataAddress=Rte_CmnMfgSrv_IgnCntr, NvMReadRamBlockFromNvCallback=NULL_PTR, NvMRomBlockDataAddress=Rte_CalprmRom_CmnMfgSrv_DEFAULT_RTE_CDATA_GROUP.NvmIgnCntr_DefaultValue, NvMUseServicePorts=true, NvMAutomaticBlockLength=false, NvMBlockLengthCheck=true, NvMBlockLengthCheckType=true
        NvMTargetBlockReference
          NvMFeeRef: NvMNameOfFeeBlock=FeeRte_NvmBlock_CmnMfgSrv_IgnCntr
      Rte_NvmBlock_CDD_MotAg1Meas_MotAg1CoeffTbl: NvMInitBlockCallback=NULL_PTR, NvMSelectBlockForReadAll=true, NvMSelectBlockForWriteAll=true, NvMWriteRamBlockToNvCallback=NULL_PTR, NvMUseInitCallback=false, NvMSingleBlockCallback=NULL_PTR, NvMBlockUseCrc=true, NvMBlockUseSyncMechanism=false, NvMNvBlockLength=104, NvMNvramBlockIdentifier=111, NvMRamBlockDataAddress=Rte_CDD_MotAg1Meas_MotAg1CoeffTbl, NvMReadRamBlockFromNvCallback=NULL_PTR, NvMRomBlockDataAddress=Rte_CalprmRom_CDD_MotAg1Meas_DEFAULT_RTE_CDATA_GROUP.MotAg1CoeffTblDft, NvMUseServicePorts=false, NvMAutomaticBlockLength=false, NvMBlockLengthCheck=true, NvMBlockLengthCheckType=true
        NvMTargetBlockReference
          NvMFeeRef: NvMNameOfFeeBlock=FeeRte_NvmBlock_CDD_MotAg1Meas_MotAg1CoeffTbl
      Rte_NvmBlock_HwAg0Meas_HwAg0Offs: NvMInitBlockCallback=NULL_PTR, NvMSelectBlockForReadAll=true, NvMSelectBlockForWriteAll=true, NvMWriteRamBlockToNvCallback=NULL_PTR, NvMUseInitCallback=false, NvMSingleBlockCallback=NULL_PTR, NvMBlockUseCrc=true, NvMBlockUseSyncMechanism=false, NvMNvBlockLength=8, NvMNvramBlockIdentifier=110, NvMRamBlockDataAddress=Rte_HwAg0Meas_HwAg0Offs, NvMReadRamBlockFromNvCallback=NULL_PTR, NvMRomBlockDataAddress=Rte_CalprmRom_HwAg0Meas_DEFAULT_RTE_CDATA_GROUP.HwAg0OffsDft, NvMUseServicePorts=true, NvMAutomaticBlockLength=false, NvMBlockLengthCheck=true, NvMBlockLengthCheckType=true
        NvMTargetBlockReference
          NvMFeeRef: NvMNameOfFeeBlock=FeeRte_NvmBlock_HwAg0Meas_HwAg0Offs
      Rte_NvmBlock_NvMProxy_ShtdwnClsChk: NvMInitBlockCallback=NULL_PTR, NvMSelectBlockForReadAll=true, NvMSelectBlockForWriteAll=false, NvMWriteRamBlockToNvCallback=CDD_NvMProxy_ClsChkWrCallBack, NvMUseInitCallback=false, NvMSingleBlockCallback=NULL_PTR, NvMBlockUseCrc=true, NvMBlockUseSyncMechanism=true, NvMNvBlockLength=4, NvMNvramBlockIdentifier=109, NvMRamBlockDataAddress=Rte_CDD_NvMProxy_ShtdwnClsChk, NvMReadRamBlockFromNvCallback=CDD_NvMProxy_ClsChkReadCallBack, NvMRomBlockDataAddress=NULL_PTR, NvMUseServicePorts=true, NvMAutomaticBlockLength=false, NvMBlockLengthCheck=true, NvMBlockLengthCheckType=true
        NvMTargetBlockReference
          NvMFeeRef: NvMNameOfFeeBlock=FeeRte_NvmBlock_NvMProxy_ShtdwnClsChk
      Rte_NvmBlock_HwAg1Meas_HwAg1Offs: NvMInitBlockCallback=NULL_PTR, NvMSelectBlockForReadAll=true, NvMSelectBlockForWriteAll=true, NvMWriteRamBlockToNvCallback=NULL_PTR, NvMUseInitCallback=false, NvMSingleBlockCallback=NULL_PTR, NvMBlockUseCrc=true, NvMBlockUseSyncMechanism=false, NvMNvBlockLength=8, NvMNvramBlockIdentifier=108, NvMRamBlockDataAddress=Rte_HwAg1Meas_HwAg1Offs, NvMReadRamBlockFromNvCallback=NULL_PTR, NvMRomBlockDataAddress=Rte_CalprmRom_HwAg1Meas_DEFAULT_RTE_CDATA_GROUP.HwAg1OffsDft, NvMUseServicePorts=true, NvMAutomaticBlockLength=false, NvMBlockLengthCheck=true, NvMBlockLengthCheckType=true
        NvMTargetBlockReference
          NvMFeeRef: NvMNameOfFeeBlock=FeeRte_NvmBlock_HwAg1Meas_HwAg1Offs
      Rte_NvmBlock_HwTqCorrln_HwTqChACmnModCmpLpFilSt: NvMInitBlockCallback=NULL_PTR, NvMSelectBlockForReadAll=true, NvMSelectBlockForWriteAll=true, NvMWriteRamBlockToNvCallback=NULL_PTR, NvMUseInitCallback=false, NvMSingleBlockCallback=NULL_PTR, NvMBlockUseCrc=true, NvMBlockUseSyncMechanism=false, NvMNvBlockLength=4, NvMNvramBlockIdentifier=106, NvMRamBlockDataAddress=Rte_HwTqCorrln_HwTqChACmnModCmpLpFilSt, NvMReadRamBlockFromNvCallback=NULL_PTR, NvMRomBlockDataAddress=Rte_CalprmRom_HwTqCorrln_DEFAULT_RTE_CDATA_GROUP.HwTqChACmnModCmpLpFilStDft, NvMUseServicePorts=true, NvMAutomaticBlockLength=false, NvMBlockLengthCheck=true, NvMBlockLengthCheckType=true
        NvMTargetBlockReference
          NvMFeeRef: NvMNameOfFeeBlock=FeeRte_NvmBlock_HwTqCorrln_HwTqChACmnModCmpLpFilSt
      Rte_NvmBlock_HwTqCorrln_HwTqChBCmnModCmpLpFilSt: NvMInitBlockCallback=NULL_PTR, NvMSelectBlockForReadAll=true, NvMSelectBlockForWriteAll=true, NvMWriteRamBlockToNvCallback=NULL_PTR, NvMUseInitCallback=false, NvMSingleBlockCallback=NULL_PTR, NvMBlockUseCrc=true, NvMBlockUseSyncMechanism=false, NvMNvBlockLength=4, NvMNvramBlockIdentifier=107, NvMRamBlockDataAddress=Rte_HwTqCorrln_HwTqChBCmnModCmpLpFilSt, NvMReadRamBlockFromNvCallback=NULL_PTR, NvMRomBlockDataAddress=Rte_CalprmRom_HwTqCorrln_DEFAULT_RTE_CDATA_GROUP.HwTqChBCmnModCmpLpFilStDft, NvMUseServicePorts=true, NvMAutomaticBlockLength=false, NvMBlockLengthCheck=true, NvMBlockLengthCheckType=true
        NvMTargetBlockReference
          NvMFeeRef: NvMNameOfFeeBlock=FeeRte_NvmBlock_HwTqCorrln_HwTqChBCmnModCmpLpFilSt
      Rte_NvmBlock_CDD_HwTq1Meas_HwTq1Offs: NvMInitBlockCallback=NULL_PTR, NvMSelectBlockForReadAll=true, NvMSelectBlockForWriteAll=true, NvMWriteRamBlockToNvCallback=NULL_PTR, NvMUseInitCallback=false, NvMSingleBlockCallback=NULL_PTR, NvMBlockUseCrc=true, NvMBlockUseSyncMechanism=false, NvMNvBlockLength=8, NvMNvramBlockIdentifier=103, NvMRamBlockDataAddress=Rte_CDD_HwTq1Meas_HwTq1Offs, NvMReadRamBlockFromNvCallback=NULL_PTR, NvMRomBlockDataAddress=Rte_CalprmRom_CDD_HwTq1Meas_DEFAULT_RTE_CDATA_GROUP.HwTq1OffsDft, NvMUseServicePorts=true, NvMAutomaticBlockLength=false, NvMBlockLengthCheck=true, NvMBlockLengthCheckType=true
        NvMTargetBlockReference
          NvMFeeRef: NvMNameOfFeeBlock=FeeRte_NvmBlock_CDD_HwTq1Meas_HwTq1Offs
      Rte_NvmBlock_CDD_HwTq3Meas_HwTq3Offs: NvMInitBlockCallback=NULL_PTR, NvMSelectBlockForReadAll=true, NvMSelectBlockForWriteAll=true, NvMWriteRamBlockToNvCallback=NULL_PTR, NvMUseInitCallback=false, NvMSingleBlockCallback=NULL_PTR, NvMBlockUseCrc=true, NvMBlockUseSyncMechanism=false, NvMNvBlockLength=8, NvMNvramBlockIdentifier=104, NvMRamBlockDataAddress=Rte_CDD_HwTq3Meas_HwTq3Offs, NvMReadRamBlockFromNvCallback=NULL_PTR, NvMRomBlockDataAddress=Rte_CalprmRom_CDD_HwTq3Meas_DEFAULT_RTE_CDATA_GROUP.HwTq3OffsDft, NvMUseServicePorts=true, NvMAutomaticBlockLength=false, NvMBlockLengthCheck=true, NvMBlockLengthCheckType=true
        NvMTargetBlockReference
          NvMFeeRef: NvMNameOfFeeBlock=FeeRte_NvmBlock_CDD_HwTq3Meas_HwTq3Offs
      Rte_NvmBlock_CDD_HwTq2Meas_HwTq2Offs: NvMInitBlockCallback=NULL_PTR, NvMSelectBlockForReadAll=true, NvMSelectBlockForWriteAll=true, NvMWriteRamBlockToNvCallback=NULL_PTR, NvMUseInitCallback=false, NvMSingleBlockCallback=NULL_PTR, NvMBlockUseCrc=true, NvMBlockUseSyncMechanism=false, NvMNvBlockLength=8, NvMNvramBlockIdentifier=105, NvMRamBlockDataAddress=Rte_CDD_HwTq2Meas_HwTq2Offs, NvMReadRamBlockFromNvCallback=NULL_PTR, NvMRomBlockDataAddress=Rte_CalprmRom_CDD_HwTq2Meas_DEFAULT_RTE_CDATA_GROUP.HwTq2OffsDft, NvMUseServicePorts=true, NvMAutomaticBlockLength=false, NvMBlockLengthCheck=true, NvMBlockLengthCheckType=true
        NvMTargetBlockReference
          NvMFeeRef: NvMNameOfFeeBlock=FeeRte_NvmBlock_CDD_HwTq2Meas_HwTq2Offs
      Rte_NvmBlock_CDD_HwTq0Meas_HwTq0Offs: NvMInitBlockCallback=NULL_PTR, NvMSelectBlockForReadAll=true, NvMSelectBlockForWriteAll=true, NvMWriteRamBlockToNvCallback=NULL_PTR, NvMUseInitCallback=false, NvMSingleBlockCallback=NULL_PTR, NvMBlockUseCrc=true, NvMBlockUseSyncMechanism=false, NvMNvBlockLength=8, NvMNvramBlockIdentifier=102, NvMRamBlockDataAddress=Rte_CDD_HwTq0Meas_HwTq0Offs, NvMReadRamBlockFromNvCallback=NULL_PTR, NvMRomBlockDataAddress=Rte_CalprmRom_CDD_HwTq0Meas_DEFAULT_RTE_CDATA_GROUP.HwTq0OffsDft, NvMUseServicePorts=true, NvMAutomaticBlockLength=false, NvMBlockLengthCheck=true, NvMBlockLengthCheckType=true
        NvMTargetBlockReference
          NvMFeeRef: NvMNameOfFeeBlock=FeeRte_NvmBlock_CDD_HwTq0Meas_HwTq0Offs
      Rte_NvmBlock_MotAg2Meas_MotAg2EolPrm: NvMInitBlockCallback=NULL_PTR, NvMSelectBlockForReadAll=true, NvMSelectBlockForWriteAll=true, NvMWriteRamBlockToNvCallback=NULL_PTR, NvMUseInitCallback=false, NvMSingleBlockCallback=NULL_PTR, NvMBlockUseCrc=true, NvMBlockUseSyncMechanism=false, NvMNvBlockLength=20, NvMNvramBlockIdentifier=101, NvMRamBlockDataAddress=Rte_MotAg2Meas_MotAg2EolPrm, NvMReadRamBlockFromNvCallback=NULL_PTR, NvMRomBlockDataAddress=Rte_CalprmRom_MotAg2Meas_DEFAULT_RTE_CDATA_GROUP.MotAg2EolPrmDft, NvMUseServicePorts=true, NvMAutomaticBlockLength=false, NvMBlockLengthCheck=true, NvMBlockLengthCheckType=true
        NvMTargetBlockReference
          NvMFeeRef: NvMNameOfFeeBlock=FeeRte_NvmBlock_MotAg2Meas_MotAg2EolPrm
      Rte_NvmBlock_DiagcMgr_DiagcMgrNtcFltAry: NvMInitBlockCallback=NULL_PTR, NvMSelectBlockForReadAll=true, NvMSelectBlockForWriteAll=true, NvMWriteRamBlockToNvCallback=NULL_PTR, NvMUseInitCallback=false, NvMSingleBlockCallback=NULL_PTR, NvMBlockUseCrc=true, NvMBlockUseSyncMechanism=false, NvMNvBlockLength=80, NvMNvramBlockIdentifier=100, NvMRamBlockDataAddress=Rte_DiagcMgr_DiagcMgrNtcFltAry, NvMReadRamBlockFromNvCallback=NULL_PTR, NvMRomBlockDataAddress=NULL_PTR, NvMUseServicePorts=true, NvMAutomaticBlockLength=false, NvMBlockLengthCheck=true, NvMBlockLengthCheckType=true
        NvMTargetBlockReference
          NvMFeeRef: NvMNameOfFeeBlock=FeeRte_NvmBlock_DiagcMgr_DiagcMgrNtcFltAry
      Rte_NvmBlock_EotLrng_EotNvmData: NvMInitBlockCallback=NULL_PTR, NvMSelectBlockForReadAll=true, NvMSelectBlockForWriteAll=true, NvMWriteRamBlockToNvCallback=NULL_PTR, NvMUseInitCallback=false, NvMSingleBlockCallback=NULL_PTR, NvMBlockUseCrc=true, NvMBlockUseSyncMechanism=false, NvMNvBlockLength=12, NvMNvramBlockIdentifier=99, NvMRamBlockDataAddress=Rte_EotLrng_EotNvmData, NvMReadRamBlockFromNvCallback=NULL_PTR, NvMRomBlockDataAddress=Rte_CalprmRom_EotLrng_DEFAULT_RTE_CDATA_GROUP.EotNvmDataDft, NvMUseServicePorts=true, NvMAutomaticBlockLength=false, NvMBlockLengthCheck=true, NvMBlockLengthCheckType=true
        NvMTargetBlockReference
          NvMFeeRef: NvMNameOfFeeBlock=FeeRte_NvmBlock_EotLrng_EotNvmData
      Rte_NvmBlock_CDD_CurrMeas_CurrMeasEolOffsCalSet: NvMInitBlockCallback=NULL_PTR, NvMSelectBlockForReadAll=true, NvMSelectBlockForWriteAll=true, NvMWriteRamBlockToNvCallback=NULL_PTR, NvMUseInitCallback=false, NvMSingleBlockCallback=NULL_PTR, NvMBlockUseCrc=true, NvMBlockUseSyncMechanism=false, NvMNvBlockLength=52, NvMNvramBlockIdentifier=98, NvMRamBlockDataAddress=Rte_CDD_CurrMeas_CurrMeasEolOffsCalSet, NvMReadRamBlockFromNvCallback=NULL_PTR, NvMRomBlockDataAddress=Rte_CalprmRom_CDD_CurrMeas_DEFAULT_RTE_CDATA_GROUP.CurrMeasEolOffsCalSetDft, NvMUseServicePorts=true, NvMAutomaticBlockLength=false, NvMBlockLengthCheck=true, NvMBlockLengthCheckType=true
        NvMTargetBlockReference
          NvMFeeRef: NvMNameOfFeeBlock=FeeRte_NvmBlock_CDD_CurrMeas_CurrMeasEolOffsCalSet
      Rte_NvmBlock_CDD_CurrMeas_CurrMeasEolGainCalSet: NvMInitBlockCallback=NULL_PTR, NvMSelectBlockForReadAll=true, NvMSelectBlockForWriteAll=true, NvMWriteRamBlockToNvCallback=NULL_PTR, NvMUseInitCallback=false, NvMSingleBlockCallback=NULL_PTR, NvMBlockUseCrc=true, NvMBlockUseSyncMechanism=false, NvMNvBlockLength=24, NvMNvramBlockIdentifier=97, NvMRamBlockDataAddress=Rte_CDD_CurrMeas_CurrMeasEolGainCalSet, NvMReadRamBlockFromNvCallback=NULL_PTR, NvMRomBlockDataAddress=Rte_CalprmRom_CDD_CurrMeas_DEFAULT_RTE_CDATA_GROUP.CurrMeasEolGainCalSetDft, NvMUseServicePorts=true, NvMAutomaticBlockLength=false, NvMBlockLengthCheck=true, NvMBlockLengthCheckType=true
        NvMTargetBlockReference
          NvMFeeRef: NvMNameOfFeeBlock=FeeRte_NvmBlock_CDD_CurrMeas_CurrMeasEolGainCalSet
      Rte_NvmBlock_PartNr_PartNrRepairShopCod: NvMInitBlockCallback=NULL_PTR, NvMSelectBlockForReadAll=true, NvMSelectBlockForWriteAll=true, NvMWriteRamBlockToNvCallback=NULL_PTR, NvMUseInitCallback=false, NvMSingleBlockCallback=NULL_PTR, NvMBlockUseCrc=true, NvMBlockUseSyncMechanism=false, NvMNvBlockLength=20, NvMNvramBlockIdentifier=83, NvMRamBlockDataAddress=Rte_PartNr_PartNrRepairShopCod, NvMReadRamBlockFromNvCallback=NULL_PTR, NvMRomBlockDataAddress=Rte_CalprmRom_PartNr_DEFAULT_RTE_CDATA_GROUP.PartNrRepairShopCodDft, NvMUseServicePorts=true, NvMAutomaticBlockLength=false, NvMBlockLengthCheck=true, NvMBlockLengthCheckType=true
        NvMTargetBlockReference
          NvMFeeRef: NvMNameOfFeeBlock=FeeRte_NvmBlock_PartNr_PartNrRepairShopCod
      Rte_NvmBlock_PartNr_PartNrSysName: NvMInitBlockCallback=NULL_PTR, NvMSelectBlockForReadAll=true, NvMSelectBlockForWriteAll=true, NvMWriteRamBlockToNvCallback=NULL_PTR, NvMUseInitCallback=false, NvMSingleBlockCallback=NULL_PTR, NvMBlockUseCrc=true, NvMBlockUseSyncMechanism=false, NvMNvBlockLength=20, NvMNvramBlockIdentifier=84, NvMRamBlockDataAddress=Rte_PartNr_PartNrSysName, NvMReadRamBlockFromNvCallback=NULL_PTR, NvMRomBlockDataAddress=Rte_CalprmRom_PartNr_DEFAULT_RTE_CDATA_GROUP.PartNrSysNameDft, NvMUseServicePorts=true, NvMAutomaticBlockLength=false, NvMBlockLengthCheck=true, NvMBlockLengthCheckType=true
        NvMTargetBlockReference
          NvMFeeRef: NvMNameOfFeeBlock=FeeRte_NvmBlock_PartNr_PartNrSysName
      Rte_NvmBlock_PartNr_PartNrCcaMfgTrakg: NvMInitBlockCallback=NULL_PTR, NvMSelectBlockForReadAll=true, NvMSelectBlockForWriteAll=true, NvMWriteRamBlockToNvCallback=NULL_PTR, NvMUseInitCallback=false, NvMSingleBlockCallback=NULL_PTR, NvMBlockUseCrc=true, NvMBlockUseSyncMechanism=false, NvMNvBlockLength=9, NvMNvramBlockIdentifier=85, NvMRamBlockDataAddress=Rte_PartNr_PartNrCcaMfgTrakg, NvMReadRamBlockFromNvCallback=NULL_PTR, NvMRomBlockDataAddress=Rte_CalprmRom_PartNr_DEFAULT_RTE_CDATA_GROUP.PartNrCcaMfgTrakgDft, NvMUseServicePorts=true, NvMAutomaticBlockLength=false, NvMBlockLengthCheck=true, NvMBlockLengthCheckType=true
        NvMTargetBlockReference
          NvMFeeRef: NvMNameOfFeeBlock=FeeRte_NvmBlock_PartNr_PartNrCcaMfgTrakg
      Rte_NvmBlock_PartNr_PartNrSysCodVersNr: NvMInitBlockCallback=NULL_PTR, NvMSelectBlockForReadAll=true, NvMSelectBlockForWriteAll=true, NvMWriteRamBlockToNvCallback=NULL_PTR, NvMUseInitCallback=false, NvMSingleBlockCallback=NULL_PTR, NvMBlockUseCrc=true, NvMBlockUseSyncMechanism=false, NvMNvBlockLength=2, NvMNvramBlockIdentifier=86, NvMRamBlockDataAddress=Rte_PartNr_PartNrSysCodVersNr, NvMReadRamBlockFromNvCallback=NULL_PTR, NvMRomBlockDataAddress=Rte_CalprmRom_PartNr_DEFAULT_RTE_CDATA_GROUP.PartNrSysCodVersNrDft, NvMUseServicePorts=true, NvMAutomaticBlockLength=false, NvMBlockLengthCheck=true, NvMBlockLengthCheckType=true
        NvMTargetBlockReference
          NvMFeeRef: NvMNameOfFeeBlock=FeeRte_NvmBlock_PartNr_PartNrSysCodVersNr
      Rte_NvmBlock_PartNr_PartNrNxtrMfgTrakg: NvMInitBlockCallback=NULL_PTR, NvMSelectBlockForReadAll=true, NvMSelectBlockForWriteAll=true, NvMWriteRamBlockToNvCallback=NULL_PTR, NvMUseInitCallback=false, NvMSingleBlockCallback=NULL_PTR, NvMBlockUseCrc=true, NvMBlockUseSyncMechanism=false, NvMNvBlockLength=7, NvMNvramBlockIdentifier=87, NvMRamBlockDataAddress=Rte_PartNr_PartNrNxtrMfgTrakg, NvMReadRamBlockFromNvCallback=NULL_PTR, NvMRomBlockDataAddress=Rte_CalprmRom_PartNr_DEFAULT_RTE_CDATA_GROUP.PartNrNxtrMfgTrakgDft, NvMUseServicePorts=true, NvMAutomaticBlockLength=false, NvMBlockLengthCheck=true, NvMBlockLengthCheckType=true
        NvMTargetBlockReference
          NvMFeeRef: NvMNameOfFeeBlock=FeeRte_NvmBlock_PartNr_PartNrNxtrMfgTrakg
      Rte_NvmBlock_PartNr_PartNrEndMdlPartNr: NvMInitBlockCallback=NULL_PTR, NvMSelectBlockForReadAll=true, NvMSelectBlockForWriteAll=true, NvMWriteRamBlockToNvCallback=NULL_PTR, NvMUseInitCallback=false, NvMSingleBlockCallback=NULL_PTR, NvMBlockUseCrc=true, NvMBlockUseSyncMechanism=false, NvMNvBlockLength=6, NvMNvramBlockIdentifier=88, NvMRamBlockDataAddress=Rte_PartNr_PartNrEndMdlPartNr, NvMReadRamBlockFromNvCallback=NULL_PTR, NvMRomBlockDataAddress=Rte_CalprmRom_PartNr_DEFAULT_RTE_CDATA_GROUP.PartNrEndMdlPartNrDft, NvMUseServicePorts=true, NvMAutomaticBlockLength=false, NvMBlockLengthCheck=true, NvMBlockLengthCheckType=true
        NvMTargetBlockReference
          NvMFeeRef: NvMNameOfFeeBlock=FeeRte_NvmBlock_PartNr_PartNrEndMdlPartNr
      Rte_NvmBlock_PartNr_PartNrBasMdlPartNr: NvMInitBlockCallback=NULL_PTR, NvMSelectBlockForReadAll=true, NvMSelectBlockForWriteAll=true, NvMWriteRamBlockToNvCallback=NULL_PTR, NvMUseInitCallback=false, NvMSingleBlockCallback=NULL_PTR, NvMBlockUseCrc=true, NvMBlockUseSyncMechanism=false, NvMNvBlockLength=6, NvMNvramBlockIdentifier=89, NvMRamBlockDataAddress=Rte_PartNr_PartNrBasMdlPartNr, NvMReadRamBlockFromNvCallback=NULL_PTR, NvMRomBlockDataAddress=Rte_CalprmRom_PartNr_DEFAULT_RTE_CDATA_GROUP.PartNrBasMdlPartNrDft, NvMUseServicePorts=true, NvMAutomaticBlockLength=false, NvMBlockLengthCheck=true, NvMBlockLengthCheckType=true
        NvMTargetBlockReference
          NvMFeeRef: NvMNameOfFeeBlock=FeeRte_NvmBlock_PartNr_PartNrBasMdlPartNr
      Rte_NvmBlock_PartNr_PartNrCtrlPidSeedKey: NvMInitBlockCallback=NULL_PTR, NvMSelectBlockForReadAll=true, NvMSelectBlockForWriteAll=true, NvMWriteRamBlockToNvCallback=NULL_PTR, NvMUseInitCallback=false, NvMSingleBlockCallback=NULL_PTR, NvMBlockUseCrc=true, NvMBlockUseSyncMechanism=false, NvMNvBlockLength=10, NvMNvramBlockIdentifier=90, NvMRamBlockDataAddress=Rte_PartNr_PartNrCtrlPidSeedKey, NvMReadRamBlockFromNvCallback=NULL_PTR, NvMRomBlockDataAddress=Rte_CalprmRom_PartNr_DEFAULT_RTE_CDATA_GROUP.PartNrCtrlPidSeedKeyDft, NvMUseServicePorts=true, NvMAutomaticBlockLength=false, NvMBlockLengthCheck=true, NvMBlockLengthCheckType=true
        NvMTargetBlockReference
          NvMFeeRef: NvMNameOfFeeBlock=FeeRte_NvmBlock_PartNr_PartNrCtrlPidSeedKey
      Rte_NvmBlock_PartNr_PartNrVinData: NvMInitBlockCallback=NULL_PTR, NvMSelectBlockForReadAll=true, NvMSelectBlockForWriteAll=true, NvMWriteRamBlockToNvCallback=NULL_PTR, NvMUseInitCallback=false, NvMSingleBlockCallback=NULL_PTR, NvMBlockUseCrc=true, NvMBlockUseSyncMechanism=false, NvMNvBlockLength=17, NvMNvramBlockIdentifier=91, NvMRamBlockDataAddress=Rte_PartNr_PartNrVinData, NvMReadRamBlockFromNvCallback=NULL_PTR, NvMRomBlockDataAddress=Rte_CalprmRom_PartNr_DEFAULT_RTE_CDATA_GROUP.PartNrVinDataDft, NvMUseServicePorts=true, NvMAutomaticBlockLength=false, NvMBlockLengthCheck=true, NvMBlockLengthCheckType=true
        NvMTargetBlockReference
          NvMFeeRef: NvMNameOfFeeBlock=FeeRte_NvmBlock_PartNr_PartNrVinData
      Rte_NvmBlock_PartNr_PartNrProgmDate: NvMInitBlockCallback=NULL_PTR, NvMSelectBlockForReadAll=true, NvMSelectBlockForWriteAll=true, NvMWriteRamBlockToNvCallback=NULL_PTR, NvMUseInitCallback=false, NvMSingleBlockCallback=NULL_PTR, NvMBlockUseCrc=true, NvMBlockUseSyncMechanism=false, NvMNvBlockLength=4, NvMNvramBlockIdentifier=92, NvMRamBlockDataAddress=Rte_PartNr_PartNrProgmDate, NvMReadRamBlockFromNvCallback=NULL_PTR, NvMRomBlockDataAddress=Rte_CalprmRom_PartNr_DEFAULT_RTE_CDATA_GROUP.PartNrProgmDateDft, NvMUseServicePorts=true, NvMAutomaticBlockLength=false, NvMBlockLengthCheck=true, NvMBlockLengthCheckType=true
        NvMTargetBlockReference
          NvMFeeRef: NvMNameOfFeeBlock=FeeRte_NvmBlock_PartNr_PartNrProgmDate
      Rte_NvmBlock_PartNr_PartNrDataUniversalNrSysId: NvMInitBlockCallback=NULL_PTR, NvMSelectBlockForReadAll=true, NvMSelectBlockForWriteAll=true, NvMWriteRamBlockToNvCallback=NULL_PTR, NvMUseInitCallback=false, NvMSingleBlockCallback=NULL_PTR, NvMBlockUseCrc=true, NvMBlockUseSyncMechanism=false, NvMNvBlockLength=9, NvMNvramBlockIdentifier=93, NvMRamBlockDataAddress=Rte_PartNr_PartNrDataUniversalNrSysId, NvMReadRamBlockFromNvCallback=NULL_PTR, NvMRomBlockDataAddress=Rte_CalprmRom_PartNr_DEFAULT_RTE_CDATA_GROUP.PartNrDataUniversalNrSysIdDft, NvMUseServicePorts=true, NvMAutomaticBlockLength=false, NvMBlockLengthCheck=true, NvMBlockLengthCheckType=true
        NvMTargetBlockReference
          NvMFeeRef: NvMNameOfFeeBlock=FeeRte_NvmBlock_PartNr_PartNrDataUniversalNrSysId
      Rte_NvmBlock_PartNr_PartNrCalProgdSts: NvMInitBlockCallback=NULL_PTR, NvMSelectBlockForReadAll=true, NvMSelectBlockForWriteAll=true, NvMWriteRamBlockToNvCallback=NULL_PTR, NvMUseInitCallback=false, NvMSingleBlockCallback=NULL_PTR, NvMBlockUseCrc=true, NvMBlockUseSyncMechanism=false, NvMNvBlockLength=1, NvMNvramBlockIdentifier=94, NvMRamBlockDataAddress=Rte_PartNr_PartNrCalProgdSts, NvMReadRamBlockFromNvCallback=NULL_PTR, NvMRomBlockDataAddress=Rte_CalprmRom_PartNr_DEFAULT_RTE_CDATA_GROUP.PartNrCalProgdStsDft, NvMUseServicePorts=true, NvMAutomaticBlockLength=false, NvMBlockLengthCheck=true, NvMBlockLengthCheckType=true
        NvMTargetBlockReference
          NvMFeeRef: NvMNameOfFeeBlock=FeeRte_NvmBlock_PartNr_PartNrCalProgdSts
      Rte_NvmBlock_PartNr_PartNrCustMfgEnaCntr: NvMInitBlockCallback=NULL_PTR, NvMSelectBlockForReadAll=true, NvMSelectBlockForWriteAll=true, NvMWriteRamBlockToNvCallback=NULL_PTR, NvMUseInitCallback=false, NvMSingleBlockCallback=NULL_PTR, NvMBlockUseCrc=true, NvMBlockUseSyncMechanism=false, NvMNvBlockLength=1, NvMNvramBlockIdentifier=95, NvMRamBlockDataAddress=Rte_PartNr_PartNrCustMfgEnaCntr, NvMReadRamBlockFromNvCallback=NULL_PTR, NvMRomBlockDataAddress=Rte_CalprmRom_PartNr_DEFAULT_RTE_CDATA_GROUP.PartNrCustMfgEnaCntrDft, NvMUseServicePorts=true, NvMAutomaticBlockLength=false, NvMBlockLengthCheck=true, NvMBlockLengthCheckType=true
        NvMTargetBlockReference
          NvMFeeRef: NvMNameOfFeeBlock=FeeRte_NvmBlock_PartNr_PartNrCustMfgEnaCntr
      Rte_NvmBlock_PartNr_PartNrProgmSessionSeedKey: NvMInitBlockCallback=NULL_PTR, NvMSelectBlockForReadAll=true, NvMSelectBlockForWriteAll=true, NvMWriteRamBlockToNvCallback=NULL_PTR, NvMUseInitCallback=false, NvMSingleBlockCallback=NULL_PTR, NvMBlockUseCrc=true, NvMBlockUseSyncMechanism=false, NvMNvBlockLength=10, NvMNvramBlockIdentifier=96, NvMRamBlockDataAddress=Rte_PartNr_PartNrProgmSessionSeedKey, NvMReadRamBlockFromNvCallback=NULL_PTR, NvMRomBlockDataAddress=Rte_CalprmRom_PartNr_DEFAULT_RTE_CDATA_GROUP.PartNrProgmSessionSeedKeyDft, NvMUseServicePorts=true, NvMAutomaticBlockLength=false, NvMBlockLengthCheck=true, NvMBlockLengthCheckType=true
        NvMTargetBlockReference
          NvMFeeRef: NvMNameOfFeeBlock=FeeRte_NvmBlock_PartNr_PartNrProgmSessionSeedKey
      Rte_NvmBlock_CmnMfgSrv_MfgTmpBuf4: NvMInitBlockCallback=NULL_PTR, NvMSelectBlockForReadAll=true, NvMSelectBlockForWriteAll=true, NvMWriteRamBlockToNvCallback=NULL_PTR, NvMUseInitCallback=false, NvMSingleBlockCallback=NULL_PTR, NvMBlockUseCrc=true, NvMBlockUseSyncMechanism=false, NvMNvBlockLength=16, NvMNvramBlockIdentifier=74, NvMRamBlockDataAddress=Rte_CmnMfgSrv_MfgTmpBuf4, NvMReadRamBlockFromNvCallback=NULL_PTR, NvMRomBlockDataAddress=NULL_PTR, NvMUseServicePorts=false, NvMAutomaticBlockLength=false, NvMBlockLengthCheck=true, NvMBlockLengthCheckType=true
        NvMTargetBlockReference
          NvMFeeRef: NvMNameOfFeeBlock=FeeRte_NvmBlock_CmnMfgSrv_MfgTmpBuf4
      Rte_NvmBlock_CmnMfgSrv_EpsSysSerlNr: NvMInitBlockCallback=NULL_PTR, NvMSelectBlockForReadAll=true, NvMSelectBlockForWriteAll=true, NvMWriteRamBlockToNvCallback=NULL_PTR, NvMUseInitCallback=false, NvMSingleBlockCallback=NULL_PTR, NvMBlockUseCrc=true, NvMBlockUseSyncMechanism=false, NvMNvBlockLength=20, NvMNvramBlockIdentifier=75, NvMRamBlockDataAddress=Rte_CmnMfgSrv_EpsSysSerlNr, NvMReadRamBlockFromNvCallback=NULL_PTR, NvMRomBlockDataAddress=NULL_PTR, NvMUseServicePorts=false, NvMAutomaticBlockLength=false, NvMBlockLengthCheck=true, NvMBlockLengthCheckType=true
        NvMTargetBlockReference
          NvMFeeRef: NvMNameOfFeeBlock=FeeRte_NvmBlock_CmnMfgSrv_EpsSysSerlNr
      Rte_NvmBlock_CmnMfgSrv_MfgTmpBuf3: NvMInitBlockCallback=NULL_PTR, NvMSelectBlockForReadAll=true, NvMSelectBlockForWriteAll=true, NvMWriteRamBlockToNvCallback=NULL_PTR, NvMUseInitCallback=false, NvMSingleBlockCallback=NULL_PTR, NvMBlockUseCrc=true, NvMBlockUseSyncMechanism=false, NvMNvBlockLength=16, NvMNvramBlockIdentifier=76, NvMRamBlockDataAddress=Rte_CmnMfgSrv_MfgTmpBuf3, NvMReadRamBlockFromNvCallback=NULL_PTR, NvMRomBlockDataAddress=NULL_PTR, NvMUseServicePorts=false, NvMAutomaticBlockLength=false, NvMBlockLengthCheck=true, NvMBlockLengthCheckType=true
        NvMTargetBlockReference
          NvMFeeRef: NvMNameOfFeeBlock=FeeRte_NvmBlock_CmnMfgSrv_MfgTmpBuf3
      Rte_NvmBlock_CmnMfgSrv_DiRestore: NvMInitBlockCallback=NULL_PTR, NvMSelectBlockForReadAll=true, NvMSelectBlockForWriteAll=true, NvMWriteRamBlockToNvCallback=NULL_PTR, NvMUseInitCallback=false, NvMSingleBlockCallback=NULL_PTR, NvMBlockUseCrc=true, NvMBlockUseSyncMechanism=false, NvMNvBlockLength=8, NvMNvramBlockIdentifier=77, NvMRamBlockDataAddress=Rte_CmnMfgSrv_DiRestore, NvMReadRamBlockFromNvCallback=NULL_PTR, NvMRomBlockDataAddress=NULL_PTR, NvMUseServicePorts=false, NvMAutomaticBlockLength=false, NvMBlockLengthCheck=true, NvMBlockLengthCheckType=true
        NvMTargetBlockReference
          NvMFeeRef: NvMNameOfFeeBlock=FeeRte_NvmBlock_CmnMfgSrv_DiRestore
      Rte_NvmBlock_CmnMfgSrv_MfgTmpBuf2: NvMInitBlockCallback=NULL_PTR, NvMSelectBlockForReadAll=true, NvMSelectBlockForWriteAll=true, NvMWriteRamBlockToNvCallback=NULL_PTR, NvMUseInitCallback=false, NvMSingleBlockCallback=NULL_PTR, NvMBlockUseCrc=true, NvMBlockUseSyncMechanism=false, NvMNvBlockLength=16, NvMNvramBlockIdentifier=78, NvMRamBlockDataAddress=Rte_CmnMfgSrv_MfgTmpBuf2, NvMReadRamBlockFromNvCallback=NULL_PTR, NvMRomBlockDataAddress=NULL_PTR, NvMUseServicePorts=false, NvMAutomaticBlockLength=false, NvMBlockLengthCheck=true, NvMBlockLengthCheckType=true
        NvMTargetBlockReference
          NvMFeeRef: NvMNameOfFeeBlock=FeeRte_NvmBlock_CmnMfgSrv_MfgTmpBuf2
      Rte_NvmBlock_CmnMfgSrv_MfgTmpBuf1: NvMInitBlockCallback=NULL_PTR, NvMSelectBlockForReadAll=true, NvMSelectBlockForWriteAll=true, NvMWriteRamBlockToNvCallback=NULL_PTR, NvMUseInitCallback=false, NvMSingleBlockCallback=NULL_PTR, NvMBlockUseCrc=true, NvMBlockUseSyncMechanism=false, NvMNvBlockLength=16, NvMNvramBlockIdentifier=79, NvMRamBlockDataAddress=Rte_CmnMfgSrv_MfgTmpBuf1, NvMReadRamBlockFromNvCallback=NULL_PTR, NvMRomBlockDataAddress=NULL_PTR, NvMUseServicePorts=false, NvMAutomaticBlockLength=false, NvMBlockLengthCheck=true, NvMBlockLengthCheckType=true
        NvMTargetBlockReference
          NvMFeeRef: NvMNameOfFeeBlock=FeeRte_NvmBlock_CmnMfgSrv_MfgTmpBuf1
      Rte_NvmBlock_CmnMfgSrv_CcaHwPartNr: NvMInitBlockCallback=NULL_PTR, NvMSelectBlockForReadAll=true, NvMSelectBlockForWriteAll=true, NvMWriteRamBlockToNvCallback=NULL_PTR, NvMUseInitCallback=false, NvMSingleBlockCallback=NULL_PTR, NvMBlockUseCrc=true, NvMBlockUseSyncMechanism=false, NvMNvBlockLength=20, NvMNvramBlockIdentifier=80, NvMRamBlockDataAddress=Rte_CmnMfgSrv_CcaHwPartNr, NvMReadRamBlockFromNvCallback=NULL_PTR, NvMRomBlockDataAddress=NULL_PTR, NvMUseServicePorts=false, NvMAutomaticBlockLength=false, NvMBlockLengthCheck=true, NvMBlockLengthCheckType=true
        NvMTargetBlockReference
          NvMFeeRef: NvMNameOfFeeBlock=FeeRte_NvmBlock_CmnMfgSrv_CcaHwPartNr
      Rte_NvmBlock_CmnMfgSrv_MfgTmpBuf0: NvMInitBlockCallback=NULL_PTR, NvMSelectBlockForReadAll=true, NvMSelectBlockForWriteAll=true, NvMWriteRamBlockToNvCallback=NULL_PTR, NvMUseInitCallback=false, NvMSingleBlockCallback=NULL_PTR, NvMBlockUseCrc=true, NvMBlockUseSyncMechanism=false, NvMNvBlockLength=16, NvMNvramBlockIdentifier=81, NvMRamBlockDataAddress=Rte_CmnMfgSrv_MfgTmpBuf0, NvMReadRamBlockFromNvCallback=NULL_PTR, NvMRomBlockDataAddress=NULL_PTR, NvMUseServicePorts=false, NvMAutomaticBlockLength=false, NvMBlockLengthCheck=true, NvMBlockLengthCheckType=true
        NvMTargetBlockReference
          NvMFeeRef: NvMNameOfFeeBlock=FeeRte_NvmBlock_CmnMfgSrv_MfgTmpBuf0
      Rte_NvmBlock_CmnMfgSrv_CcaSerlNr: NvMInitBlockCallback=NULL_PTR, NvMSelectBlockForReadAll=true, NvMSelectBlockForWriteAll=true, NvMWriteRamBlockToNvCallback=NULL_PTR, NvMUseInitCallback=false, NvMSingleBlockCallback=NULL_PTR, NvMBlockUseCrc=true, NvMBlockUseSyncMechanism=false, NvMNvBlockLength=20, NvMNvramBlockIdentifier=82, NvMRamBlockDataAddress=Rte_CmnMfgSrv_CcaSerlNr, NvMReadRamBlockFromNvCallback=NULL_PTR, NvMRomBlockDataAddress=NULL_PTR, NvMUseServicePorts=false, NvMAutomaticBlockLength=false, NvMBlockLengthCheck=true, NvMBlockLengthCheckType=true
        NvMTargetBlockReference
          NvMFeeRef: NvMNameOfFeeBlock=FeeRte_NvmBlock_CmnMfgSrv_CcaSerlNr
      Rte_NvmBlock_DutyCycThermProtn_FilStVal: NvMInitBlockCallback=NULL_PTR, NvMSelectBlockForReadAll=true, NvMSelectBlockForWriteAll=true, NvMWriteRamBlockToNvCallback=NULL_PTR, NvMUseInitCallback=false, NvMSingleBlockCallback=NULL_PTR, NvMBlockUseCrc=true, NvMBlockUseSyncMechanism=false, NvMNvBlockLength=4, NvMNvramBlockIdentifier=73, NvMRamBlockDataAddress=Rte_DutyCycThermProtn_FilStVal, NvMReadRamBlockFromNvCallback=NULL_PTR, NvMUseServicePorts=true, NvMRomBlockDataAddress=NULL_PTR, NvMAutomaticBlockLength=false, NvMBlockLengthCheck=true, NvMBlockLengthCheckType=true
        NvMTargetBlockReference
          NvMFeeRef: NvMNameOfFeeBlock=FeeRte_NvmBlock_DutyCycThermProtn_FilStVal
      Rte_NvmBlock_PullCmpActv_PullCmpLongTerm: NvMInitBlockCallback=NULL_PTR, NvMSelectBlockForReadAll=true, NvMSelectBlockForWriteAll=true, NvMWriteRamBlockToNvCallback=NULL_PTR, NvMUseInitCallback=false, NvMSingleBlockCallback=NULL_PTR, NvMBlockUseCrc=true, NvMBlockUseSyncMechanism=false, NvMNvBlockLength=4, NvMNvramBlockIdentifier=72, NvMRamBlockDataAddress=Rte_PullCmpActv_PullCmpLongTerm, NvMReadRamBlockFromNvCallback=NULL_PTR, NvMRomBlockDataAddress=Rte_CalprmRom_PullCmpActv_DEFAULT_RTE_CDATA_GROUP.PullCmpLongTermDft, NvMUseServicePorts=true, NvMAutomaticBlockLength=false, NvMBlockLengthCheck=true, NvMBlockLengthCheckType=true
        NvMTargetBlockReference
          NvMFeeRef: NvMNameOfFeeBlock=FeeRte_NvmBlock_PullCmpActv_PullCmpLongTerm
      Rte_NvmBlock_MotTqCmdSca_MotTqScaFac: NvMInitBlockCallback=NULL_PTR, NvMSelectBlockForReadAll=true, NvMSelectBlockForWriteAll=true, NvMWriteRamBlockToNvCallback=NULL_PTR, NvMUseInitCallback=false, NvMSingleBlockCallback=NULL_PTR, NvMBlockUseCrc=true, NvMBlockUseSyncMechanism=false, NvMNvBlockLength=4, NvMNvramBlockIdentifier=71, NvMRamBlockDataAddress=Rte_MotTqCmdSca_MotTqScaFac, NvMReadRamBlockFromNvCallback=NULL_PTR, NvMRomBlockDataAddress=NULL_PTR, NvMUseServicePorts=false, NvMAutomaticBlockLength=false, NvMBlockLengthCheck=true, NvMBlockLengthCheckType=true
        NvMTargetBlockReference
          NvMFeeRef: NvMNameOfFeeBlock=FeeRte_NvmBlock_MotTqCmdSca_MotTqScaFac
      Rte_NvmBlock_SnsrOffsLrng_SnsrOffsLrnd: NvMInitBlockCallback=NULL_PTR, NvMSelectBlockForReadAll=true, NvMSelectBlockForWriteAll=true, NvMWriteRamBlockToNvCallback=NULL_PTR, NvMUseInitCallback=false, NvMSingleBlockCallback=NULL_PTR, NvMBlockUseCrc=true, NvMBlockUseSyncMechanism=false, NvMNvBlockLength=76, NvMNvramBlockIdentifier=70, NvMRamBlockDataAddress=Rte_SnsrOffsLrng_SnsrOffsLrnd, NvMReadRamBlockFromNvCallback=NULL_PTR, NvMRomBlockDataAddress=NULL_PTR, NvMUseServicePorts=true, NvMAutomaticBlockLength=false, NvMBlockLengthCheck=true, NvMBlockLengthCheckType=true
        NvMTargetBlockReference
          NvMFeeRef: NvMNameOfFeeBlock=FeeRte_NvmBlock_SnsrOffsLrng_SnsrOffsLrnd
      Rte_NvmBlock_GmOvrlStMgr_GmLoaIgnCntr: NvMInitBlockCallback=NULL_PTR, NvMSelectBlockForReadAll=true, NvMSelectBlockForWriteAll=true, NvMWriteRamBlockToNvCallback=NULL_PTR, NvMUseInitCallback=false, NvMSingleBlockCallback=NULL_PTR, NvMBlockUseCrc=true, NvMBlockUseSyncMechanism=false, NvMNvBlockLength=2, NvMNvramBlockIdentifier=69, NvMRamBlockDataAddress=Rte_GmOvrlStMgr_GmLoaIgnCntr, NvMReadRamBlockFromNvCallback=NULL_PTR, NvMUseServicePorts=true, NvMRomBlockDataAddress=NULL_PTR, NvMAutomaticBlockLength=false, NvMBlockLengthCheck=true, NvMBlockLengthCheckType=true
        NvMTargetBlockReference
          NvMFeeRef: NvMNameOfFeeBlock=FeeRte_NvmBlock_GmOvrlStMgr_GmLoaIgnCntr
      Rte_NvmBlock_MotRplCoggCfg_MotRplCoggPrm: NvMInitBlockCallback=NULL_PTR, NvMSelectBlockForReadAll=true, NvMSelectBlockForWriteAll=true, NvMWriteRamBlockToNvCallback=NULL_PTR, NvMUseInitCallback=false, NvMSingleBlockCallback=NULL_PTR, NvMBlockUseCrc=true, NvMBlockUseSyncMechanism=false, NvMNvBlockLength=18, NvMNvramBlockIdentifier=67, NvMRamBlockDataAddress=Rte_MotRplCoggCfg_MotRplCoggPrm, NvMReadRamBlockFromNvCallback=NULL_PTR, NvMRomBlockDataAddress=NULL_PTR, NvMUseServicePorts=false, NvMAutomaticBlockLength=false, NvMBlockLengthCheck=true, NvMBlockLengthCheckType=true
        NvMTargetBlockReference
          NvMFeeRef: NvMNameOfFeeBlock=FeeRte_NvmBlock_MotRplCoggCfg_MotRplCoggPrm
      Rte_NvmBlock_CDD_MotRplCoggCmd_MotCoggCmdY: NvMInitBlockCallback=NULL_PTR, NvMSelectBlockForReadAll=true, NvMSelectBlockForWriteAll=true, NvMWriteRamBlockToNvCallback=NULL_PTR, NvMUseInitCallback=false, NvMSingleBlockCallback=NULL_PTR, NvMBlockUseCrc=true, NvMBlockUseSyncMechanism=false, NvMNvBlockLength=1024, NvMNvramBlockIdentifier=68, NvMRamBlockDataAddress=Rte_CDD_MotRplCoggCmd_MotCoggCmdY, NvMReadRamBlockFromNvCallback=NULL_PTR, NvMRomBlockDataAddress=NULL_PTR, NvMUseServicePorts=false, NvMAutomaticBlockLength=false, NvMBlockLengthCheck=true, NvMBlockLengthCheckType=true
        NvMTargetBlockReference
          NvMFeeRef: NvMNameOfFeeBlock=FeeRte_NvmBlock_CDD_MotRplCoggCmd_MotCoggCmdY
      Rte_NvmBlock_StHlthSigStc_SigStcHistDataAry: NvMInitBlockCallback=NULL_PTR, NvMSelectBlockForReadAll=true, NvMSelectBlockForWriteAll=true, NvMWriteRamBlockToNvCallback=NULL_PTR, NvMUseInitCallback=false, NvMSingleBlockCallback=NULL_PTR, NvMBlockUseCrc=true, NvMBlockUseSyncMechanism=false, NvMNvBlockLength=225, NvMNvramBlockIdentifier=66, NvMRamBlockDataAddress=Rte_StHlthSigStc_SigStcHistDataAry, NvMReadRamBlockFromNvCallback=NULL_PTR, NvMRomBlockDataAddress=NULL_PTR, NvMUseServicePorts=false, NvMAutomaticBlockLength=false, NvMBlockLengthCheck=true, NvMBlockLengthCheckType=true
        NvMTargetBlockReference
          NvMFeeRef: NvMNameOfFeeBlock=FeeRte_NvmBlock_StHlthSigStc_SigStcHistDataAry
      Rte_NvmBlock_HwAgVehCentrTrim_HwAgTrimVal_Deprecated: NvMInitBlockCallback=NULL_PTR, NvMSelectBlockForReadAll=false, NvMSelectBlockForWriteAll=false, NvMWriteRamBlockToNvCallback=NULL_PTR, NvMUseInitCallback=false, NvMSingleBlockCallback=NULL_PTR, NvMBlockUseCrc=true, NvMBlockUseSyncMechanism=false, NvMNvBlockLength=4, NvMNvramBlockIdentifier=65, NvMRamBlockDataAddress=NULL_PTR, NvMReadRamBlockFromNvCallback=NULL_PTR, NvMUseServicePorts=false, NvMRomBlockDataAddress=NULL_PTR, NvMAutomaticBlockLength=false, NvMBlockLengthCheck=false, NvMBlockLengthCheckType=true
        NvMTargetBlockReference
          NvMFeeRef: NvMNameOfFeeBlock=FeeRte_NvmBlock_HwAgVehCentrTrim_HwAgTrimVal_Deprecated
      Rte_NvmBlock_WhlImbRejctn_MaxCompPerc_Deprecated: NvMInitBlockCallback=NULL_PTR, NvMSelectBlockForReadAll=false, NvMSelectBlockForWriteAll=false, NvMWriteRamBlockToNvCallback=NULL_PTR, NvMUseInitCallback=false, NvMSingleBlockCallback=NULL_PTR, NvMBlockUseCrc=true, NvMBlockUseSyncMechanism=false, NvMNvBlockLength=4, NvMNvramBlockIdentifier=59, NvMRamBlockDataAddress=NULL_PTR, NvMReadRamBlockFromNvCallback=NULL_PTR, NvMRomBlockDataAddress=NULL_PTR, NvMUseServicePorts=false, NvMAutomaticBlockLength=false, NvMBlockLengthCheck=false, NvMBlockLengthCheckType=true
        NvMTargetBlockReference
          NvMFeeRef: NvMNameOfFeeBlock=FeeRte_NvmBlock_WhlImbRejctn_MaxCompPerc_Deprecated
      Rte_NvmBlock_WhlImbRejctn_ActvCmpBand3_Deprecated: NvMInitBlockCallback=NULL_PTR, NvMSelectBlockForReadAll=false, NvMSelectBlockForWriteAll=false, NvMWriteRamBlockToNvCallback=NULL_PTR, NvMUseInitCallback=false, NvMSingleBlockCallback=NULL_PTR, NvMBlockUseCrc=true, NvMBlockUseSyncMechanism=false, NvMNvBlockLength=4, NvMNvramBlockIdentifier=60, NvMRamBlockDataAddress=NULL_PTR, NvMReadRamBlockFromNvCallback=NULL_PTR, NvMRomBlockDataAddress=NULL_PTR, NvMUseServicePorts=false, NvMAutomaticBlockLength=false, NvMBlockLengthCheck=false, NvMBlockLengthCheckType=true
        NvMTargetBlockReference
          NvMFeeRef: NvMNameOfFeeBlock=FeeRte_NvmBlock_WhlImbRejctn_ActvCmpBand3_Deprecated
      Rte_NvmBlock_WhlImbRejctn_ActvCmpBand1_Deprecated: NvMInitBlockCallback=NULL_PTR, NvMSelectBlockForReadAll=false, NvMSelectBlockForWriteAll=false, NvMWriteRamBlockToNvCallback=NULL_PTR, NvMUseInitCallback=false, NvMSingleBlockCallback=NULL_PTR, NvMBlockUseCrc=true, NvMBlockUseSyncMechanism=false, NvMNvBlockLength=4, NvMNvramBlockIdentifier=61, NvMRamBlockDataAddress=NULL_PTR, NvMReadRamBlockFromNvCallback=NULL_PTR, NvMRomBlockDataAddress=NULL_PTR, NvMUseServicePorts=false, NvMAutomaticBlockLength=false, NvMBlockLengthCheck=false, NvMBlockLengthCheckType=true
        NvMTargetBlockReference
          NvMFeeRef: NvMNameOfFeeBlock=FeeRte_NvmBlock_WhlImbRejctn_ActvCmpBand1_Deprecated
      Rte_NvmBlock_WhlImbRejctn_RiPeakPrev_Deprecated: NvMInitBlockCallback=NULL_PTR, NvMSelectBlockForReadAll=false, NvMSelectBlockForWriteAll=false, NvMWriteRamBlockToNvCallback=NULL_PTR, NvMUseInitCallback=false, NvMSingleBlockCallback=NULL_PTR, NvMBlockUseCrc=true, NvMBlockUseSyncMechanism=false, NvMNvBlockLength=4, NvMNvramBlockIdentifier=62, NvMRamBlockDataAddress=NULL_PTR, NvMReadRamBlockFromNvCallback=NULL_PTR, NvMRomBlockDataAddress=NULL_PTR, NvMUseServicePorts=false, NvMAutomaticBlockLength=false, NvMBlockLengthCheck=false, NvMBlockLengthCheckType=true
        NvMTargetBlockReference
          NvMFeeRef: NvMNameOfFeeBlock=FeeRte_NvmBlock_WhlImbRejctn_RiPeakPrev_Deprecated
      Rte_NvmBlock_WhlImbRejctn_LePeakPrev_Deprecated: NvMInitBlockCallback=NULL_PTR, NvMSelectBlockForReadAll=false, NvMSelectBlockForWriteAll=false, NvMWriteRamBlockToNvCallback=NULL_PTR, NvMUseInitCallback=false, NvMSingleBlockCallback=NULL_PTR, NvMBlockUseCrc=true, NvMBlockUseSyncMechanism=false, NvMNvBlockLength=4, NvMNvramBlockIdentifier=63, NvMRamBlockDataAddress=NULL_PTR, NvMReadRamBlockFromNvCallback=NULL_PTR, NvMRomBlockDataAddress=NULL_PTR, NvMUseServicePorts=false, NvMAutomaticBlockLength=false, NvMBlockLengthCheck=false, NvMBlockLengthCheckType=true
        NvMTargetBlockReference
          NvMFeeRef: NvMNameOfFeeBlock=FeeRte_NvmBlock_WhlImbRejctn_LePeakPrev_Deprecated
      Rte_NvmBlock_WhlImbRejctn_ActvCmpBand2_Deprecated: NvMInitBlockCallback=NULL_PTR, NvMSelectBlockForReadAll=false, NvMSelectBlockForWriteAll=false, NvMWriteRamBlockToNvCallback=NULL_PTR, NvMUseInitCallback=false, NvMSingleBlockCallback=NULL_PTR, NvMBlockUseCrc=true, NvMBlockUseSyncMechanism=false, NvMNvBlockLength=4, NvMNvramBlockIdentifier=64, NvMRamBlockDataAddress=NULL_PTR, NvMReadRamBlockFromNvCallback=NULL_PTR, NvMRomBlockDataAddress=NULL_PTR, NvMUseServicePorts=false, NvMAutomaticBlockLength=false, NvMBlockLengthCheck=false, NvMBlockLengthCheckType=true
        NvMTargetBlockReference
          NvMFeeRef: NvMNameOfFeeBlock=FeeRte_NvmBlock_WhlImbRejctn_ActvCmpBand2_Deprecated
      Rte_NvmBlock_HwAgVehCentrTrim_HwAgTrimData: NvMInitBlockCallback=NULL_PTR, NvMSelectBlockForReadAll=true, NvMSelectBlockForWriteAll=true, NvMWriteRamBlockToNvCallback=NULL_PTR, NvMUseInitCallback=false, NvMSingleBlockCallback=NULL_PTR, NvMBlockUseCrc=true, NvMBlockUseSyncMechanism=false, NvMNvBlockLength=8, NvMNvramBlockIdentifier=58, NvMRamBlockDataAddress=Rte_HwAgVehCentrTrim_HwAgTrimData, NvMReadRamBlockFromNvCallback=NULL_PTR, NvMRomBlockDataAddress=Rte_CalprmRom_HwAgVehCentrTrim_DEFAULT_RTE_CDATA_GROUP.HwAgTrimDataDft, NvMUseServicePorts=false, NvMAutomaticBlockLength=false, NvMBlockLengthCheck=true, NvMBlockLengthCheckType=true
        NvMTargetBlockReference
          NvMFeeRef: NvMNameOfFeeBlock=FeeRte_NvmBlock_HwAgVehCentrTrim_HwAgTrimData
      Rte_NvmBlock_SysFricLrng_FricNonLrngData: NvMInitBlockCallback=NULL_PTR, NvMSelectBlockForReadAll=true, NvMSelectBlockForWriteAll=true, NvMWriteRamBlockToNvCallback=NULL_PTR, NvMUseInitCallback=false, NvMSingleBlockCallback=NULL_PTR, NvMBlockUseCrc=true, NvMBlockUseSyncMechanism=false, NvMNvBlockLength=8, NvMNvramBlockIdentifier=56, NvMRamBlockDataAddress=Rte_SysFricLrng_FricNonLrngData, NvMReadRamBlockFromNvCallback=NULL_PTR, NvMRomBlockDataAddress=Rte_CalprmRom_SysFricLrng_DEFAULT_RTE_CDATA_GROUP.FricNonLrngDataDft, NvMUseServicePorts=false, NvMAutomaticBlockLength=false, NvMBlockLengthCheck=true, NvMBlockLengthCheckType=true
        NvMTargetBlockReference
          NvMFeeRef: NvMNameOfFeeBlock=FeeRte_NvmBlock_SysFricLrng_FricNonLrngData
      Rte_NvmBlock_SysFricLrng_FricLrngData: NvMInitBlockCallback=NULL_PTR, NvMSelectBlockForReadAll=true, NvMSelectBlockForWriteAll=true, NvMWriteRamBlockToNvCallback=NULL_PTR, NvMUseInitCallback=false, NvMSingleBlockCallback=NULL_PTR, NvMBlockUseCrc=true, NvMBlockUseSyncMechanism=false, NvMNvBlockLength=216, NvMNvramBlockIdentifier=57, NvMRamBlockDataAddress=Rte_SysFricLrng_FricLrngData, NvMReadRamBlockFromNvCallback=NULL_PTR, NvMRomBlockDataAddress=Rte_CalprmRom_SysFricLrng_DEFAULT_RTE_CDATA_GROUP.FricLrngDataDft, NvMUseServicePorts=false, NvMAutomaticBlockLength=false, NvMBlockLengthCheck=true, NvMBlockLengthCheckType=true
        NvMTargetBlockReference
          NvMFeeRef: NvMNameOfFeeBlock=FeeRte_NvmBlock_SysFricLrng_FricLrngData
      Rte_NvmBlock_Bootloader_EcuId: NvMInitBlockCallback=NULL_PTR, NvMSelectBlockForReadAll=true, NvMSelectBlockForWriteAll=true, NvMWriteRamBlockToNvCallback=NULL_PTR, NvMUseInitCallback=false, NvMSingleBlockCallback=NULL_PTR, NvMBlockUseCrc=false, NvMBlockUseSyncMechanism=false, NvMNvBlockLength=16, NvMNvramBlockIdentifier=55, NvMRamBlockDataAddress=Rte_PartNr_PartNrEcuId, NvMReadRamBlockFromNvCallback=NULL_PTR, NvMRomBlockDataAddress=NULL_PTR, NvMUseServicePorts=false, NvMAutomaticBlockLength=false, NvMBlockLengthCheck=true, NvMBlockLengthCheckType=true
        NvMTargetBlockReference
          NvMFeeRef: NvMNameOfFeeBlock=FeeRte_NvmBlock_Bootloader_EcuId
      Rte_NvmBlock_Bootloader_NbId: NvMInitBlockCallback=NULL_PTR, NvMSelectBlockForReadAll=false, NvMSelectBlockForWriteAll=false, NvMWriteRamBlockToNvCallback=NULL_PTR, NvMUseInitCallback=false, NvMSingleBlockCallback=NULL_PTR, NvMBlockUseCrc=false, NvMBlockUseSyncMechanism=false, NvMNvBlockLength=4, NvMNvramBlockIdentifier=54, NvMRamBlockDataAddress=NULL_PTR, NvMReadRamBlockFromNvCallback=NULL_PTR, NvMRomBlockDataAddress=NULL_PTR, NvMUseServicePorts=false, NvMAutomaticBlockLength=false, NvMBlockLengthCheck=false, NvMBlockLengthCheckType=true
        NvMTargetBlockReference
          NvMFeeRef: NvMNameOfFeeBlock=FeeRte_NvmBlock_Bootloader_NbId
      Rte_NvmBlock_Bootloader_SBAT: NvMInitBlockCallback=NULL_PTR, NvMSelectBlockForReadAll=true, NvMSelectBlockForWriteAll=true, NvMWriteRamBlockToNvCallback=NULL_PTR, NvMUseInitCallback=false, NvMSingleBlockCallback=NULL_PTR, NvMBlockUseCrc=false, NvMBlockUseSyncMechanism=false, NvMNvBlockLength=822, NvMNvramBlockIdentifier=53, NvMRamBlockDataAddress=Rte_PartNr_PartNrSecuBypAuthn, NvMReadRamBlockFromNvCallback=NULL_PTR, NvMRomBlockDataAddress=NULL_PTR, NvMUseServicePorts=false, NvMAutomaticBlockLength=false, NvMBlockLengthCheck=true, NvMBlockLengthCheckType=true
        NvMTargetBlockReference
          NvMFeeRef: NvMNameOfFeeBlock=FeeRte_NvmBlock_Bootloader_SBAT
      DemAdminDataBlock: NvMInitBlockCallback=Dem_NvM_InitAdminData, NvMSelectBlockForReadAll=true, NvMSelectBlockForWriteAll=true, NvMWriteRamBlockToNvCallback=NULL_PTR, NvMUseInitCallback=true, NvMSingleBlockCallback=Dem_NvM_JobFinished, NvMBlockUseCrc=false, NvMBlockUseSyncMechanism=false, NvMNvBlockLength=8, NvMNvramBlockIdentifier=43, NvMRamBlockDataAddress=Dem_Cfg_AdminData, NvMReadRamBlockFromNvCallback=NULL_PTR, NvMRomBlockDataAddress=NULL_PTR, NvMUseServicePorts=false, NvMAutomaticBlockLength=false, NvMBlockLengthCheck=true, NvMBlockLengthCheckType=true
        NvMTargetBlockReference
          NvMFeeRef: NvMNameOfFeeBlock=FeeDemAdminDataBlock
      DemStatusDataBlock: NvMInitBlockCallback=Dem_NvM_InitStatusData, NvMSelectBlockForReadAll=true, NvMSelectBlockForWriteAll=true, NvMWriteRamBlockToNvCallback=NULL_PTR, NvMUseInitCallback=true, NvMSingleBlockCallback=Dem_NvM_JobFinished, NvMBlockUseCrc=false, NvMBlockUseSyncMechanism=false, NvMNvBlockLength=72, NvMNvramBlockIdentifier=44, NvMRamBlockDataAddress=Dem_Cfg_StatusData, NvMReadRamBlockFromNvCallback=NULL_PTR, NvMRomBlockDataAddress=NULL_PTR, NvMUseServicePorts=false, NvMAutomaticBlockLength=false, NvMBlockLengthCheck=true, NvMBlockLengthCheckType=true
        NvMTargetBlockReference
          NvMFeeRef: NvMNameOfFeeBlock=FeeDemStatusDataBlock
      DemPrimaryDataBlock0: NvMInitBlockCallback=NULL_PTR, NvMSelectBlockForReadAll=true, NvMSelectBlockForWriteAll=true, NvMWriteRamBlockToNvCallback=NULL_PTR, NvMUseInitCallback=false, NvMSingleBlockCallback=Dem_NvM_JobFinished, NvMBlockUseCrc=false, NvMBlockUseSyncMechanism=false, NvMNvBlockLength=44, NvMNvramBlockIdentifier=45, NvMRamBlockDataAddress=Dem_Cfg_PrimaryEntry_0, NvMReadRamBlockFromNvCallback=NULL_PTR, NvMRomBlockDataAddress=Dem_Cfg_MemoryEntryInit, NvMUseServicePorts=false, NvMAutomaticBlockLength=false, NvMBlockLengthCheck=true, NvMBlockLengthCheckType=true
        NvMTargetBlockReference
          NvMFeeRef: NvMNameOfFeeBlock=FeeDemPrimaryDataBlock0
      DemPrimaryDataBlock1: NvMInitBlockCallback=NULL_PTR, NvMSelectBlockForReadAll=true, NvMSelectBlockForWriteAll=true, NvMWriteRamBlockToNvCallback=NULL_PTR, NvMUseInitCallback=false, NvMSingleBlockCallback=Dem_NvM_JobFinished, NvMBlockUseCrc=false, NvMBlockUseSyncMechanism=false, NvMNvBlockLength=44, NvMNvramBlockIdentifier=46, NvMRamBlockDataAddress=Dem_Cfg_PrimaryEntry_1, NvMReadRamBlockFromNvCallback=NULL_PTR, NvMRomBlockDataAddress=Dem_Cfg_MemoryEntryInit, NvMUseServicePorts=false, NvMAutomaticBlockLength=false, NvMBlockLengthCheck=true, NvMBlockLengthCheckType=true
        NvMTargetBlockReference
          NvMFeeRef: NvMNameOfFeeBlock=FeeDemPrimaryDataBlock1
      DemPrimaryDataBlock2: NvMInitBlockCallback=NULL_PTR, NvMSelectBlockForReadAll=true, NvMSelectBlockForWriteAll=true, NvMWriteRamBlockToNvCallback=NULL_PTR, NvMUseInitCallback=false, NvMSingleBlockCallback=Dem_NvM_JobFinished, NvMBlockUseCrc=false, NvMBlockUseSyncMechanism=false, NvMNvBlockLength=44, NvMNvramBlockIdentifier=47, NvMRamBlockDataAddress=Dem_Cfg_PrimaryEntry_2, NvMReadRamBlockFromNvCallback=NULL_PTR, NvMRomBlockDataAddress=Dem_Cfg_MemoryEntryInit, NvMUseServicePorts=false, NvMAutomaticBlockLength=false, NvMBlockLengthCheck=true, NvMBlockLengthCheckType=true
        NvMTargetBlockReference
          NvMFeeRef: NvMNameOfFeeBlock=FeeDemPrimaryDataBlock2
      DemPrimaryDataBlock3: NvMInitBlockCallback=NULL_PTR, NvMSelectBlockForReadAll=true, NvMSelectBlockForWriteAll=true, NvMWriteRamBlockToNvCallback=NULL_PTR, NvMUseInitCallback=false, NvMSingleBlockCallback=Dem_NvM_JobFinished, NvMBlockUseCrc=false, NvMBlockUseSyncMechanism=false, NvMNvBlockLength=44, NvMNvramBlockIdentifier=48, NvMRamBlockDataAddress=Dem_Cfg_PrimaryEntry_3, NvMReadRamBlockFromNvCallback=NULL_PTR, NvMRomBlockDataAddress=Dem_Cfg_MemoryEntryInit, NvMUseServicePorts=false, NvMAutomaticBlockLength=false, NvMBlockLengthCheck=true, NvMBlockLengthCheckType=true
        NvMTargetBlockReference
          NvMFeeRef: NvMNameOfFeeBlock=FeeDemPrimaryDataBlock3
      DemPrimaryDataBlock4: NvMInitBlockCallback=NULL_PTR, NvMSelectBlockForReadAll=true, NvMSelectBlockForWriteAll=true, NvMWriteRamBlockToNvCallback=NULL_PTR, NvMUseInitCallback=false, NvMSingleBlockCallback=Dem_NvM_JobFinished, NvMBlockUseCrc=false, NvMBlockUseSyncMechanism=false, NvMNvBlockLength=44, NvMNvramBlockIdentifier=49, NvMRamBlockDataAddress=Dem_Cfg_PrimaryEntry_4, NvMReadRamBlockFromNvCallback=NULL_PTR, NvMRomBlockDataAddress=Dem_Cfg_MemoryEntryInit, NvMUseServicePorts=false, NvMAutomaticBlockLength=false, NvMBlockLengthCheck=true, NvMBlockLengthCheckType=true
        NvMTargetBlockReference
          NvMFeeRef: NvMNameOfFeeBlock=FeeDemPrimaryDataBlock4
      DemPrimaryDataBlock5: NvMInitBlockCallback=NULL_PTR, NvMSelectBlockForReadAll=true, NvMSelectBlockForWriteAll=true, NvMWriteRamBlockToNvCallback=NULL_PTR, NvMUseInitCallback=false, NvMSingleBlockCallback=Dem_NvM_JobFinished, NvMBlockUseCrc=false, NvMBlockUseSyncMechanism=false, NvMNvBlockLength=44, NvMNvramBlockIdentifier=50, NvMRamBlockDataAddress=Dem_Cfg_PrimaryEntry_5, NvMReadRamBlockFromNvCallback=NULL_PTR, NvMRomBlockDataAddress=Dem_Cfg_MemoryEntryInit, NvMUseServicePorts=false, NvMAutomaticBlockLength=false, NvMBlockLengthCheck=true, NvMBlockLengthCheckType=true
        NvMTargetBlockReference
          NvMFeeRef: NvMNameOfFeeBlock=FeeDemPrimaryDataBlock5
      DemPrimaryDataBlock6: NvMInitBlockCallback=NULL_PTR, NvMSelectBlockForReadAll=true, NvMSelectBlockForWriteAll=true, NvMWriteRamBlockToNvCallback=NULL_PTR, NvMUseInitCallback=false, NvMSingleBlockCallback=Dem_NvM_JobFinished, NvMBlockUseCrc=false, NvMBlockUseSyncMechanism=false, NvMNvBlockLength=44, NvMNvramBlockIdentifier=51, NvMRamBlockDataAddress=Dem_Cfg_PrimaryEntry_6, NvMReadRamBlockFromNvCallback=NULL_PTR, NvMRomBlockDataAddress=Dem_Cfg_MemoryEntryInit, NvMUseServicePorts=false, NvMAutomaticBlockLength=false, NvMBlockLengthCheck=true, NvMBlockLengthCheckType=true
        NvMTargetBlockReference
          NvMFeeRef: NvMNameOfFeeBlock=FeeDemPrimaryDataBlock6
      DemPrimaryDataBlock7: NvMInitBlockCallback=NULL_PTR, NvMSelectBlockForReadAll=true, NvMSelectBlockForWriteAll=true, NvMWriteRamBlockToNvCallback=NULL_PTR, NvMUseInitCallback=false, NvMSingleBlockCallback=Dem_NvM_JobFinished, NvMBlockUseCrc=false, NvMBlockUseSyncMechanism=false, NvMNvBlockLength=44, NvMNvramBlockIdentifier=52, NvMRamBlockDataAddress=Dem_Cfg_PrimaryEntry_7, NvMReadRamBlockFromNvCallback=NULL_PTR, NvMRomBlockDataAddress=Dem_Cfg_MemoryEntryInit, NvMUseServicePorts=false, NvMAutomaticBlockLength=false, NvMBlockLengthCheck=true, NvMBlockLengthCheckType=true
        NvMTargetBlockReference
          NvMFeeRef: NvMNameOfFeeBlock=FeeDemPrimaryDataBlock7
      DemPrimaryDataBlock8: NvMInitBlockCallback=NULL_PTR, NvMSelectBlockForReadAll=true, NvMSelectBlockForWriteAll=true, NvMWriteRamBlockToNvCallback=NULL_PTR, NvMUseInitCallback=false, NvMSingleBlockCallback=Dem_NvM_JobFinished, NvMBlockUseCrc=false, NvMBlockUseSyncMechanism=false, NvMNvBlockLength=44, NvMNvramBlockIdentifier=11, NvMRamBlockDataAddress=Dem_Cfg_PrimaryEntry_8, NvMReadRamBlockFromNvCallback=NULL_PTR, NvMRomBlockDataAddress=Dem_Cfg_MemoryEntryInit, NvMUseServicePorts=false, NvMAutomaticBlockLength=false, NvMBlockLengthCheck=true, NvMBlockLengthCheckType=true
        NvMTargetBlockReference
          NvMFeeRef: NvMNameOfFeeBlock=FeeDemPrimaryDataBlock8
      DemPrimaryDataBlock9: NvMInitBlockCallback=NULL_PTR, NvMSelectBlockForReadAll=true, NvMSelectBlockForWriteAll=true, NvMWriteRamBlockToNvCallback=NULL_PTR, NvMUseInitCallback=false, NvMSingleBlockCallback=Dem_NvM_JobFinished, NvMBlockUseCrc=false, NvMBlockUseSyncMechanism=false, NvMNvBlockLength=44, NvMNvramBlockIdentifier=12, NvMRamBlockDataAddress=Dem_Cfg_PrimaryEntry_9, NvMReadRamBlockFromNvCallback=NULL_PTR, NvMRomBlockDataAddress=Dem_Cfg_MemoryEntryInit, NvMUseServicePorts=false, NvMAutomaticBlockLength=false, NvMBlockLengthCheck=true, NvMBlockLengthCheckType=true
        NvMTargetBlockReference
          NvMFeeRef: NvMNameOfFeeBlock=FeeDemPrimaryDataBlock9
      DemPrimaryDataBlock10: NvMInitBlockCallback=NULL_PTR, NvMSelectBlockForReadAll=true, NvMSelectBlockForWriteAll=true, NvMWriteRamBlockToNvCallback=NULL_PTR, NvMUseInitCallback=false, NvMSingleBlockCallback=Dem_NvM_JobFinished, NvMBlockUseCrc=false, NvMBlockUseSyncMechanism=false, NvMNvBlockLength=44, NvMNvramBlockIdentifier=13, NvMRamBlockDataAddress=Dem_Cfg_PrimaryEntry_10, NvMReadRamBlockFromNvCallback=NULL_PTR, NvMRomBlockDataAddress=Dem_Cfg_MemoryEntryInit, NvMUseServicePorts=false, NvMAutomaticBlockLength=false, NvMBlockLengthCheck=true, NvMBlockLengthCheckType=true
        NvMTargetBlockReference
          NvMFeeRef: NvMNameOfFeeBlock=FeeDemPrimaryDataBlock10
      DemPrimaryDataBlock11: NvMInitBlockCallback=NULL_PTR, NvMSelectBlockForReadAll=true, NvMSelectBlockForWriteAll=true, NvMWriteRamBlockToNvCallback=NULL_PTR, NvMUseInitCallback=false, NvMSingleBlockCallback=Dem_NvM_JobFinished, NvMBlockUseCrc=false, NvMBlockUseSyncMechanism=false, NvMNvBlockLength=44, NvMNvramBlockIdentifier=14, NvMRamBlockDataAddress=Dem_Cfg_PrimaryEntry_11, NvMReadRamBlockFromNvCallback=NULL_PTR, NvMRomBlockDataAddress=Dem_Cfg_MemoryEntryInit, NvMUseServicePorts=false, NvMAutomaticBlockLength=false, NvMBlockLengthCheck=true, NvMBlockLengthCheckType=true
        NvMTargetBlockReference
          NvMFeeRef: NvMNameOfFeeBlock=FeeDemPrimaryDataBlock11
      DemPrimaryDataBlock12: NvMInitBlockCallback=NULL_PTR, NvMSelectBlockForReadAll=true, NvMSelectBlockForWriteAll=true, NvMWriteRamBlockToNvCallback=NULL_PTR, NvMUseInitCallback=false, NvMSingleBlockCallback=Dem_NvM_JobFinished, NvMBlockUseCrc=false, NvMBlockUseSyncMechanism=false, NvMNvBlockLength=44, NvMNvramBlockIdentifier=15, NvMRamBlockDataAddress=Dem_Cfg_PrimaryEntry_12, NvMReadRamBlockFromNvCallback=NULL_PTR, NvMRomBlockDataAddress=Dem_Cfg_MemoryEntryInit, NvMUseServicePorts=false, NvMAutomaticBlockLength=false, NvMBlockLengthCheck=true, NvMBlockLengthCheckType=true
        NvMTargetBlockReference
          NvMFeeRef: NvMNameOfFeeBlock=FeeDemPrimaryDataBlock12
      DemPrimaryDataBlock13: NvMInitBlockCallback=NULL_PTR, NvMSelectBlockForReadAll=true, NvMSelectBlockForWriteAll=true, NvMWriteRamBlockToNvCallback=NULL_PTR, NvMUseInitCallback=false, NvMSingleBlockCallback=Dem_NvM_JobFinished, NvMBlockUseCrc=false, NvMBlockUseSyncMechanism=false, NvMNvBlockLength=44, NvMNvramBlockIdentifier=16, NvMRamBlockDataAddress=Dem_Cfg_PrimaryEntry_13, NvMReadRamBlockFromNvCallback=NULL_PTR, NvMRomBlockDataAddress=Dem_Cfg_MemoryEntryInit, NvMUseServicePorts=false, NvMAutomaticBlockLength=false, NvMBlockLengthCheck=true, NvMBlockLengthCheckType=true
        NvMTargetBlockReference
          NvMFeeRef: NvMNameOfFeeBlock=FeeDemPrimaryDataBlock13
      DemPrimaryDataBlock14: NvMInitBlockCallback=NULL_PTR, NvMSelectBlockForReadAll=true, NvMSelectBlockForWriteAll=true, NvMWriteRamBlockToNvCallback=NULL_PTR, NvMUseInitCallback=false, NvMSingleBlockCallback=Dem_NvM_JobFinished, NvMBlockUseCrc=false, NvMBlockUseSyncMechanism=false, NvMNvBlockLength=44, NvMNvramBlockIdentifier=17, NvMRamBlockDataAddress=Dem_Cfg_PrimaryEntry_14, NvMReadRamBlockFromNvCallback=NULL_PTR, NvMRomBlockDataAddress=Dem_Cfg_MemoryEntryInit, NvMUseServicePorts=false, NvMAutomaticBlockLength=false, NvMBlockLengthCheck=true, NvMBlockLengthCheckType=true
        NvMTargetBlockReference
          NvMFeeRef: NvMNameOfFeeBlock=FeeDemPrimaryDataBlock14
      DemPrimaryDataBlock15: NvMInitBlockCallback=NULL_PTR, NvMSelectBlockForReadAll=true, NvMSelectBlockForWriteAll=true, NvMWriteRamBlockToNvCallback=NULL_PTR, NvMUseInitCallback=false, NvMSingleBlockCallback=Dem_NvM_JobFinished, NvMBlockUseCrc=false, NvMBlockUseSyncMechanism=false, NvMNvBlockLength=44, NvMNvramBlockIdentifier=18, NvMRamBlockDataAddress=Dem_Cfg_PrimaryEntry_15, NvMReadRamBlockFromNvCallback=NULL_PTR, NvMRomBlockDataAddress=Dem_Cfg_MemoryEntryInit, NvMUseServicePorts=false, NvMAutomaticBlockLength=false, NvMBlockLengthCheck=true, NvMBlockLengthCheckType=true
        NvMTargetBlockReference
          NvMFeeRef: NvMNameOfFeeBlock=FeeDemPrimaryDataBlock15
      DemPrimaryDataBlock16: NvMInitBlockCallback=NULL_PTR, NvMSelectBlockForReadAll=true, NvMSelectBlockForWriteAll=true, NvMWriteRamBlockToNvCallback=NULL_PTR, NvMUseInitCallback=false, NvMSingleBlockCallback=Dem_NvM_JobFinished, NvMBlockUseCrc=false, NvMBlockUseSyncMechanism=false, NvMNvBlockLength=44, NvMNvramBlockIdentifier=19, NvMRamBlockDataAddress=Dem_Cfg_PrimaryEntry_16, NvMReadRamBlockFromNvCallback=NULL_PTR, NvMRomBlockDataAddress=Dem_Cfg_MemoryEntryInit, NvMUseServicePorts=false, NvMAutomaticBlockLength=false, NvMBlockLengthCheck=true, NvMBlockLengthCheckType=true
        NvMTargetBlockReference
          NvMFeeRef: NvMNameOfFeeBlock=FeeDemPrimaryDataBlock16
      DemPrimaryDataBlock17: NvMInitBlockCallback=NULL_PTR, NvMSelectBlockForReadAll=true, NvMSelectBlockForWriteAll=true, NvMWriteRamBlockToNvCallback=NULL_PTR, NvMUseInitCallback=false, NvMSingleBlockCallback=Dem_NvM_JobFinished, NvMBlockUseCrc=false, NvMBlockUseSyncMechanism=false, NvMNvBlockLength=44, NvMNvramBlockIdentifier=20, NvMRamBlockDataAddress=Dem_Cfg_PrimaryEntry_17, NvMReadRamBlockFromNvCallback=NULL_PTR, NvMRomBlockDataAddress=Dem_Cfg_MemoryEntryInit, NvMUseServicePorts=false, NvMAutomaticBlockLength=false, NvMBlockLengthCheck=true, NvMBlockLengthCheckType=true
        NvMTargetBlockReference
          NvMFeeRef: NvMNameOfFeeBlock=FeeDemPrimaryDataBlock17
      DemPrimaryDataBlock18: NvMInitBlockCallback=NULL_PTR, NvMSelectBlockForReadAll=true, NvMSelectBlockForWriteAll=true, NvMWriteRamBlockToNvCallback=NULL_PTR, NvMUseInitCallback=false, NvMSingleBlockCallback=Dem_NvM_JobFinished, NvMBlockUseCrc=false, NvMBlockUseSyncMechanism=false, NvMNvBlockLength=44, NvMNvramBlockIdentifier=21, NvMRamBlockDataAddress=Dem_Cfg_PrimaryEntry_18, NvMReadRamBlockFromNvCallback=NULL_PTR, NvMRomBlockDataAddress=Dem_Cfg_MemoryEntryInit, NvMUseServicePorts=false, NvMAutomaticBlockLength=false, NvMBlockLengthCheck=true, NvMBlockLengthCheckType=true
        NvMTargetBlockReference
          NvMFeeRef: NvMNameOfFeeBlock=FeeDemPrimaryDataBlock18
      DemPrimaryDataBlock19: NvMInitBlockCallback=NULL_PTR, NvMSelectBlockForReadAll=true, NvMSelectBlockForWriteAll=true, NvMWriteRamBlockToNvCallback=NULL_PTR, NvMUseInitCallback=false, NvMSingleBlockCallback=Dem_NvM_JobFinished, NvMBlockUseCrc=false, NvMBlockUseSyncMechanism=false, NvMNvBlockLength=44, NvMNvramBlockIdentifier=22, NvMRamBlockDataAddress=Dem_Cfg_PrimaryEntry_19, NvMReadRamBlockFromNvCallback=NULL_PTR, NvMRomBlockDataAddress=Dem_Cfg_MemoryEntryInit, NvMUseServicePorts=false, NvMAutomaticBlockLength=false, NvMBlockLengthCheck=true, NvMBlockLengthCheckType=true
        NvMTargetBlockReference
          NvMFeeRef: NvMNameOfFeeBlock=FeeDemPrimaryDataBlock19
      DemPrimaryDataBlock20: NvMInitBlockCallback=NULL_PTR, NvMSelectBlockForReadAll=true, NvMSelectBlockForWriteAll=true, NvMWriteRamBlockToNvCallback=NULL_PTR, NvMUseInitCallback=false, NvMSingleBlockCallback=Dem_NvM_JobFinished, NvMBlockUseCrc=false, NvMBlockUseSyncMechanism=false, NvMNvBlockLength=44, NvMNvramBlockIdentifier=23, NvMRamBlockDataAddress=Dem_Cfg_PrimaryEntry_20, NvMReadRamBlockFromNvCallback=NULL_PTR, NvMRomBlockDataAddress=Dem_Cfg_MemoryEntryInit, NvMUseServicePorts=false, NvMAutomaticBlockLength=false, NvMBlockLengthCheck=true, NvMBlockLengthCheckType=true
        NvMTargetBlockReference
          NvMFeeRef: NvMNameOfFeeBlock=FeeDemPrimaryDataBlock20
      DemPrimaryDataBlock21: NvMInitBlockCallback=NULL_PTR, NvMSelectBlockForReadAll=true, NvMSelectBlockForWriteAll=true, NvMWriteRamBlockToNvCallback=NULL_PTR, NvMUseInitCallback=false, NvMSingleBlockCallback=Dem_NvM_JobFinished, NvMBlockUseCrc=false, NvMBlockUseSyncMechanism=false, NvMNvBlockLength=44, NvMNvramBlockIdentifier=24, NvMRamBlockDataAddress=Dem_Cfg_PrimaryEntry_21, NvMReadRamBlockFromNvCallback=NULL_PTR, NvMRomBlockDataAddress=Dem_Cfg_MemoryEntryInit, NvMUseServicePorts=false, NvMAutomaticBlockLength=false, NvMBlockLengthCheck=true, NvMBlockLengthCheckType=true
        NvMTargetBlockReference
          NvMFeeRef: NvMNameOfFeeBlock=FeeDemPrimaryDataBlock21
      DemPrimaryDataBlock22: NvMInitBlockCallback=NULL_PTR, NvMSelectBlockForReadAll=true, NvMSelectBlockForWriteAll=true, NvMWriteRamBlockToNvCallback=NULL_PTR, NvMUseInitCallback=false, NvMSingleBlockCallback=Dem_NvM_JobFinished, NvMBlockUseCrc=false, NvMBlockUseSyncMechanism=false, NvMNvBlockLength=44, NvMNvramBlockIdentifier=25, NvMRamBlockDataAddress=Dem_Cfg_PrimaryEntry_22, NvMReadRamBlockFromNvCallback=NULL_PTR, NvMRomBlockDataAddress=Dem_Cfg_MemoryEntryInit, NvMUseServicePorts=false, NvMAutomaticBlockLength=false, NvMBlockLengthCheck=true, NvMBlockLengthCheckType=true
        NvMTargetBlockReference
          NvMFeeRef: NvMNameOfFeeBlock=FeeDemPrimaryDataBlock22
      DemPrimaryDataBlock23: NvMInitBlockCallback=NULL_PTR, NvMSelectBlockForReadAll=true, NvMSelectBlockForWriteAll=true, NvMWriteRamBlockToNvCallback=NULL_PTR, NvMUseInitCallback=false, NvMSingleBlockCallback=Dem_NvM_JobFinished, NvMBlockUseCrc=false, NvMBlockUseSyncMechanism=false, NvMNvBlockLength=44, NvMNvramBlockIdentifier=26, NvMRamBlockDataAddress=Dem_Cfg_PrimaryEntry_23, NvMReadRamBlockFromNvCallback=NULL_PTR, NvMRomBlockDataAddress=Dem_Cfg_MemoryEntryInit, NvMUseServicePorts=false, NvMAutomaticBlockLength=false, NvMBlockLengthCheck=true, NvMBlockLengthCheckType=true
        NvMTargetBlockReference
          NvMFeeRef: NvMNameOfFeeBlock=FeeDemPrimaryDataBlock23
      DemPrimaryDataBlock24: NvMInitBlockCallback=NULL_PTR, NvMSelectBlockForReadAll=true, NvMSelectBlockForWriteAll=true, NvMWriteRamBlockToNvCallback=NULL_PTR, NvMUseInitCallback=false, NvMSingleBlockCallback=Dem_NvM_JobFinished, NvMBlockUseCrc=false, NvMBlockUseSyncMechanism=false, NvMNvBlockLength=44, NvMNvramBlockIdentifier=27, NvMRamBlockDataAddress=Dem_Cfg_PrimaryEntry_24, NvMReadRamBlockFromNvCallback=NULL_PTR, NvMRomBlockDataAddress=Dem_Cfg_MemoryEntryInit, NvMUseServicePorts=false, NvMAutomaticBlockLength=false, NvMBlockLengthCheck=true, NvMBlockLengthCheckType=true
        NvMTargetBlockReference
          NvMFeeRef: NvMNameOfFeeBlock=FeeDemPrimaryDataBlock24
      DemPrimaryDataBlock25: NvMInitBlockCallback=NULL_PTR, NvMSelectBlockForReadAll=true, NvMSelectBlockForWriteAll=true, NvMWriteRamBlockToNvCallback=NULL_PTR, NvMUseInitCallback=false, NvMSingleBlockCallback=Dem_NvM_JobFinished, NvMBlockUseCrc=false, NvMBlockUseSyncMechanism=false, NvMNvBlockLength=44, NvMNvramBlockIdentifier=28, NvMRamBlockDataAddress=Dem_Cfg_PrimaryEntry_25, NvMReadRamBlockFromNvCallback=NULL_PTR, NvMRomBlockDataAddress=Dem_Cfg_MemoryEntryInit, NvMUseServicePorts=false, NvMAutomaticBlockLength=false, NvMBlockLengthCheck=true, NvMBlockLengthCheckType=true
        NvMTargetBlockReference
          NvMFeeRef: NvMNameOfFeeBlock=FeeDemPrimaryDataBlock25
      DemPrimaryDataBlock26: NvMInitBlockCallback=NULL_PTR, NvMSelectBlockForReadAll=true, NvMSelectBlockForWriteAll=true, NvMWriteRamBlockToNvCallback=NULL_PTR, NvMUseInitCallback=false, NvMSingleBlockCallback=Dem_NvM_JobFinished, NvMBlockUseCrc=false, NvMBlockUseSyncMechanism=false, NvMNvBlockLength=44, NvMNvramBlockIdentifier=29, NvMRamBlockDataAddress=Dem_Cfg_PrimaryEntry_26, NvMReadRamBlockFromNvCallback=NULL_PTR, NvMRomBlockDataAddress=Dem_Cfg_MemoryEntryInit, NvMUseServicePorts=false, NvMAutomaticBlockLength=false, NvMBlockLengthCheck=true, NvMBlockLengthCheckType=true
        NvMTargetBlockReference
          NvMFeeRef: NvMNameOfFeeBlock=FeeDemPrimaryDataBlock26
      DemPrimaryDataBlock27: NvMInitBlockCallback=NULL_PTR, NvMSelectBlockForReadAll=true, NvMSelectBlockForWriteAll=true, NvMWriteRamBlockToNvCallback=NULL_PTR, NvMUseInitCallback=false, NvMSingleBlockCallback=Dem_NvM_JobFinished, NvMBlockUseCrc=false, NvMBlockUseSyncMechanism=false, NvMNvBlockLength=44, NvMNvramBlockIdentifier=30, NvMRamBlockDataAddress=Dem_Cfg_PrimaryEntry_27, NvMReadRamBlockFromNvCallback=NULL_PTR, NvMRomBlockDataAddress=Dem_Cfg_MemoryEntryInit, NvMUseServicePorts=false, NvMAutomaticBlockLength=false, NvMBlockLengthCheck=true, NvMBlockLengthCheckType=true
        NvMTargetBlockReference
          NvMFeeRef: NvMNameOfFeeBlock=FeeDemPrimaryDataBlock27
      DemPrimaryDataBlock28: NvMInitBlockCallback=NULL_PTR, NvMSelectBlockForReadAll=true, NvMSelectBlockForWriteAll=true, NvMWriteRamBlockToNvCallback=NULL_PTR, NvMUseInitCallback=false, NvMSingleBlockCallback=Dem_NvM_JobFinished, NvMBlockUseCrc=false, NvMBlockUseSyncMechanism=false, NvMNvBlockLength=44, NvMNvramBlockIdentifier=31, NvMRamBlockDataAddress=Dem_Cfg_PrimaryEntry_28, NvMReadRamBlockFromNvCallback=NULL_PTR, NvMRomBlockDataAddress=Dem_Cfg_MemoryEntryInit, NvMUseServicePorts=false, NvMAutomaticBlockLength=false, NvMBlockLengthCheck=true, NvMBlockLengthCheckType=true
        NvMTargetBlockReference
          NvMFeeRef: NvMNameOfFeeBlock=FeeDemPrimaryDataBlock28
      DemPrimaryDataBlock29: NvMInitBlockCallback=NULL_PTR, NvMSelectBlockForReadAll=true, NvMSelectBlockForWriteAll=true, NvMWriteRamBlockToNvCallback=NULL_PTR, NvMUseInitCallback=false, NvMSingleBlockCallback=Dem_NvM_JobFinished, NvMBlockUseCrc=false, NvMBlockUseSyncMechanism=false, NvMNvBlockLength=44, NvMNvramBlockIdentifier=32, NvMRamBlockDataAddress=Dem_Cfg_PrimaryEntry_29, NvMReadRamBlockFromNvCallback=NULL_PTR, NvMRomBlockDataAddress=Dem_Cfg_MemoryEntryInit, NvMUseServicePorts=false, NvMAutomaticBlockLength=false, NvMBlockLengthCheck=true, NvMBlockLengthCheckType=true
        NvMTargetBlockReference
          NvMFeeRef: NvMNameOfFeeBlock=FeeDemPrimaryDataBlock29
      DemPrimaryDataBlock30: NvMInitBlockCallback=NULL_PTR, NvMSelectBlockForReadAll=true, NvMSelectBlockForWriteAll=true, NvMWriteRamBlockToNvCallback=NULL_PTR, NvMUseInitCallback=false, NvMSingleBlockCallback=Dem_NvM_JobFinished, NvMBlockUseCrc=false, NvMBlockUseSyncMechanism=false, NvMNvBlockLength=44, NvMNvramBlockIdentifier=33, NvMRamBlockDataAddress=Dem_Cfg_PrimaryEntry_30, NvMReadRamBlockFromNvCallback=NULL_PTR, NvMRomBlockDataAddress=Dem_Cfg_MemoryEntryInit, NvMUseServicePorts=false, NvMAutomaticBlockLength=false, NvMBlockLengthCheck=true, NvMBlockLengthCheckType=true
        NvMTargetBlockReference
          NvMFeeRef: NvMNameOfFeeBlock=FeeDemPrimaryDataBlock30
      DemPrimaryDataBlock31: NvMInitBlockCallback=NULL_PTR, NvMSelectBlockForReadAll=true, NvMSelectBlockForWriteAll=true, NvMWriteRamBlockToNvCallback=NULL_PTR, NvMUseInitCallback=false, NvMSingleBlockCallback=Dem_NvM_JobFinished, NvMBlockUseCrc=false, NvMBlockUseSyncMechanism=false, NvMNvBlockLength=44, NvMNvramBlockIdentifier=34, NvMRamBlockDataAddress=Dem_Cfg_PrimaryEntry_31, NvMReadRamBlockFromNvCallback=NULL_PTR, NvMRomBlockDataAddress=Dem_Cfg_MemoryEntryInit, NvMUseServicePorts=false, NvMAutomaticBlockLength=false, NvMBlockLengthCheck=true, NvMBlockLengthCheckType=true
        NvMTargetBlockReference
          NvMFeeRef: NvMNameOfFeeBlock=FeeDemPrimaryDataBlock31
      DemPrimaryDataBlock32: NvMInitBlockCallback=NULL_PTR, NvMSelectBlockForReadAll=true, NvMSelectBlockForWriteAll=true, NvMWriteRamBlockToNvCallback=NULL_PTR, NvMUseInitCallback=false, NvMSingleBlockCallback=Dem_NvM_JobFinished, NvMBlockUseCrc=false, NvMBlockUseSyncMechanism=false, NvMNvBlockLength=44, NvMNvramBlockIdentifier=35, NvMRamBlockDataAddress=Dem_Cfg_PrimaryEntry_32, NvMReadRamBlockFromNvCallback=NULL_PTR, NvMRomBlockDataAddress=Dem_Cfg_MemoryEntryInit, NvMUseServicePorts=false, NvMAutomaticBlockLength=false, NvMBlockLengthCheck=true, NvMBlockLengthCheckType=true
        NvMTargetBlockReference
          NvMFeeRef: NvMNameOfFeeBlock=FeeDemPrimaryDataBlock32
      DemPrimaryDataBlock33: NvMInitBlockCallback=NULL_PTR, NvMSelectBlockForReadAll=true, NvMSelectBlockForWriteAll=true, NvMWriteRamBlockToNvCallback=NULL_PTR, NvMUseInitCallback=false, NvMSingleBlockCallback=Dem_NvM_JobFinished, NvMBlockUseCrc=false, NvMBlockUseSyncMechanism=false, NvMNvBlockLength=44, NvMNvramBlockIdentifier=36, NvMRamBlockDataAddress=Dem_Cfg_PrimaryEntry_33, NvMReadRamBlockFromNvCallback=NULL_PTR, NvMRomBlockDataAddress=Dem_Cfg_MemoryEntryInit, NvMUseServicePorts=false, NvMAutomaticBlockLength=false, NvMBlockLengthCheck=true, NvMBlockLengthCheckType=true
        NvMTargetBlockReference
          NvMFeeRef: NvMNameOfFeeBlock=FeeDemPrimaryDataBlock33
      DemPrimaryDataBlock34: NvMInitBlockCallback=NULL_PTR, NvMSelectBlockForReadAll=true, NvMSelectBlockForWriteAll=true, NvMWriteRamBlockToNvCallback=NULL_PTR, NvMUseInitCallback=false, NvMSingleBlockCallback=Dem_NvM_JobFinished, NvMBlockUseCrc=false, NvMBlockUseSyncMechanism=false, NvMNvBlockLength=44, NvMNvramBlockIdentifier=37, NvMRamBlockDataAddress=Dem_Cfg_PrimaryEntry_34, NvMReadRamBlockFromNvCallback=NULL_PTR, NvMRomBlockDataAddress=Dem_Cfg_MemoryEntryInit, NvMUseServicePorts=false, NvMAutomaticBlockLength=false, NvMBlockLengthCheck=true, NvMBlockLengthCheckType=true
        NvMTargetBlockReference
          NvMFeeRef: NvMNameOfFeeBlock=FeeDemPrimaryDataBlock34
      DemPrimaryDataBlock35: NvMInitBlockCallback=NULL_PTR, NvMSelectBlockForReadAll=true, NvMSelectBlockForWriteAll=true, NvMWriteRamBlockToNvCallback=NULL_PTR, NvMUseInitCallback=false, NvMSingleBlockCallback=Dem_NvM_JobFinished, NvMBlockUseCrc=false, NvMBlockUseSyncMechanism=false, NvMNvBlockLength=44, NvMNvramBlockIdentifier=38, NvMRamBlockDataAddress=Dem_Cfg_PrimaryEntry_35, NvMReadRamBlockFromNvCallback=NULL_PTR, NvMRomBlockDataAddress=Dem_Cfg_MemoryEntryInit, NvMUseServicePorts=false, NvMAutomaticBlockLength=false, NvMBlockLengthCheck=true, NvMBlockLengthCheckType=true
        NvMTargetBlockReference
          NvMFeeRef: NvMNameOfFeeBlock=FeeDemPrimaryDataBlock35
      DemPrimaryDataBlock36: NvMInitBlockCallback=NULL_PTR, NvMSelectBlockForReadAll=true, NvMSelectBlockForWriteAll=true, NvMWriteRamBlockToNvCallback=NULL_PTR, NvMUseInitCallback=false, NvMSingleBlockCallback=Dem_NvM_JobFinished, NvMBlockUseCrc=false, NvMBlockUseSyncMechanism=false, NvMNvBlockLength=44, NvMNvramBlockIdentifier=39, NvMRamBlockDataAddress=Dem_Cfg_PrimaryEntry_36, NvMReadRamBlockFromNvCallback=NULL_PTR, NvMRomBlockDataAddress=Dem_Cfg_MemoryEntryInit, NvMUseServicePorts=false, NvMAutomaticBlockLength=false, NvMBlockLengthCheck=true, NvMBlockLengthCheckType=true
        NvMTargetBlockReference
          NvMFeeRef: NvMNameOfFeeBlock=FeeDemPrimaryDataBlock36
      DemPrimaryDataBlock37: NvMInitBlockCallback=NULL_PTR, NvMSelectBlockForReadAll=true, NvMSelectBlockForWriteAll=true, NvMWriteRamBlockToNvCallback=NULL_PTR, NvMUseInitCallback=false, NvMSingleBlockCallback=Dem_NvM_JobFinished, NvMBlockUseCrc=false, NvMBlockUseSyncMechanism=false, NvMNvBlockLength=44, NvMNvramBlockIdentifier=40, NvMRamBlockDataAddress=Dem_Cfg_PrimaryEntry_37, NvMReadRamBlockFromNvCallback=NULL_PTR, NvMRomBlockDataAddress=Dem_Cfg_MemoryEntryInit, NvMUseServicePorts=false, NvMAutomaticBlockLength=false, NvMBlockLengthCheck=true, NvMBlockLengthCheckType=true
        NvMTargetBlockReference
          NvMFeeRef: NvMNameOfFeeBlock=FeeDemPrimaryDataBlock37
      DemPrimaryDataBlock38: NvMInitBlockCallback=NULL_PTR, NvMSelectBlockForReadAll=true, NvMSelectBlockForWriteAll=true, NvMWriteRamBlockToNvCallback=NULL_PTR, NvMUseInitCallback=false, NvMSingleBlockCallback=Dem_NvM_JobFinished, NvMBlockUseCrc=false, NvMBlockUseSyncMechanism=false, NvMNvBlockLength=44, NvMNvramBlockIdentifier=41, NvMRamBlockDataAddress=Dem_Cfg_PrimaryEntry_38, NvMReadRamBlockFromNvCallback=NULL_PTR, NvMRomBlockDataAddress=Dem_Cfg_MemoryEntryInit, NvMUseServicePorts=false, NvMAutomaticBlockLength=false, NvMBlockLengthCheck=true, NvMBlockLengthCheckType=true
        NvMTargetBlockReference
          NvMFeeRef: NvMNameOfFeeBlock=FeeDemPrimaryDataBlock38
      DemPrimaryDataBlock39: NvMInitBlockCallback=NULL_PTR, NvMSelectBlockForReadAll=true, NvMSelectBlockForWriteAll=true, NvMWriteRamBlockToNvCallback=NULL_PTR, NvMUseInitCallback=false, NvMSingleBlockCallback=Dem_NvM_JobFinished, NvMBlockUseCrc=false, NvMBlockUseSyncMechanism=false, NvMNvBlockLength=44, NvMNvramBlockIdentifier=42, NvMRamBlockDataAddress=Dem_Cfg_PrimaryEntry_39, NvMReadRamBlockFromNvCallback=NULL_PTR, NvMRomBlockDataAddress=Dem_Cfg_MemoryEntryInit, NvMUseServicePorts=false, NvMAutomaticBlockLength=false, NvMBlockLengthCheck=true, NvMBlockLengthCheckType=true
        NvMTargetBlockReference
          NvMFeeRef: NvMNameOfFeeBlock=FeeDemPrimaryDataBlock39
      Rte_NvmBlock_CustDiagc_GmIgnCntr: NvMInitBlockCallback=NULL_PTR, NvMSelectBlockForReadAll=true, NvMSelectBlockForWriteAll=true, NvMWriteRamBlockToNvCallback=NULL_PTR, NvMUseInitCallback=false, NvMSingleBlockCallback=NULL_PTR, NvMBlockUseCrc=true, NvMBlockUseSyncMechanism=false, NvMNvBlockLength=2, NvMNvramBlockIdentifier=10, NvMRamBlockDataAddress=Rte_CustDiagc_GmIgnCntr, NvMReadRamBlockFromNvCallback=NULL_PTR, NvMRomBlockDataAddress=NULL_PTR, NvMUseServicePorts=false, NvMAutomaticBlockLength=false, NvMBlockLengthCheck=true, NvMBlockLengthCheckType=true
        NvMTargetBlockReference
          NvMFeeRef: NvMNameOfFeeBlock=FeeRte_NvmBlock_CustDiagc_GmIgnCntr
      Rte_NvmBlock_GmMsg778BusHiSpd_DtcTrigStsAry: NvMInitBlockCallback=NULL_PTR, NvMSelectBlockForReadAll=true, NvMSelectBlockForWriteAll=true, NvMWriteRamBlockToNvCallback=NULL_PTR, NvMUseInitCallback=false, NvMSingleBlockCallback=NULL_PTR, NvMBlockUseCrc=true, NvMBlockUseSyncMechanism=false, NvMNvBlockLength=40, NvMNvramBlockIdentifier=9, NvMRamBlockDataAddress=Rte_GmMsg778BusHiSpd_DtcTrigStsAry, NvMReadRamBlockFromNvCallback=NULL_PTR, NvMRomBlockDataAddress=NULL_PTR, NvMUseServicePorts=false, NvMAutomaticBlockLength=false, NvMBlockLengthCheck=true, NvMBlockLengthCheckType=true
        NvMTargetBlockReference
          NvMFeeRef: NvMNameOfFeeBlock=FeeRte_NvmBlock_GmMsg778BusHiSpd_DtcTrigStsAry
      SnpshtDataAry: NvMInitBlockCallback=NULL_PTR, NvMSelectBlockForReadAll=true, NvMSelectBlockForWriteAll=true, NvMWriteRamBlockToNvCallback=NULL_PTR, NvMUseInitCallback=false, NvMSingleBlockCallback=NULL_PTR, NvMBlockUseCrc=true, NvMBlockUseSyncMechanism=false, NvMNvBlockLength=192, NvMNvramBlockIdentifier=8, NvMRamBlockDataAddress=SnpshtDataAry_M, NvMReadRamBlockFromNvCallback=NULL_PTR, NvMRomBlockDataAddress=NULL_PTR, NvMUseServicePorts=false, NvMAutomaticBlockLength=false, NvMBlockLengthCheck=true, NvMBlockLengthCheckType=true
        NvMTargetBlockReference
          NvMFeeRef: NvMNameOfFeeBlock=FeeSnpshtDataAry
      Rte_NvmBlock_HwAgSnsrls_StordLstPrm: NvMInitBlockCallback=NULL_PTR, NvMSelectBlockForReadAll=true, NvMSelectBlockForWriteAll=true, NvMWriteRamBlockToNvCallback=NULL_PTR, NvMUseInitCallback=false, NvMSingleBlockCallback=NULL_PTR, NvMBlockUseCrc=true, NvMBlockUseSyncMechanism=false, NvMNvBlockLength=8, NvMNvramBlockIdentifier=7, NvMRamBlockDataAddress=Rte_HwAgSnsrls_StordLstPrm, NvMReadRamBlockFromNvCallback=NULL_PTR, NvMRomBlockDataAddress=Rte_CalprmRom_HwAgSnsrls_DEFAULT_RTE_CDATA_GROUP.StordLstPrmDft, NvMUseServicePorts=false, NvMAutomaticBlockLength=false, NvMBlockLengthCheck=true, NvMBlockLengthCheckType=true
        NvMTargetBlockReference
          NvMFeeRef: NvMNameOfFeeBlock=FeeRte_NvmBlock_HwAgSnsrls_StordLstPrm
      Rte_NvmBlock_EotLrng_MaxHwAgCwAndCcw_Deprecated: NvMInitBlockCallback=NULL_PTR, NvMSelectBlockForReadAll=false, NvMSelectBlockForWriteAll=false, NvMWriteRamBlockToNvCallback=NULL_PTR, NvMUseInitCallback=false, NvMSingleBlockCallback=NULL_PTR, NvMBlockUseCrc=true, NvMBlockUseSyncMechanism=false, NvMNvBlockLength=8, NvMNvramBlockIdentifier=6, NvMRamBlockDataAddress=NULL_PTR, NvMReadRamBlockFromNvCallback=NULL_PTR, NvMRomBlockDataAddress=NULL_PTR, NvMUseServicePorts=false, NvMAutomaticBlockLength=false, NvMBlockLengthCheck=false, NvMBlockLengthCheckType=true
        NvMTargetBlockReference
          NvMFeeRef: NvMNameOfFeeBlock=FeeRte_NvmBlock_EotLrng_MaxHwAgCwAndCcw_Deprecated
      Rte_NvmBlock_CmnMfgSrv_SeedKey: NvMInitBlockCallback=NULL_PTR, NvMSelectBlockForReadAll=true, NvMSelectBlockForWriteAll=true, NvMWriteRamBlockToNvCallback=NULL_PTR, NvMUseInitCallback=false, NvMSingleBlockCallback=NULL_PTR, NvMBlockUseCrc=true, NvMBlockUseSyncMechanism=false, NvMNvBlockLength=8, NvMNvramBlockIdentifier=5, NvMRamBlockDataAddress=Rte_CmnMfgSrv_SeedKey, NvMReadRamBlockFromNvCallback=NULL_PTR, NvMRomBlockDataAddress=Rte_CalprmRom_CmnMfgSrv_DEFAULT_RTE_CDATA_GROUP.SeedKeyDft, NvMUseServicePorts=false, NvMAutomaticBlockLength=false, NvMBlockLengthCheck=true, NvMBlockLengthCheckType=true
        NvMTargetBlockReference
          NvMFeeRef: NvMNameOfFeeBlock=FeeRte_NvmBlock_CmnMfgSrv_SeedKey
      Rte_NvmBlock_EotLrng_MaxHwAgCwAndCcw: NvMInitBlockCallback=NULL_PTR, NvMSelectBlockForReadAll=true, NvMSelectBlockForWriteAll=true, NvMWriteRamBlockToNvCallback=NULL_PTR, NvMUseInitCallback=false, NvMSingleBlockCallback=NULL_PTR, NvMBlockUseCrc=true, NvMBlockUseSyncMechanism=false, NvMNvBlockLength=12, NvMNvramBlockIdentifier=4, NvMRamBlockDataAddress=Rte_EotLrng_MaxHwAgCwAndCcw, NvMReadRamBlockFromNvCallback=NULL_PTR, NvMRomBlockDataAddress=NULL_PTR, NvMUseServicePorts=false, NvMAutomaticBlockLength=false, NvMBlockLengthCheck=true, NvMBlockLengthCheckType=true
        NvMTargetBlockReference
          NvMFeeRef: NvMNameOfFeeBlock=FeeRte_NvmBlock_EotLrng_MaxHwAgCwAndCcw
      Rte_NvmBlock_WhlImbRejctn_CmpPeakData: NvMInitBlockCallback=NULL_PTR, NvMSelectBlockForReadAll=true, NvMSelectBlockForWriteAll=true, NvMWriteRamBlockToNvCallback=NULL_PTR, NvMUseInitCallback=false, NvMSingleBlockCallback=NULL_PTR, NvMBlockUseCrc=true, NvMBlockUseSyncMechanism=false, NvMNvBlockLength=24, NvMNvramBlockIdentifier=3, NvMUseServicePorts=false, NvMRamBlockDataAddress=Rte_WhlImbRejctn_CmpPeakData, NvMRomBlockDataAddress=NULL_PTR
        NvMTargetBlockReference
          NvMFeeRef: NvMNameOfFeeBlock=FeeRte_NvmBlock_WhlImbRejctn_CmpPeakData
