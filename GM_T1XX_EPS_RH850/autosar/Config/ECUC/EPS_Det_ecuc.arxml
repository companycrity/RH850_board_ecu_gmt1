AUTOSAR XML (schema 4-0-3)
package /ActiveEcuC
  module config Det: implementation-config-variant=VARIANT-PRE-COMPILE, module-description=Det_Impl
    DetGeneral:
      DetVersionInfoApi = false
      DetEnableDet = true
      DetExtDebugSupport = false
      DetGlobalFilterSize = 0
      DetBreakFilterSize = 0
      DetLogBufferSize = 0
      DetEntryCallout = false
      DetForwardToDlt = false
      DetServicePort: DetModuleId=4096
