AUTOSAR XML (schema 4-0-3)
package /ActiveEcuC
  module config StHlthSigStc: implementation-config-variant=VARIANT-PRE-COMPILE
    StHlthSigStcCrConfigList: StHlthSigStcCrcStartSymbol=ApplCRCAddress
    StHlthSigStcApplicationConfig: StHlthSigStcOsApplicationReference=Appl10
    22 x StHlthSigStcSignalList:
      CtrlrTStHlth
        StHlthSigStcSignalSettings:
          StHlthSigStcSignalName = CtrlrTStHlth
          StHlthSigStcLoopTime = 100000
          StHlthSigStcUpdatedInMotorIsr = false
          StHlthSigStcSignalTaskReference = Task_100ms_Appl10
      OutpAssiStHlth
        StHlthSigStcSignalSettings:
          StHlthSigStcSignalName = OutpAssiStHlth
          StHlthSigStcLoopTime = 2000
          StHlthSigStcUpdatedInMotorIsr = false
          StHlthSigStcSignalTaskReference = Task_2ms_Appl10
      DigTqSnsrAStHlth
        StHlthSigStcSignalSettings:
          StHlthSigStcSignalName = DigTqSnsrAStHlth
          StHlthSigStcLoopTime = 4000
          StHlthSigStcUpdatedInMotorIsr = false
          StHlthSigStcSignalTaskReference = Task_4ms_Appl10
      DigTqSnsrBStHlth
        StHlthSigStcSignalSettings:
          StHlthSigStcSignalName = DigTqSnsrBStHlth
          StHlthSigStcLoopTime = 4000
          StHlthSigStcUpdatedInMotorIsr = false
          StHlthSigStcSignalTaskReference = Task_4ms_Appl10
      DigTqIdptSigStHlth
        StHlthSigStcSignalSettings:
          StHlthSigStcSignalName = DigTqIdptSigStHlth
          StHlthSigStcLoopTime = 4000
          StHlthSigStcUpdatedInMotorIsr = false
          StHlthSigStcSignalTaskReference = Task_4ms_Appl10
      DutyCycStHlth
        StHlthSigStcSignalSettings:
          StHlthSigStcSignalName = DutyCycStHlth
          StHlthSigStcLoopTime = 100000
          StHlthSigStcUpdatedInMotorIsr = false
          StHlthSigStcSignalTaskReference = Task_100ms_Appl10
      EotImpctStHlth
        StHlthSigStcSignalSettings:
          StHlthSigStcSignalName = EotImpctStHlth
          StHlthSigStcLoopTime = 2000
          StHlthSigStcUpdatedInMotorIsr = false
          StHlthSigStcSignalTaskReference = Task_2ms_Appl10
      MotPosStHlth
        StHlthSigStcSignalSettings:
          StHlthSigStcSignalName = MotPosStHlth
          StHlthSigStcLoopTime = 2000
          StHlthSigStcUpdatedInMotorIsr = false
          StHlthSigStcSignalTaskReference = Task_2ms_Appl10
      MotPosABDiffStHlth
        StHlthSigStcSignalSettings:
          StHlthSigStcSignalName = AbsltMotPosABDifStHlth
          StHlthSigStcLoopTime = 2000
          StHlthSigStcUpdatedInMotorIsr = false
          StHlthSigStcSignalTaskReference = Task_2ms_Appl10
      MotPosACDiffStHlth
        StHlthSigStcSignalSettings:
          StHlthSigStcSignalName = AbsltMotPosACDifStHlth
          StHlthSigStcLoopTime = 2000
          StHlthSigStcUpdatedInMotorIsr = false
          StHlthSigStcSignalTaskReference = Task_2ms_Appl10
      MotPosBCDiffStHlth
        StHlthSigStcSignalSettings:
          StHlthSigStcSignalName = AbsltMotPosBCDifStHlth
          StHlthSigStcLoopTime = 2000
          StHlthSigStcUpdatedInMotorIsr = false
          StHlthSigStcSignalTaskReference = Task_2ms_Appl10
      CurrMotSumABCStHlth
        StHlthSigStcSignalSettings:
          StHlthSigStcSignalName = CurrMotSumABCStHlth
          StHlthSigStcLoopTime = 2000
          StHlthSigStcUpdatedInMotorIsr = false
          StHlthSigStcSignalTaskReference = Task_2ms_Appl10
      CurrMotSumDEFStHlth
        StHlthSigStcSignalSettings:
          StHlthSigStcSignalName = CurrMotSumDEFStHlth
          StHlthSigStcLoopTime = 2000
          StHlthSigStcUpdatedInMotorIsr = false
          StHlthSigStcSignalTaskReference = Task_2ms_Appl10
      MotPosPhaseAStHlth
        StHlthSigStcSignalSettings: StHlthSigStcSignalName=PhaAStHlth, StHlthSigStcLoopTime=2000, StHlthSigStcUpdatedInMotorIsr=false, StHlthSigStcSignalTaskReference=Task_2ms_Appl10
      MotPosPhaseBStHlth
        StHlthSigStcSignalSettings: StHlthSigStcSignalName=PhaBStHlth, StHlthSigStcLoopTime=2000, StHlthSigStcUpdatedInMotorIsr=false, StHlthSigStcSignalTaskReference=Task_2ms_Appl10
      MotPosPhaseCStHlth
        StHlthSigStcSignalSettings: StHlthSigStcSignalName=PhaCStHlth, StHlthSigStcLoopTime=2000, StHlthSigStcUpdatedInMotorIsr=false, StHlthSigStcSignalTaskReference=Task_2ms_Appl10
      MotPosPhaseDStHlth
        StHlthSigStcSignalSettings: StHlthSigStcSignalName=PhaDStHlth, StHlthSigStcLoopTime=2000, StHlthSigStcUpdatedInMotorIsr=false, StHlthSigStcSignalTaskReference=Task_2ms_Appl10
      MotPosPhaseEStHlth
        StHlthSigStcSignalSettings: StHlthSigStcSignalName=PhaEStHlth, StHlthSigStcLoopTime=2000, StHlthSigStcUpdatedInMotorIsr=false, StHlthSigStcSignalTaskReference=Task_2ms_Appl10
      MotPosPhaseFStHlth
        StHlthSigStcSignalSettings: StHlthSigStcSignalName=PhaFStHlth, StHlthSigStcLoopTime=2000, StHlthSigStcUpdatedInMotorIsr=false, StHlthSigStcSignalTaskReference=Task_2ms_Appl10
      RamEccSngBitCorrnStHlth
        StHlthSigStcSignalSettings:
          StHlthSigStcSignalName = RamEccSngBitCorrnStHlth
          StHlthSigStcLoopTime = 2000
          StHlthSigStcUpdatedInMotorIsr = false
          StHlthSigStcSignalTaskReference = Task_2ms_Appl10
      FricEstimnStHlth
        StHlthSigStcSignalSettings:
          StHlthSigStcSignalName = FricEstimnStHlth
          StHlthSigStcLoopTime = 10000
          StHlthSigStcUpdatedInMotorIsr = false
          StHlthSigStcSignalTaskReference = Task_10ms_Appl10
      WhlImbMaxCmpStHlth
        StHlthSigStcSignalSettings:
          StHlthSigStcSignalName = WhlImbMaxCmpStHlth
          StHlthSigStcLoopTime = 2000
          StHlthSigStcUpdatedInMotorIsr = false
          StHlthSigStcSignalTaskReference = Task_2ms_Appl10
