AUTOSAR XML (schema 4-0-3)
package /ActiveEcuC
  module config Adc0CfgAndUse: implementation-config-variant=VARIANT-PRE-COMPILE
    Adc0CfgAndUseGeneral:
      ADCD0VCR00 = 24580
      ADCD0VCR01 = 2
      ADCD0VCR02 = 3
      ADCD0VCR03 = 4
      ADCD0VCR04 = 9
      ADCD0VCR05 = 10
      ADCD0VCR06 = 11
      ADCD0VCR07 = 24588
      ADCD0VCR08 = 24580
      ADCD0VCR09 = 2
      ADCD0VCR10 = 3
      ADCD0VCR11 = 4
      ADCD0VCR12 = 9
      ADCD0VCR13 = 10
      ADCD0VCR14 = 11
      ADCD0VCR15 = 0
      ADCD0VCR16 = 1
      ADCD0VCR17 = 8
      ADCD0VCR18 = 24588
      ADCD0VCR19 = 24584
      ADCD0VCR20 = 24584
      ADCD0SGVCSP2 = 8
      ADCD0SGVCSP3 = 0
      ADCD0SGVCEP2 = 18
      ADCD0SGVCEP3 = 7
