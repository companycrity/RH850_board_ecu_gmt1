AUTOSAR XML (schema 4-0-3)
package /ActiveEcuC
  module config NxtrMfgSrv: implementation-config-variant=VARIANT-PRE-COMPILE
    NxtrMfgSrvGeneral: MfgSrvApplRef=Appl6
    167 x CommonService:
      SrvF000RoutineStrt: ServiceType=Routine - 0x31, RequestLength=0, ResponseLength=0, ServiceId=61440, SubFunction=1, Enabled=true
        AccessControls: NexteerSession=true, SecurityAccess=true
      SrvF001RoutineStrt: ServiceType=Routine - 0x31, RequestLength=0, ResponseLength=0, ServiceId=61441, SubFunction=1, Enabled=true
        AccessControls: NexteerSession=true, SecurityAccess=true
      SrvF010RoutineStrt: ServiceType=Routine - 0x31, RequestLength=0, ResponseLength=0, ServiceId=61456, SubFunction=1, Enabled=true, Application=Appl10
        AccessControls: NexteerSession=true, SecurityAccess=true
      SrvF100RoutineStop: ServiceType=Routine - 0x31, RequestLength=0, ResponseLength=0, ServiceId=61696, SubFunction=2, Enabled=true
        AccessControls: NexteerSession=true, SecurityAccess=true
      SrvF100RoutineStrt: ServiceType=Routine - 0x31, RequestLength=0, ResponseLength=0, ServiceId=61696, SubFunction=1, Enabled=true
        AccessControls: NexteerSession=true, SecurityAccess=true
      SrvF100RoutineSts: ServiceType=Routine - 0x31, RequestLength=0, ResponseLength=1, ServiceId=61696, SubFunction=3, Enabled=true
        AccessControls: NexteerSession=true, SecurityAccess=false
      SrvF110RoutineStop: ServiceType=Routine - 0x31, RequestLength=0, ResponseLength=0, ServiceId=61712, SubFunction=2, Enabled=true
        AccessControls: NexteerSession=true, SecurityAccess=true
      SrvF110RoutineStrt: ServiceType=Routine - 0x31, RequestLength=0, ResponseLength=0, ServiceId=61712, SubFunction=1, Enabled=true
        AccessControls: NexteerSession=true, SecurityAccess=true
      SrvF110RoutineSts: ServiceType=Routine - 0x31, RequestLength=0, ResponseLength=1, ServiceId=61712, SubFunction=3, Enabled=true
        AccessControls: NexteerSession=true, SecurityAccess=false
      SrvF111RoutineStop: ServiceType=Routine - 0x31, RequestLength=0, ResponseLength=0, ServiceId=61713, SubFunction=2, Enabled=true
        AccessControls: NexteerSession=true, SecurityAccess=true
      SrvF111RoutineStrt: ServiceType=Routine - 0x31, RequestLength=0, ResponseLength=0, ServiceId=61713, SubFunction=1, Enabled=true
        AccessControls: NexteerSession=true, SecurityAccess=true
      SrvF111RoutineSts: ServiceType=Routine - 0x31, RequestLength=0, ResponseLength=1, ServiceId=61713, SubFunction=3, Enabled=true
        AccessControls: NexteerSession=true, SecurityAccess=false
      SrvF112RoutineStop: ServiceType=Routine - 0x31, RequestLength=0, ResponseLength=0, ServiceId=61714, SubFunction=2, Enabled=true
        AccessControls: NexteerSession=true, SecurityAccess=true
      SrvF112RoutineStrt: ServiceType=Routine - 0x31, RequestLength=0, ResponseLength=0, ServiceId=61714, SubFunction=1, Enabled=true
        AccessControls: NexteerSession=true, SecurityAccess=true
      SrvF112RoutineSts: ServiceType=Routine - 0x31, RequestLength=0, ResponseLength=1, ServiceId=61714, SubFunction=3, Enabled=true
        AccessControls: NexteerSession=true, SecurityAccess=false
      SrvF113RoutineStop: ServiceType=Routine - 0x31, RequestLength=0, ResponseLength=0, ServiceId=61715, SubFunction=2, Enabled=true
        AccessControls: NexteerSession=true, SecurityAccess=true
      SrvF113RoutineStrt: ServiceType=Routine - 0x31, RequestLength=0, ResponseLength=0, ServiceId=61715, SubFunction=1, Enabled=true
        AccessControls: NexteerSession=true, SecurityAccess=true
      SrvF113RoutineSts: ServiceType=Routine - 0x31, RequestLength=0, ResponseLength=1, ServiceId=61715, SubFunction=3, Enabled=true
        AccessControls: NexteerSession=true, SecurityAccess=false
      SrvF114RoutineStop: ServiceType=Routine - 0x31, RequestLength=0, ResponseLength=0, ServiceId=61716, SubFunction=2, Enabled=true
        AccessControls: NexteerSession=true, SecurityAccess=true
      SrvF114RoutineStrt: ServiceType=Routine - 0x31, RequestLength=0, ResponseLength=0, ServiceId=61716, SubFunction=1, Enabled=true
        AccessControls: NexteerSession=true, SecurityAccess=true
      SrvF114RoutineSts: ServiceType=Routine - 0x31, RequestLength=0, ResponseLength=1, ServiceId=61716, SubFunction=3, Enabled=true
        AccessControls: NexteerSession=true, SecurityAccess=false
      SrvF115RoutineStop: ServiceType=Routine - 0x31, RequestLength=0, ResponseLength=0, ServiceId=61717, SubFunction=2, Enabled=true
        AccessControls: NexteerSession=true, SecurityAccess=true
      SrvF115RoutineStrt: ServiceType=Routine - 0x31, RequestLength=0, ResponseLength=0, ServiceId=61717, SubFunction=1, Enabled=true
        AccessControls: NexteerSession=true, SecurityAccess=true
      SrvF115RoutineSts: ServiceType=Routine - 0x31, RequestLength=0, ResponseLength=1, ServiceId=61717, SubFunction=3, Enabled=true
        AccessControls: NexteerSession=true, SecurityAccess=false
      SrvF116RoutineStop: ServiceType=Routine - 0x31, RequestLength=0, ResponseLength=0, ServiceId=61718, SubFunction=2, Enabled=true
        AccessControls: NexteerSession=true, SecurityAccess=true
      SrvF116RoutineStrt: ServiceType=Routine - 0x31, RequestLength=0, ResponseLength=0, ServiceId=61718, SubFunction=1, Enabled=true
        AccessControls: NexteerSession=true, SecurityAccess=true
      SrvF116RoutineSts: ServiceType=Routine - 0x31, RequestLength=0, ResponseLength=1, ServiceId=61718, SubFunction=3, Enabled=true
        AccessControls: NexteerSession=true, SecurityAccess=false
      SrvF117RoutineStop: ServiceType=Routine - 0x31, RequestLength=0, ResponseLength=0, ServiceId=61719, SubFunction=2, Enabled=true
        AccessControls: NexteerSession=true, SecurityAccess=true
      SrvF117RoutineStrt: ServiceType=Routine - 0x31, RequestLength=0, ResponseLength=0, ServiceId=61719, SubFunction=1, Enabled=true
        AccessControls: NexteerSession=true, SecurityAccess=true
      SrvF117RoutineSts: ServiceType=Routine - 0x31, RequestLength=0, ResponseLength=1, ServiceId=61719, SubFunction=3, Enabled=true
        AccessControls: NexteerSession=true, SecurityAccess=false
      SrvF118RoutineStop: ServiceType=Routine - 0x31, RequestLength=0, ResponseLength=0, ServiceId=61720, SubFunction=2, Enabled=true
        AccessControls: NexteerSession=true, SecurityAccess=true
      SrvF118RoutineStrt: ServiceType=Routine - 0x31, RequestLength=0, ResponseLength=0, ServiceId=61720, SubFunction=1, Enabled=true
        AccessControls: NexteerSession=true, SecurityAccess=true
      SrvF118RoutineSts: ServiceType=Routine - 0x31, RequestLength=0, ResponseLength=1, ServiceId=61720, SubFunction=3, Enabled=true
        AccessControls: NexteerSession=true, SecurityAccess=false
      SrvF119RoutineStop: ServiceType=Routine - 0x31, RequestLength=0, ResponseLength=0, ServiceId=61721, SubFunction=2, Enabled=true
        AccessControls: NexteerSession=true, SecurityAccess=true
      SrvF119RoutineStrt: ServiceType=Routine - 0x31, RequestLength=0, ResponseLength=0, ServiceId=61721, SubFunction=1, Enabled=true
        AccessControls: NexteerSession=true, SecurityAccess=true
      SrvF119RoutineSts: ServiceType=Routine - 0x31, RequestLength=0, ResponseLength=1, ServiceId=61721, SubFunction=3, Enabled=true
        AccessControls: NexteerSession=true, SecurityAccess=false
      SrvF140RoutineStop: ServiceType=Routine - 0x31, RequestLength=0, ResponseLength=0, ServiceId=61760, SubFunction=2, Enabled=true
        AccessControls: NexteerSession=true, SecurityAccess=true
      SrvF140RoutineStrt: ServiceType=Routine - 0x31, RequestLength=0, ResponseLength=0, ServiceId=61760, SubFunction=1, Enabled=true
        AccessControls: NexteerSession=true, SecurityAccess=true
      SrvF140RoutineSts: ServiceType=Routine - 0x31, RequestLength=0, ResponseLength=8, ServiceId=61760, SubFunction=3, Enabled=true
        AccessControls: NexteerSession=true, SecurityAccess=false
      SrvF141RoutineStop: ServiceType=Routine - 0x31, RequestLength=0, ResponseLength=0, ServiceId=61761, SubFunction=2, Enabled=true
        AccessControls: NexteerSession=true, SecurityAccess=true
      SrvF141RoutineStrt: ServiceType=Routine - 0x31, RequestLength=0, ResponseLength=0, ServiceId=61761, SubFunction=1, Enabled=true
        AccessControls: NexteerSession=true, SecurityAccess=true
      SrvF141RoutineSts: ServiceType=Routine - 0x31, RequestLength=0, ResponseLength=8, ServiceId=61761, SubFunction=3, Enabled=true
        AccessControls: NexteerSession=true, SecurityAccess=false
      SrvF150RoutineStop: ServiceType=Routine - 0x31, RequestLength=0, ResponseLength=0, ServiceId=61776, SubFunction=2, Enabled=true
        AccessControls: NexteerSession=true, SecurityAccess=true
      SrvF150RoutineStrt: ServiceType=Routine - 0x31, RequestLength=0, ResponseLength=0, ServiceId=61776, SubFunction=1, Enabled=true
        AccessControls: NexteerSession=true, SecurityAccess=true
      SrvF150RoutineSts: ServiceType=Routine - 0x31, RequestLength=0, ResponseLength=1, ServiceId=61776, SubFunction=3, Enabled=true
        AccessControls: NexteerSession=true, SecurityAccess=false
      SrvF194Rd: ServiceType=Read - 0x22, RequestLength=0, ResponseLength=16, ServiceId=61844, Enabled=true
        AccessControls: NexteerSession=true, SecurityAccess=false
      SrvF195Rd: ServiceType=Read - 0x22, RequestLength=0, ResponseLength=16, ServiceId=61845, Enabled=true
        AccessControls: NexteerSession=true, SecurityAccess=false
      SrvF1F0Rd: ServiceType=Read - 0x22, RequestLength=0, ResponseLength=16, ServiceId=61936, Enabled=true
        AccessControls: NexteerSession=true, SecurityAccess=false
      SrvF1F1Rd: ServiceType=Read - 0x22, RequestLength=0, ResponseLength=16, ServiceId=61937, Enabled=true
        AccessControls: NexteerSession=true, SecurityAccess=false
      SrvF1F2Rd: ServiceType=Read - 0x22, RequestLength=0, ResponseLength=5, ServiceId=61938, Enabled=true
        AccessControls: NexteerSession=true, SecurityAccess=false
      SrvF1F3Rd: ServiceType=Read - 0x22, RequestLength=0, ResponseLength=5, ServiceId=61939, Enabled=true
        AccessControls: NexteerSession=true, SecurityAccess=false
      SrvF1F4Rd: ServiceType=Read - 0x22, RequestLength=0, ResponseLength=5, ServiceId=61940, Enabled=true
        AccessControls: NexteerSession=true, SecurityAccess=false
      SrvF1F7Rd: ServiceType=Read - 0x22, RequestLength=0, ResponseLength=59, ServiceId=61943, Enabled=true
        AccessControls: NexteerSession=true, SecurityAccess=false
      SrvF1F8Rd: ServiceType=Read - 0x22, RequestLength=0, ResponseLength=59, ServiceId=61944, Enabled=true
        AccessControls: NexteerSession=true, SecurityAccess=false
      SrvF1F9Rd: ServiceType=Read - 0x22, RequestLength=0, ResponseLength=59, ServiceId=61945, Enabled=true
        AccessControls: NexteerSession=true, SecurityAccess=false
      SrvF1FDRd: ServiceType=Read - 0x22, RequestLength=0, ResponseLength=9, ServiceId=61949, Enabled=true
        AccessControls: NexteerSession=true, SecurityAccess=false
      SrvF1FERd: ServiceType=Read - 0x22, RequestLength=0, ResponseLength=5, ServiceId=61950, Enabled=true
        AccessControls: NexteerSession=true, SecurityAccess=false
      SrvF1FFRd: ServiceType=Read - 0x22, RequestLength=0, ResponseLength=20, ServiceId=61951, Enabled=true
        AccessControls: NexteerSession=true, SecurityAccess=false
      SrvFD00Rd: ServiceType=Read - 0x22, RequestLength=0, ResponseLength=1, ServiceId=64768, Enabled=true
        AccessControls: NexteerSession=true, SecurityAccess=false
      SrvFD01Rd: ServiceType=Read - 0x22, RequestLength=0, ResponseLength=4, ServiceId=64769, Enabled=true
        AccessControls: NexteerSession=true, SecurityAccess=false
      SrvFD02Rd: ServiceType=Read - 0x22, RequestLength=0, ResponseLength=1, ServiceId=64770, Enabled=true
        AccessControls: NexteerSession=true, SecurityAccess=false
      SrvFD02Wr: ServiceType=Write - 0x2E, RequestLength=1, ResponseLength=0, ServiceId=64770, Enabled=true
        AccessControls: NexteerSession=true, SecurityAccess=true
      SrvFD03Rd: ServiceType=Read - 0x22, RequestLength=0, ResponseLength=4, ServiceId=64771, Enabled=true
        AccessControls: NexteerSession=true, SecurityAccess=false
      SrvFD03Wr: ServiceType=Write - 0x2E, RequestLength=4, ResponseLength=0, ServiceId=64771, Enabled=true, Application=Appl10
        AccessControls: NexteerSession=true, SecurityAccess=true
      SrvFD30Rd: ServiceType=Read - 0x22, RequestLength=0, ResponseLength=20, ServiceId=64816, Enabled=true
        AccessControls: NexteerSession=true, SecurityAccess=false
      SrvFD30Wr: ServiceType=Write - 0x2E, RequestLength=20, ResponseLength=0, ServiceId=64816, Enabled=true
        AccessControls: NexteerSession=true, SecurityAccess=true
      SrvFD31Rd: ServiceType=Read - 0x22, RequestLength=0, ResponseLength=20, ServiceId=64817, Enabled=true
        AccessControls: NexteerSession=true, SecurityAccess=false
      SrvFD31Wr: ServiceType=Write - 0x2E, RequestLength=20, ResponseLength=0, ServiceId=64817, Enabled=true
        AccessControls: NexteerSession=true, SecurityAccess=true
      SrvFD32Rd: ServiceType=Read - 0x22, RequestLength=0, ResponseLength=20, ServiceId=64818, Enabled=true
        AccessControls: NexteerSession=true, SecurityAccess=false
      SrvFD32Wr: ServiceType=Write - 0x2E, RequestLength=20, ResponseLength=0, ServiceId=64818, Enabled=true
        AccessControls: NexteerSession=true, SecurityAccess=true
      SrvFD38Rd: ServiceType=Read - 0x22, RequestLength=0, ResponseLength=16, ServiceId=64824, Enabled=true
        AccessControls: NexteerSession=true, SecurityAccess=false
      SrvFD38Wr: ServiceType=Write - 0x2E, RequestLength=16, ResponseLength=0, ServiceId=64824, Enabled=true
        AccessControls: NexteerSession=true, SecurityAccess=true
      SrvFD39Rd: ServiceType=Read - 0x22, RequestLength=0, ResponseLength=16, ServiceId=64825, Enabled=true
        AccessControls: NexteerSession=true, SecurityAccess=false
      SrvFD39Wr: ServiceType=Write - 0x2E, RequestLength=16, ResponseLength=0, ServiceId=64825, Enabled=true
        AccessControls: NexteerSession=true, SecurityAccess=true
      SrvFD3ARd: ServiceType=Read - 0x22, RequestLength=0, ResponseLength=16, ServiceId=64826, Enabled=true
        AccessControls: NexteerSession=true, SecurityAccess=false
      SrvFD3AWr: ServiceType=Write - 0x2E, RequestLength=16, ResponseLength=0, ServiceId=64826, Enabled=true
        AccessControls: NexteerSession=true, SecurityAccess=true
      SrvFD3BRd: ServiceType=Read - 0x22, RequestLength=0, ResponseLength=16, ServiceId=64827, Enabled=true
        AccessControls: NexteerSession=true, SecurityAccess=false
      SrvFD3BWr: ServiceType=Write - 0x2E, RequestLength=16, ResponseLength=0, ServiceId=64827, Enabled=true
        AccessControls: NexteerSession=true, SecurityAccess=true
      SrvFD3CRd: ServiceType=Read - 0x22, RequestLength=0, ResponseLength=16, ServiceId=64828, Enabled=true
        AccessControls: NexteerSession=true, SecurityAccess=false
      SrvFD3CWr: ServiceType=Write - 0x2E, RequestLength=16, ResponseLength=0, ServiceId=64828, Enabled=true
        AccessControls: NexteerSession=true, SecurityAccess=true
      SrvFD40CtrlAdj: ServiceType=Control - 0x2F, RequestLength=4, ResponseLength=4, ServiceId=64832, SubFunction=3, Enabled=true, Application=Appl10
        AccessControls: NexteerSession=true, SecurityAccess=true
      SrvFD40CtrlRtn: ServiceType=Control - 0x2F, RequestLength=0, ResponseLength=4, ServiceId=64832, SubFunction=0, Enabled=true, Application=Appl10
        AccessControls: NexteerSession=true, SecurityAccess=false
      SrvFD41CtrlAdj: ServiceType=Control - 0x2F, RequestLength=4, ResponseLength=4, ServiceId=64833, SubFunction=3, Enabled=true
        AccessControls: NexteerSession=true, SecurityAccess=true
      SrvFD41CtrlRtn: ServiceType=Control - 0x2F, RequestLength=0, ResponseLength=4, ServiceId=64833, SubFunction=0, Enabled=true
        AccessControls: NexteerSession=true, SecurityAccess=false
      SrvFD42CtrlAdj: ServiceType=Control - 0x2F, RequestLength=4, ResponseLength=4, ServiceId=64834, SubFunction=3, Enabled=true
        AccessControls: NexteerSession=true, SecurityAccess=true
      SrvFD42CtrlRtn: ServiceType=Control - 0x2F, RequestLength=0, ResponseLength=4, ServiceId=64834, SubFunction=0, Enabled=true
        AccessControls: NexteerSession=true, SecurityAccess=false
      SrvFD60Rd: ServiceType=Read - 0x22, RequestLength=0, ResponseLength=100, ServiceId=64864, Enabled=true
        AccessControls: NexteerSession=true, SecurityAccess=false
      SrvFD70RoutineStrt: ServiceType=Routine - 0x31, RequestLength=0, ResponseLength=0, ServiceId=64880, SubFunction=1, Enabled=true, Application=Appl10
        AccessControls: NexteerSession=true, SecurityAccess=true
      SrvFD80RoutineStrt: ServiceType=Routine - 0x31, RequestLength=0, ResponseLength=0, ServiceId=64896, SubFunction=1, Enabled=true, Application=Appl10
        AccessControls: NexteerSession=true, SecurityAccess=true
      SrvFD81RoutineStrt: ServiceType=Routine - 0x31, RequestLength=0, ResponseLength=0, ServiceId=64897, SubFunction=1, Enabled=true, Application=Appl10
        AccessControls: NexteerSession=true, SecurityAccess=true
      SrvFD84RoutineStrt: ServiceType=Routine - 0x31, RequestLength=0, ResponseLength=0, ServiceId=64900, SubFunction=1, Enabled=true, Application=Appl10
        AccessControls: NexteerSession=true, SecurityAccess=true
      SrvFD85RoutineStrt: ServiceType=Routine - 0x31, RequestLength=0, ResponseLength=0, ServiceId=64901, SubFunction=1, Enabled=true, Application=Appl10
        AccessControls: NexteerSession=true, SecurityAccess=true
      SrvFD88Rd: ServiceType=Read - 0x22, RequestLength=0, ResponseLength=4, ServiceId=64904, Enabled=true
        AccessControls: NexteerSession=true, SecurityAccess=false
      SrvFD88Wr: ServiceType=Write - 0x2E, RequestLength=4, ResponseLength=0, ServiceId=64904, Enabled=true, Application=Appl10
        AccessControls: NexteerSession=true, SecurityAccess=true
      SrvFD89Rd: ServiceType=Read - 0x22, RequestLength=0, ResponseLength=4, ServiceId=64905, Enabled=true
        AccessControls: NexteerSession=true, SecurityAccess=false
      SrvFD89Wr: ServiceType=Write - 0x2E, RequestLength=4, ResponseLength=0, ServiceId=64905, Enabled=true, Application=Appl10
        AccessControls: NexteerSession=true, SecurityAccess=true
      SrvFD8CRd: ServiceType=Read - 0x22, RequestLength=0, ResponseLength=1, ServiceId=64908, Enabled=true
        AccessControls: NexteerSession=true, SecurityAccess=false
      SrvFD8DRd: ServiceType=Read - 0x22, RequestLength=0, ResponseLength=1, ServiceId=64909, Enabled=true
        AccessControls: NexteerSession=true, SecurityAccess=false
      SrvFDA0RoutineStrt: ServiceType=Routine - 0x31, RequestLength=0, ResponseLength=0, ServiceId=64928, SubFunction=1, Enabled=true, Application=Appl10
        AccessControls: NexteerSession=true, SecurityAccess=true
      SrvFDA1RoutineStrt: ServiceType=Routine - 0x31, RequestLength=0, ResponseLength=0, ServiceId=64929, SubFunction=1, Enabled=true, Application=Appl10
        AccessControls: NexteerSession=true, SecurityAccess=true
      SrvFDA2RoutineStrt: ServiceType=Routine - 0x31, RequestLength=0, ResponseLength=0, ServiceId=64930, SubFunction=1, Enabled=true, Application=Appl10
        AccessControls: NexteerSession=true, SecurityAccess=true
      SrvFDA3RoutineStrt: ServiceType=Routine - 0x31, RequestLength=0, ResponseLength=0, ServiceId=64931, SubFunction=1, Enabled=true, Application=Appl10
        AccessControls: NexteerSession=true, SecurityAccess=true
      SrvFDA8RoutineStrt: ServiceType=Routine - 0x31, RequestLength=0, ResponseLength=0, ServiceId=64936, SubFunction=1, Enabled=true, Application=Appl10
        AccessControls: NexteerSession=true, SecurityAccess=true
      SrvFDA9RoutineStrt: ServiceType=Routine - 0x31, RequestLength=0, ResponseLength=0, ServiceId=64937, SubFunction=1, Enabled=true, Application=Appl10
        AccessControls: NexteerSession=true, SecurityAccess=true
      SrvFDAARoutineStrt: ServiceType=Routine - 0x31, RequestLength=0, ResponseLength=0, ServiceId=64938, SubFunction=1, Enabled=true, Application=Appl10
        AccessControls: NexteerSession=true, SecurityAccess=true
      SrvFDABRoutineStrt: ServiceType=Routine - 0x31, RequestLength=0, ResponseLength=0, ServiceId=64939, SubFunction=1, Enabled=true, Application=Appl10
        AccessControls: NexteerSession=true, SecurityAccess=true
      SrvFDB0Rd: ServiceType=Read - 0x22, RequestLength=0, ResponseLength=4, ServiceId=64944, Enabled=true
        AccessControls: NexteerSession=true, SecurityAccess=false
      SrvFDB0Wr: ServiceType=Write - 0x2E, RequestLength=4, ResponseLength=0, ServiceId=64944, Enabled=true, Application=Appl10
        AccessControls: NexteerSession=true, SecurityAccess=true
      SrvFDB1Rd: ServiceType=Read - 0x22, RequestLength=0, ResponseLength=4, ServiceId=64945, Enabled=true
        AccessControls: NexteerSession=true, SecurityAccess=false
      SrvFDB1Wr: ServiceType=Write - 0x2E, RequestLength=4, ResponseLength=0, ServiceId=64945, Enabled=true, Application=Appl10
        AccessControls: NexteerSession=true, SecurityAccess=true
      SrvFDB2Rd: ServiceType=Read - 0x22, RequestLength=0, ResponseLength=4, ServiceId=64946, Enabled=true
        AccessControls: NexteerSession=true, SecurityAccess=false
      SrvFDB2Wr: ServiceType=Write - 0x2E, RequestLength=4, ResponseLength=0, ServiceId=64946, Enabled=true, Application=Appl10
        AccessControls: NexteerSession=true, SecurityAccess=true
      SrvFDB3Rd: ServiceType=Read - 0x22, RequestLength=0, ResponseLength=4, ServiceId=64947, Enabled=true
        AccessControls: NexteerSession=true, SecurityAccess=false
      SrvFDB3Wr: ServiceType=Write - 0x2E, RequestLength=4, ResponseLength=0, ServiceId=64947, Enabled=true, Application=Appl10
        AccessControls: NexteerSession=true, SecurityAccess=true
      SrvFDB8Rd: ServiceType=Read - 0x22, RequestLength=0, ResponseLength=1, ServiceId=64952, Enabled=true
        AccessControls: NexteerSession=true, SecurityAccess=false
      SrvFDB9Rd: ServiceType=Read - 0x22, RequestLength=0, ResponseLength=1, ServiceId=64953, Enabled=true
        AccessControls: NexteerSession=true, SecurityAccess=false
      SrvFDBARd: ServiceType=Read - 0x22, RequestLength=0, ResponseLength=1, ServiceId=64954, Enabled=true
        AccessControls: NexteerSession=true, SecurityAccess=false
      SrvFDBBRd: ServiceType=Read - 0x22, RequestLength=0, ResponseLength=1, ServiceId=64955, Enabled=true
        AccessControls: NexteerSession=true, SecurityAccess=false
      SrvFDC0Rd: ServiceType=Read - 0x22, RequestLength=0, ResponseLength=2, ServiceId=64960, Enabled=true
        AccessControls: NexteerSession=true, SecurityAccess=false
      SrvFDC0Wr: ServiceType=Write - 0x2E, RequestLength=2, ResponseLength=0, ServiceId=64960, Enabled=true, Application=Appl10
        AccessControls: NexteerSession=true, SecurityAccess=true
      SrvFDC8Rd: ServiceType=Read - 0x22, RequestLength=0, ResponseLength=22, ServiceId=64968, Enabled=true
        AccessControls: NexteerSession=true, SecurityAccess=false
      SrvFDC8Wr: ServiceType=Write - 0x2E, RequestLength=22, ResponseLength=0, ServiceId=64968, Enabled=true, Application=Appl10
        AccessControls: NexteerSession=true, SecurityAccess=true
      SrvFDD0RoutineStrt: ServiceType=Routine - 0x31, RequestLength=0, ResponseLength=0, ServiceId=64976, SubFunction=1, Enabled=false
        AccessControls: NexteerSession=true, SecurityAccess=true
      SrvFDD1Rd: ServiceType=Read - 0x22, RequestLength=0, ResponseLength=258, ServiceId=64977, Enabled=false
        AccessControls: NexteerSession=true, SecurityAccess=false
      SrvFDD1Wr: ServiceType=Write - 0x2E, RequestLength=258, ResponseLength=0, ServiceId=64977, Enabled=false
        AccessControls: NexteerSession=true, SecurityAccess=true
      SrvFDD2Rd: ServiceType=Read - 0x22, RequestLength=0, ResponseLength=258, ServiceId=64978, Enabled=false
        AccessControls: NexteerSession=true, SecurityAccess=false
      SrvFDD2Wr: ServiceType=Write - 0x2E, RequestLength=258, ResponseLength=0, ServiceId=64978, Enabled=false
        AccessControls: NexteerSession=true, SecurityAccess=true
      SrvFDD3Rd: ServiceType=Read - 0x22, RequestLength=0, ResponseLength=258, ServiceId=64979, Enabled=false
        AccessControls: NexteerSession=true, SecurityAccess=false
      SrvFDD3Wr: ServiceType=Write - 0x2E, RequestLength=258, ResponseLength=0, ServiceId=64979, Enabled=false
        AccessControls: NexteerSession=true, SecurityAccess=true
      SrvFDD4Rd: ServiceType=Read - 0x22, RequestLength=0, ResponseLength=258, ServiceId=64980, Enabled=false
        AccessControls: NexteerSession=true, SecurityAccess=false
      SrvFDD4Wr: ServiceType=Write - 0x2E, RequestLength=258, ResponseLength=0, ServiceId=64980, Enabled=false
        AccessControls: NexteerSession=true, SecurityAccess=true
      SrvFDD5Rd: ServiceType=Read - 0x22, RequestLength=0, ResponseLength=2, ServiceId=64981, Enabled=false
        AccessControls: NexteerSession=true, SecurityAccess=false
      SrvFDD5Wr: ServiceType=Write - 0x2E, RequestLength=2, ResponseLength=0, ServiceId=64981, Enabled=false
        AccessControls: NexteerSession=true, SecurityAccess=true
      SrvFDD7Rd: ServiceType=Read - 0x22, RequestLength=0, ResponseLength=106, ServiceId=64983, Enabled=true
        AccessControls: NexteerSession=true, SecurityAccess=false
      SrvFDD7Wr: ServiceType=Write - 0x2E, RequestLength=106, ResponseLength=0, ServiceId=64983, Enabled=true, Application=Appl10
        AccessControls: NexteerSession=true, SecurityAccess=true
      SrvFDD8RoutineStrt: ServiceType=Routine - 0x31, RequestLength=0, ResponseLength=0, ServiceId=64984, SubFunction=1, Enabled=false
        AccessControls: NexteerSession=true, SecurityAccess=true
      SrvFDD9Rd: ServiceType=Read - 0x22, RequestLength=0, ResponseLength=258, ServiceId=64985, Enabled=false
        AccessControls: NexteerSession=true, SecurityAccess=false
      SrvFDD9Wr: ServiceType=Write - 0x2E, RequestLength=258, ResponseLength=0, ServiceId=64985, Enabled=false
        AccessControls: NexteerSession=true, SecurityAccess=true
      SrvFDDARd: ServiceType=Read - 0x22, RequestLength=0, ResponseLength=258, ServiceId=64986, Enabled=false
        AccessControls: NexteerSession=true, SecurityAccess=false
      SrvFDDAWr: ServiceType=Write - 0x2E, RequestLength=258, ResponseLength=0, ServiceId=64986, Enabled=false
        AccessControls: NexteerSession=true, SecurityAccess=true
      SrvFDDBRd: ServiceType=Read - 0x22, RequestLength=0, ResponseLength=258, ServiceId=64987, Enabled=false
        AccessControls: NexteerSession=true, SecurityAccess=false
      SrvFDDBWr: ServiceType=Write - 0x2E, RequestLength=258, ResponseLength=0, ServiceId=64987, Enabled=false
        AccessControls: NexteerSession=true, SecurityAccess=true
      SrvFDDCRd: ServiceType=Read - 0x22, RequestLength=0, ResponseLength=258, ServiceId=64988, Enabled=false
        AccessControls: NexteerSession=true, SecurityAccess=false
      SrvFDDCWr: ServiceType=Write - 0x2E, RequestLength=258, ResponseLength=0, ServiceId=64988, Enabled=false
        AccessControls: NexteerSession=true, SecurityAccess=true
      SrvFDDDRd: ServiceType=Read - 0x22, RequestLength=0, ResponseLength=2, ServiceId=64989, Enabled=false
        AccessControls: NexteerSession=true, SecurityAccess=false
      SrvFDDDWr: ServiceType=Write - 0x2E, RequestLength=2, ResponseLength=0, ServiceId=64989, Enabled=false
        AccessControls: NexteerSession=true, SecurityAccess=true
      SrvFDDFRd: ServiceType=Read - 0x22, RequestLength=0, ResponseLength=106, ServiceId=64991, Enabled=true
        AccessControls: NexteerSession=true, SecurityAccess=false
      SrvFDDFWr: ServiceType=Write - 0x2E, RequestLength=106, ResponseLength=0, ServiceId=64991, Enabled=true, Application=Appl10
        AccessControls: NexteerSession=true, SecurityAccess=true
      SrvFDF0RoutineStrt: ServiceType=Routine - 0x31, RequestLength=0, ResponseLength=0, ServiceId=65008, SubFunction=1, Enabled=true, Application=Appl10
        AccessControls: NexteerSession=true, SecurityAccess=true
      SrvFDF0RoutineSts: ServiceType=Routine - 0x31, RequestLength=0, ResponseLength=1, ServiceId=65008, SubFunction=3, Enabled=true
        AccessControls: NexteerSession=true, SecurityAccess=false
      SrvFDF1RoutineStrt: ServiceType=Routine - 0x31, RequestLength=0, ResponseLength=0, ServiceId=65009, SubFunction=1, Enabled=true, Application=Appl10
        AccessControls: NexteerSession=true, SecurityAccess=true
      SrvFDF1RoutineSts: ServiceType=Routine - 0x31, RequestLength=0, ResponseLength=1, ServiceId=65009, SubFunction=3, Enabled=true
        AccessControls: NexteerSession=true, SecurityAccess=false
      SrvFDF4Rd: ServiceType=Read - 0x22, RequestLength=0, ResponseLength=24, ServiceId=65012, Enabled=true
        AccessControls: NexteerSession=true, SecurityAccess=false
      SrvFDF4Wr: ServiceType=Write - 0x2E, RequestLength=24, ResponseLength=0, ServiceId=65012, Enabled=true, Application=Appl10
        AccessControls: NexteerSession=true, SecurityAccess=true
      SrvFDF5Rd: ServiceType=Read - 0x22, RequestLength=0, ResponseLength=52, ServiceId=65013, Enabled=true
        AccessControls: NexteerSession=true, SecurityAccess=false
      SrvFDF5Wr: ServiceType=Write - 0x2E, RequestLength=52, ResponseLength=0, ServiceId=65013, Enabled=true, Application=Appl10
        AccessControls: NexteerSession=true, SecurityAccess=true
      SrvFDF8Rd: ServiceType=Read - 0x22, RequestLength=0, ResponseLength=8, ServiceId=65016, Enabled=true
        AccessControls: NexteerSession=true, SecurityAccess=false
      SrvFDF8Wr: ServiceType=Write - 0x2E, RequestLength=8, ResponseLength=0, ServiceId=65016, Enabled=true, Application=Appl10
        AccessControls: NexteerSession=true, SecurityAccess=true
      SrvFE80RoutineStrt: ServiceType=Routine - 0x31, RequestLength=0, ResponseLength=0, ServiceId=65152, SubFunction=1, Enabled=true, Application=Appl10
        AccessControls: NexteerSession=true, SecurityAccess=true
      SrvFE81Rd: ServiceType=Read - 0x22, RequestLength=0, ResponseLength=13, ServiceId=65153, Enabled=true
        AccessControls: NexteerSession=true, SecurityAccess=false
      SrvFE82Rd: ServiceType=Read - 0x22, RequestLength=0, ResponseLength=4, ServiceId=65154, Enabled=true
        AccessControls: NexteerSession=false, SecurityAccess=false
      SrvFE82Wr: ServiceType=Write - 0x2E, RequestLength=4, ResponseLength=0, ServiceId=65154, Enabled=true, Application=Appl10
        AccessControls: NexteerSession=true, SecurityAccess=true
      SrvFE83Rd: ServiceType=Read - 0x22, RequestLength=0, ResponseLength=4, ServiceId=65155, Enabled=true
        AccessControls: NexteerSession=false, SecurityAccess=false
      SrvFE83Wr: ServiceType=Write - 0x2E, RequestLength=4, ResponseLength=0, ServiceId=65155, Enabled=true, Application=Appl10
        AccessControls: NexteerSession=true, SecurityAccess=true
      SrvSessionDflt: ServiceType=Session - 0x10, RequestLength=0, ResponseLength=0, SubFunction=1, Enabled=true
        AccessControls: NexteerSession=false, SecurityAccess=false
      SrvSessionNxtr: ServiceType=Session - 0x10, RequestLength=0, ResponseLength=0, SubFunction=126, Enabled=true
        AccessControls: NexteerSession=false, SecurityAccess=false
      SrvTesterPresent_Send: ServiceType=TesterPresent - 0x3E, RequestLength=0, ResponseLength=0, SubFunction=0, Enabled=true
        AccessControls: NexteerSession=false, SecurityAccess=false
    26 x ProgramSpecificService, all with Enabled=true:
      SrvFED0Rd: ServiceType=Read - 0x22, RequestLength=0, ResponseLength=6, ServiceId=65232
        AccessControls: NexteerSession=true, SecurityAccess=false
      SrvFED0Wr: ServiceType=Write - 0x2E, RequestLength=6, ResponseLength=0, ServiceId=65232
        AccessControls: NexteerSession=true, SecurityAccess=true
      SrvFED1Rd: ServiceType=Read - 0x22, RequestLength=0, ResponseLength=6, ServiceId=65233
        AccessControls: NexteerSession=true, SecurityAccess=false
      SrvFED1Wr: ServiceType=Write - 0x2E, RequestLength=6, ResponseLength=0, ServiceId=65233
        AccessControls: NexteerSession=true, SecurityAccess=true
      SrvFED2Rd: ServiceType=Read - 0x22, RequestLength=0, ResponseLength=20, ServiceId=65234
        AccessControls: NexteerSession=true, SecurityAccess=false
      SrvFED2Wr: ServiceType=Write - 0x2E, RequestLength=20, ResponseLength=0, ServiceId=65234
        AccessControls: NexteerSession=true, SecurityAccess=true
      SrvFED3Rd: ServiceType=Read - 0x22, RequestLength=0, ResponseLength=2, ServiceId=65235
        AccessControls: NexteerSession=true, SecurityAccess=false
      SrvFED3Wr: ServiceType=Write - 0x2E, RequestLength=2, ResponseLength=0, ServiceId=65235
        AccessControls: NexteerSession=true, SecurityAccess=true
      SrvFED4Rd: ServiceType=Read - 0x22, RequestLength=0, ResponseLength=6, ServiceId=65236
        AccessControls: NexteerSession=true, SecurityAccess=false
      SrvFED4Wr: ServiceType=Write - 0x2E, RequestLength=6, ResponseLength=0, ServiceId=65236
        AccessControls: NexteerSession=true, SecurityAccess=true
      SrvFED5Rd: ServiceType=Read - 0x22, RequestLength=0, ResponseLength=9, ServiceId=65237
        AccessControls: NexteerSession=true, SecurityAccess=false
      SrvFED5Wr: ServiceType=Write - 0x2E, RequestLength=9, ResponseLength=0, ServiceId=65237
        AccessControls: NexteerSession=true, SecurityAccess=true
      SrvFED6Rd: ServiceType=Read - 0x22, RequestLength=0, ResponseLength=1, ServiceId=65238
        AccessControls: NexteerSession=true, SecurityAccess=false
      SrvFED6Wr: ServiceType=Write - 0x2E, RequestLength=1, ResponseLength=0, ServiceId=65238
        AccessControls: NexteerSession=true, SecurityAccess=true
      SrvFED7Rd: ServiceType=Read - 0x22, RequestLength=0, ResponseLength=4, ServiceId=65239
        AccessControls: NexteerSession=true, SecurityAccess=false
      SrvFED7Wr: ServiceType=Write - 0x2E, RequestLength=4, ResponseLength=0, ServiceId=65239
        AccessControls: NexteerSession=true, SecurityAccess=true
      SrvFED8Rd: ServiceType=Read - 0x22, RequestLength=0, ResponseLength=20, ServiceId=65240
        AccessControls: NexteerSession=true, SecurityAccess=false
      SrvFED8Wr: ServiceType=Write - 0x2E, RequestLength=20, ResponseLength=0, ServiceId=65240
        AccessControls: NexteerSession=true, SecurityAccess=true
      SrvFED9Rd: ServiceType=Read - 0x22, RequestLength=0, ResponseLength=17, ServiceId=65241
        AccessControls: NexteerSession=true, SecurityAccess=false
      SrvFED9Wr: ServiceType=Write - 0x2E, RequestLength=17, ResponseLength=0, ServiceId=65241
        AccessControls: NexteerSession=true, SecurityAccess=true
      SrvFEDARd: ServiceType=Read - 0x22, RequestLength=0, ResponseLength=9, ServiceId=65242
        AccessControls: NexteerSession=true, SecurityAccess=false
      SrvFEDAWr: ServiceType=Write - 0x2E, RequestLength=9, ResponseLength=0, ServiceId=65242
        AccessControls: NexteerSession=true, SecurityAccess=true
      SrvFEE0Rd: ServiceType=Read - 0x22, RequestLength=0, ResponseLength=10, ServiceId=65248
        AccessControls: NexteerSession=true, SecurityAccess=false
      SrvFEE0Wr: ServiceType=Write - 0x2E, RequestLength=10, ResponseLength=0, ServiceId=65248
        AccessControls: NexteerSession=true, SecurityAccess=true
      SrvFEE1Rd: ServiceType=Read - 0x22, RequestLength=0, ResponseLength=10, ServiceId=65249
        AccessControls: NexteerSession=true, SecurityAccess=false
      SrvFEE1Wr: ServiceType=Write - 0x2E, RequestLength=10, ResponseLength=0, ServiceId=65249
        AccessControls: NexteerSession=true, SecurityAccess=true
    18 x CommonService, all with Enabled=true:
      SrvFE00Rd: ServiceType=Read - 0x22, RequestLength=0, ResponseLength=256, ServiceId=65024
        AccessControls: NexteerSession=true, SecurityAccess=false
      SrvFE00Wr: ServiceType=Write - 0x2E, RequestLength=256, ResponseLength=0, ServiceId=65024, Application=Appl10
        AccessControls: NexteerSession=true, SecurityAccess=true
      SrvFE01Rd: ServiceType=Read - 0x22, RequestLength=0, ResponseLength=256, ServiceId=65025
        AccessControls: NexteerSession=true, SecurityAccess=false
      SrvFE01Wr: ServiceType=Write - 0x2E, RequestLength=256, ResponseLength=0, ServiceId=65025, Application=Appl10
        AccessControls: NexteerSession=true, SecurityAccess=true
      SrvFE02Rd: ServiceType=Read - 0x22, RequestLength=0, ResponseLength=256, ServiceId=65026
        AccessControls: NexteerSession=true, SecurityAccess=false
      SrvFE02Wr: ServiceType=Write - 0x2E, RequestLength=256, ResponseLength=0, ServiceId=65026, Application=Appl10
        AccessControls: NexteerSession=true, SecurityAccess=true
      SrvFE03Rd: ServiceType=Read - 0x22, RequestLength=0, ResponseLength=256, ServiceId=65027
        AccessControls: NexteerSession=true, SecurityAccess=false
      SrvFE03Wr: ServiceType=Write - 0x2E, RequestLength=256, ResponseLength=0, ServiceId=65027, Application=Appl10
        AccessControls: NexteerSession=true, SecurityAccess=true
      SrvFE08Rd: ServiceType=Read - 0x22, RequestLength=0, ResponseLength=18, ServiceId=65032
        AccessControls: NexteerSession=true, SecurityAccess=false
      SrvFE08Wr: ServiceType=Write - 0x2E, RequestLength=18, ResponseLength=0, ServiceId=65032, Application=Appl10
        AccessControls: NexteerSession=true, SecurityAccess=true
      SrvFE20RoutineStop: ServiceType=Routine - 0x31, RequestLength=4, ResponseLength=0, ServiceId=65056, SubFunction=2, Application=Appl10
        AccessControls: NexteerSession=false, SecurityAccess=false
      SrvFE20RoutineStrt: ServiceType=Routine - 0x31, RequestLength=8, ResponseLength=0, ServiceId=65056, SubFunction=1, Application=Appl10
        AccessControls: NexteerSession=true, SecurityAccess=true
      SrvFE21Rd: ServiceType=Read - 0x22, RequestLength=0, ResponseLength=28, ServiceId=65057
        AccessControls: NexteerSession=true, SecurityAccess=false
      SrvFE21Wr: ServiceType=Write - 0x2E, RequestLength=28, ResponseLength=0, ServiceId=65057, Application=Appl10
        AccessControls: NexteerSession=true, SecurityAccess=true
      SrvFEA0RoutineStrt: ServiceType=Routine - 0x31, RequestLength=0, ResponseLength=0, ServiceId=65184, SubFunction=1, Application=Appl10
        AccessControls: NexteerSession=true, SecurityAccess=true
      SrvFEA1RoutineStrt: ServiceType=Routine - 0x31, RequestLength=0, ResponseLength=0, ServiceId=65185, SubFunction=1, Application=Appl10
        AccessControls: NexteerSession=true, SecurityAccess=true
      SrvFEA2Rd: ServiceType=Read - 0x22, RequestLength=0, ResponseLength=4, ServiceId=65186
        AccessControls: NexteerSession=true, SecurityAccess=false
      SrvFEA2Wr: ServiceType=Write - 0x2E, RequestLength=4, ResponseLength=0, ServiceId=65186, Application=Appl10
        AccessControls: NexteerSession=true, SecurityAccess=true
    SrvFEE4Rd (ProgramSpecificService): ServiceType=Read - 0x22, RequestLength=0, ResponseLength=2, ServiceId=65252, Enabled=true
      AccessControls: NexteerSession=true, SecurityAccess=false
    SrvFEE4Wr (ProgramSpecificService): ServiceType=Write - 0x2E, RequestLength=2, ResponseLength=0, ServiceId=65252, Enabled=true, Application=Appl10
      AccessControls: NexteerSession=true, SecurityAccess=true
    19 x CommonService, all with Enabled=true:
      SrvF101RoutineStop: ServiceType=Routine - 0x31, RequestLength=0, ResponseLength=0, ServiceId=61697, SubFunction=2
        AccessControls: NexteerSession=true, SecurityAccess=true
      SrvF101RoutineStrt: ServiceType=Routine - 0x31, RequestLength=0, ResponseLength=0, ServiceId=61697, SubFunction=1
        AccessControls: NexteerSession=true, SecurityAccess=true
      SrvF101RoutineSts: ServiceType=Routine - 0x31, RequestLength=0, ResponseLength=1, ServiceId=61697, SubFunction=3
        AccessControls: NexteerSession=true, SecurityAccess=false
      SrvFE90Rd: ServiceType=Read - 0x22, RequestLength=0, ResponseLength=4, ServiceId=65168
        AccessControls: NexteerSession=true, SecurityAccess=false
      SrvFE90Wr: ServiceType=Write - 0x2E, RequestLength=4, ResponseLength=0, ServiceId=65168, Application=Appl10
        AccessControls: NexteerSession=true, SecurityAccess=true
      SrvFE98RoutineStrt: ServiceType=Routine - 0x31, RequestLength=0, ResponseLength=0, ServiceId=65176, SubFunction=1, Application=Appl10
        AccessControls: NexteerSession=true, SecurityAccess=true
      SrvFE99RoutineStrt: ServiceType=Routine - 0x31, RequestLength=0, ResponseLength=0, ServiceId=65177, SubFunction=1, Application=Appl10
        AccessControls: NexteerSession=true, SecurityAccess=true
      SrvFE9CRd: ServiceType=Read - 0x22, RequestLength=0, ResponseLength=5, ServiceId=65180
        AccessControls: NexteerSession=true, SecurityAccess=false
      SrvFE9CWr: ServiceType=Write - 0x2E, RequestLength=5, ResponseLength=0, ServiceId=65180, Application=Appl10
        AccessControls: NexteerSession=true, SecurityAccess=true
      SrvFE9DRd: ServiceType=Read - 0x22, RequestLength=0, ResponseLength=5, ServiceId=65181
        AccessControls: NexteerSession=true, SecurityAccess=false
      SrvFE9DWr: ServiceType=Write - 0x2E, RequestLength=5, ResponseLength=0, ServiceId=65181, Application=Appl10
        AccessControls: NexteerSession=true, SecurityAccess=true
      SrvFE9ERd: ServiceType=Read - 0x22, RequestLength=0, ResponseLength=5, ServiceId=65182
        AccessControls: NexteerSession=true, SecurityAccess=false
      SrvFE9EWr: ServiceType=Write - 0x2E, RequestLength=5, ResponseLength=0, ServiceId=65182, Application=Appl10
        AccessControls: NexteerSession=true, SecurityAccess=true
      SrvFE88RoutineStrt: ServiceType=Routine - 0x31, RequestLength=0, ResponseLength=0, ServiceId=65160, SubFunction=1, Application=Appl10
        AccessControls: NexteerSession=true, SecurityAccess=true
      SrvFE89RoutineStrt: ServiceType=Routine - 0x31, RequestLength=0, ResponseLength=0, ServiceId=65161, SubFunction=1, Application=Appl10
        AccessControls: NexteerSession=true, SecurityAccess=true
      SrvFE8ARd: ServiceType=Read - 0x22, RequestLength=0, ResponseLength=7, ServiceId=65162
        AccessControls: NexteerSession=true, SecurityAccess=false
      SrvFE8AWr: ServiceType=Write - 0x2E, RequestLength=7, ResponseLength=0, ServiceId=65162, Application=Appl10
        AccessControls: NexteerSession=true, SecurityAccess=true
      SrvFE8BRd: ServiceType=Read - 0x22, RequestLength=0, ResponseLength=1, ServiceId=65163
        AccessControls: NexteerSession=true, SecurityAccess=false
      SrvFE8BWr: ServiceType=Write - 0x2E, RequestLength=1, ResponseLength=0, ServiceId=65163, Application=Appl10
        AccessControls: NexteerSession=true, SecurityAccess=true
    4 x ProgramSpecificService, all with Enabled=true:
      SrvFEDBRd: ServiceType=Read - 0x22, RequestLength=0, ResponseLength=16, ServiceId=65243
        AccessControls: NexteerSession=true, SecurityAccess=false
      SrvFEDBWr: ServiceType=Write - 0x2E, RequestLength=16, ResponseLength=0, ServiceId=65243
        AccessControls: NexteerSession=true, SecurityAccess=true
      SrvFEDCRd: ServiceType=Read - 0x22, RequestLength=0, ResponseLength=822, ServiceId=65244
        AccessControls: NexteerSession=true, SecurityAccess=false
      SrvFEDCWr: ServiceType=Write - 0x2E, RequestLength=822, ResponseLength=0, ServiceId=65244
        AccessControls: NexteerSession=true, SecurityAccess=true
    44 x CommonService:
      SrvF002RoutineStrt: ServiceType=Routine - 0x31, RequestLength=0, ResponseLength=0, ServiceId=61442, SubFunction=1, Enabled=true
        AccessControls: NexteerSession=true, SecurityAccess=true
      SrvF11ARoutineStop: ServiceType=Routine - 0x31, RequestLength=0, ResponseLength=0, ServiceId=61722, SubFunction=2, Enabled=true
        AccessControls: NexteerSession=true, SecurityAccess=true
      SrvF11ARoutineStrt: ServiceType=Routine - 0x31, RequestLength=0, ResponseLength=0, ServiceId=61722, SubFunction=1, Enabled=true
        AccessControls: NexteerSession=true, SecurityAccess=true
      SrvF11ARoutineSts: ServiceType=Routine - 0x31, RequestLength=0, ResponseLength=1, ServiceId=61722, SubFunction=3, Enabled=true
        AccessControls: NexteerSession=true, SecurityAccess=false
      SrvF151RoutineStop: ServiceType=Routine - 0x31, RequestLength=0, ResponseLength=0, ServiceId=61777, SubFunction=2, Enabled=true
        AccessControls: NexteerSession=true, SecurityAccess=true
      SrvF151RoutineStrt: ServiceType=Routine - 0x31, RequestLength=0, ResponseLength=0, ServiceId=61777, SubFunction=1, Enabled=true
        AccessControls: NexteerSession=true, SecurityAccess=true
      SrvF151RoutineSts: ServiceType=Routine - 0x31, RequestLength=0, ResponseLength=1, ServiceId=61777, SubFunction=3, Enabled=true
        AccessControls: NexteerSession=true, SecurityAccess=false
      SrvFD05Rd: ServiceType=Read - 0x22, RequestLength=0, ResponseLength=8, ServiceId=64773, Enabled=true
        AccessControls: NexteerSession=true, SecurityAccess=true
      SrvFD05Wr: ServiceType=Write - 0x2E, RequestLength=8, ResponseLength=0, ServiceId=64773, Enabled=true
        AccessControls: NexteerSession=true, SecurityAccess=true
      SrvFD06Rd: ServiceType=Read - 0x22, RequestLength=0, ResponseLength=1, ServiceId=64774, Enabled=true
        AccessControls: NexteerSession=true, SecurityAccess=false
      SrvFD61Rd: ServiceType=Read - 0x22, RequestLength=0, ResponseLength=176, ServiceId=64865, Enabled=true
        AccessControls: NexteerSession=true, SecurityAccess=false
      SrvFD68RoutineStrt: ServiceType=Routine - 0x31, RequestLength=2, ResponseLength=5, ServiceId=64872, SubFunction=1, Enabled=true
        AccessControls: NexteerSession=true, SecurityAccess=false
      SrvFD71RoutineStrt: ServiceType=Routine - 0x31, RequestLength=0, ResponseLength=0, ServiceId=64881, SubFunction=1, Enabled=true, Application=Appl10
        AccessControls: NexteerSession=true, SecurityAccess=true
      SrvFEA8RoutineStrt: ServiceType=Routine - 0x31, RequestLength=0, ResponseLength=0, ServiceId=65192, SubFunction=1, Enabled=true, Application=Appl10
        AccessControls: NexteerSession=true, SecurityAccess=true
      SrvFEA9Rd: ServiceType=Read - 0x22, RequestLength=0, ResponseLength=8, ServiceId=65193, Enabled=true
        AccessControls: NexteerSession=true, SecurityAccess=false
      SrvFEB0RoutineStrt: ServiceType=Routine - 0x31, RequestLength=0, ResponseLength=0, ServiceId=65200, SubFunction=1, Enabled=true, Application=Appl10
        AccessControls: NexteerSession=true, SecurityAccess=true
      SrvFEB1RoutineStrt: ServiceType=Routine - 0x31, RequestLength=0, ResponseLength=0, ServiceId=65201, SubFunction=1, Enabled=true, Application=Appl10
        AccessControls: NexteerSession=true, SecurityAccess=true
      SrvSecuKey: ServiceType=Security - 0x27, RequestLength=4, ResponseLength=0, SubFunction=98, Enabled=true
        AccessControls: NexteerSession=true, SecurityAccess=false
      SrvSecuSeed: ServiceType=Security - 0x27, RequestLength=0, ResponseLength=4, SubFunction=97, Enabled=true
        AccessControls: NexteerSession=true, SecurityAccess=false
      SrvFDAFRoutineStrt: ServiceType=Routine - 0x31, RequestLength=0, ResponseLength=0, ServiceId=64943, SubFunction=1, Enabled=false
        AccessControls: NexteerSession=true, SecurityAccess=true
      SrvFDA4RoutineStrt: ServiceType=Routine - 0x31, RequestLength=0, ResponseLength=0, ServiceId=64932, SubFunction=1, Enabled=false
        AccessControls: NexteerSession=true, SecurityAccess=true
      SrvFDB4Wr: ServiceType=Write - 0x2E, RequestLength=4, ResponseLength=0, ServiceId=64948, Enabled=false
        AccessControls: NexteerSession=true, SecurityAccess=true
      SrvFDA5RoutineStrt: ServiceType=Routine - 0x31, RequestLength=0, ResponseLength=0, ServiceId=64933, SubFunction=1, Enabled=false
        AccessControls: NexteerSession=true, SecurityAccess=true
      SrvFDB5Wr: ServiceType=Write - 0x2E, RequestLength=4, ResponseLength=0, ServiceId=64949, Enabled=false
        AccessControls: NexteerSession=true, SecurityAccess=true
      SrvFEAARoutineStrt: ServiceType=Routine - 0x31, RequestLength=0, ResponseLength=0, ServiceId=65194, SubFunction=1, Enabled=true
        AccessControls: NexteerSession=true, SecurityAccess=true
      SrvFDBCRd: ServiceType=Read - 0x22, RequestLength=0, ResponseLength=1, ServiceId=64956, Enabled=false
        AccessControls: NexteerSession=true, SecurityAccess=false
      SrvFDADRoutineStrt: ServiceType=Routine - 0x31, RequestLength=0, ResponseLength=0, ServiceId=64941, SubFunction=1, Enabled=false
        AccessControls: NexteerSession=true, SecurityAccess=true
      SrvFEABRd: ServiceType=Read - 0x22, RequestLength=0, ResponseLength=1, ServiceId=65195, Enabled=true
        AccessControls: NexteerSession=true, SecurityAccess=false
      SrvFDB6Wr: ServiceType=Write - 0x2E, RequestLength=4, ResponseLength=0, ServiceId=64950, Enabled=false
        AccessControls: NexteerSession=true, SecurityAccess=true
      SrvRstHard: ServiceType=Reset - 0x11, RequestLength=0, ResponseLength=0, SubFunction=97, Enabled=true
        AccessControls: NexteerSession=true, SecurityAccess=true
      SrvFDBDRd: ServiceType=Read - 0x22, RequestLength=0, ResponseLength=1, ServiceId=64957, Enabled=false
        AccessControls: NexteerSession=true, SecurityAccess=false
      SrvFDB4Rd: ServiceType=Read - 0x22, RequestLength=0, ResponseLength=4, ServiceId=64948, Enabled=false
        AccessControls: NexteerSession=true, SecurityAccess=false
      SrvRstSoft: ServiceType=Reset - 0x11, RequestLength=0, ResponseLength=0, SubFunction=96, Enabled=true
        AccessControls: NexteerSession=true, SecurityAccess=true
      SrvFDB7Wr: ServiceType=Write - 0x2E, RequestLength=4, ResponseLength=0, ServiceId=64951, Enabled=false
        AccessControls: NexteerSession=true, SecurityAccess=true
      SrvFDBERd: ServiceType=Read - 0x22, RequestLength=0, ResponseLength=1, ServiceId=64958, Enabled=false
        AccessControls: NexteerSession=true, SecurityAccess=false
      SrvFE8CRd: ServiceType=Read - 0x22, RequestLength=0, ResponseLength=212, ServiceId=65164, Enabled=true
        AccessControls: NexteerSession=true, SecurityAccess=false
      SrvFDB5Rd: ServiceType=Read - 0x22, RequestLength=0, ResponseLength=4, ServiceId=64949, Enabled=false
        AccessControls: NexteerSession=true, SecurityAccess=false
      SrvFDACRoutineStrt: ServiceType=Routine - 0x31, RequestLength=0, ResponseLength=0, ServiceId=64940, SubFunction=1, Enabled=false
        AccessControls: NexteerSession=true, SecurityAccess=true
      SrvFDBFRd: ServiceType=Read - 0x22, RequestLength=0, ResponseLength=1, ServiceId=64959, Enabled=false
        AccessControls: NexteerSession=true, SecurityAccess=false
      SrvFEABWr: ServiceType=Write - 0x2E, RequestLength=1, ResponseLength=0, ServiceId=65195, Enabled=true
        AccessControls: NexteerSession=false, SecurityAccess=false
      SrvFDB6Rd: ServiceType=Read - 0x22, RequestLength=0, ResponseLength=4, ServiceId=64950, Enabled=false
        AccessControls: NexteerSession=true, SecurityAccess=false
      SrvFDB7Rd: ServiceType=Read - 0x22, RequestLength=0, ResponseLength=4, ServiceId=64951, Enabled=false
        AccessControls: NexteerSession=true, SecurityAccess=false
      SrvFE8CWr: ServiceType=Write - 0x2E, RequestLength=212, ResponseLength=0, ServiceId=65164, Enabled=true
        AccessControls: NexteerSession=true, SecurityAccess=true
      SrvFDAERoutineStrt: ServiceType=Routine - 0x31, RequestLength=0, ResponseLength=0, ServiceId=64942, SubFunction=1, Enabled=false
        AccessControls: NexteerSession=true, SecurityAccess=true
