AUTOSAR XML (schema 4-0-3)
package /ActiveEcuC
  module config NxtrSwIds: implementation-config-variant=VARIANT-PRE-COMPILE
    NxtrSwIdsGeneral: SwRelNr=T1xx, SwRelVer=07.02.01, PrototypeBuild=false
