AUTOSAR XML (schema 4-0-3)
package /ActiveEcuC
  module config Spi: implementation-config-variant=VARIANT-POST-BUILD-LOADABLE, module-description=Spi_Impl
    SpiGeneral:
      SpiCancelApi = false
      SpiChannelBuffersAllowed = 0
      SpiDevErrorDetect = true
      SpiHwStatusApi = false
      SpiInterruptibleSeqAllowed = false
      SpiLevelDelivered = 1
      SpiSupportConcurrentSyncTransmit = false
      SpiVersionInfoApi = false
      SpiDmaMode = false
      SpiDmaTypeUsed = SPI_DMA_TYPE_TWO
      SpiDataConsistencyCheckEnable = true
      SpiDataWidthSelection = BITS_16
      SpiCriticalSectionProtection = true
      SpiVersionCheckExternalModules = false
      SpiHighPriorityHwHandlingEnable = false
      SpiDeviceName = R7F701311
      SpiAlreadyInitDetCheck = true
      SpiSeqStartNotificationEnable = false
      SpiSyncSeqEndNotificationEnable = false
      SpiPersistentHWConfiguration = true
      SpiMaxBaudrate = PCLK_DIV_BY_8
      SpiTimeOut = 65535
    SpiDriver: SpiMaxChannel=67, SpiMaxJob=67, SpiMaxSequence=67
      GateDrv0Cfg0Ch (SpiChannel): SpiChannelId=0, SpiChannelType=IB, SpiDataWidth=15, SpiEbMaxLength=1, SpiIbNBuffers=1, SpiTransferStart=MSB, SpiDefaultData=0
      SpiDemEventParameterRefs: SPI_E_HARDWARE_ERROR=SPI_E_HARDWARE_ERROR, SPI_E_DATA_TX_TIMEOUT_FAILURE=SPI_E_DATA_TX_TIMEOUT_FAILURE
      GateDriver0 (SpiExternalDevice):
        SpiBaudrate = 0
        SpiBaudrateConfiguration = 10
        SpiCsIdentifier = NULL
        SpiCsPolarity = LOW
        SpiDataShiftEdge = LEADING
        SpiEnableCs = true
        SpiHwUnit = CSIH2
        SpiShiftClockIdleLevel = HIGH
        SpiTimeClk2Cs = 0
        SpiClk2CsCount = 5
        SpiInputClockSelect = PCLK_DIVBY_4
        SpiInterruptDelayMode = false
        SpiParitySelection = ODD_PARITY
        SpiFifoTimeOut = 0
        SpiBroadcastingPriority = DOMINANT
        SpiBaudrateRegisterSelect = CSIH_BAUDRATE_REGISTER_0
        SpiCsHoldTiming = HOLD_TIME_0_POINT_5
        SpiCsIdleEnforcement = true
        SpiCsIdleTiming = IDLE_TIME_3_POINT_5
        SpiCsInactiveAfterLastData = true
        SpiCsInterDataDelay = INTER_DATA_TIME_0_POINT_5
        SpiCsSetupTime = SETUP_TIME_0_POINT_5
        SpiCsSelection = CS_VIA_PERIPHERAL_ENGINE
        SpiClockFrequencyRef = McuHighspeedPeriClk0
      GateDrv0Cfg0Job (SpiJob): SpiJobId=0, SpiJobPriority=3, SpiHwUnitSynchronous=ASYNCHRONOUS, SpiPortPinSelect=CSL0, SpiJobEndNotification=NULL, SpiDeviceAssignment=GateDriver0
        SpiChannelList: SpiChannelIndex=0, SpiChannelAssignment=GateDrv0Cfg0Ch
      GateDrv0Cfg0Seq (SpiSequence):
        SpiInterruptibleSequence = false
        SpiSeqStartNotification = NULL
        SpiHighPriorityHwSequence = false
        SpiSequenceId = 0
        SpiSeqEndNotification = NULL
        SpiJobAssignment = GateDrv0Cfg0Job
      GateDriver0MemoryMode (SpiMemoryMode): SpiHwUnitSelection=CSIH2, SpiMemoryModeSelection=DIRECT_ACCESS_MODE
      GateDrv0Cfg1Job (SpiJob): SpiJobId=1, SpiJobPriority=3, SpiHwUnitSynchronous=ASYNCHRONOUS, SpiPortPinSelect=CSL0, SpiJobEndNotification=NULL, SpiDeviceAssignment=GateDriver0
        SpiChannelList: SpiChannelIndex=0, SpiChannelAssignment=GateDrv0Cfg1Ch
      51 x SpiChannel, all with SpiChannelType=IB, SpiDataWidth=15, SpiEbMaxLength=1, SpiIbNBuffers=1, SpiTransferStart=MSB, SpiDefaultData=0:
        GateDrv0Cfg{1..13}Ch: SpiChannelId={1..13}
        GateDrv0VrfyCmd0Ch: SpiChannelId=14
        GateDrv0VrfyCmd1Ch: SpiChannelId=15
        GateDrv0VrfyCmd2Ch: SpiChannelId=16
        GateDrv0VrfyRes0Ch: SpiChannelId=17
        GateDrv0Mask0Ch: SpiChannelId=19
        GateDrv0Mask1Ch: SpiChannelId=20
        GateDrv0Mask2Ch: SpiChannelId=21
        GateDrv0VrfyRes1Ch: SpiChannelId=18
        GateDrv0Diag0Ch: SpiChannelId=22
        GateDrv0Diag1Ch: SpiChannelId=23
        GateDrv0Diag2Ch: SpiChannelId=24
        GateDrv0CtrlCh: SpiChannelId=25
        GateDrv1Cfg0Ch: SpiChannelId=26
        GateDrv1Cfg10Ch: SpiChannelId=36
        GateDrv1Cfg11Ch: SpiChannelId=37
        GateDrv1Cfg12Ch: SpiChannelId=38
        GateDrv1Cfg13Ch: SpiChannelId=39
        GateDrv1Cfg1Ch: SpiChannelId=27
        GateDrv1Cfg2Ch: SpiChannelId=28
        GateDrv1Cfg3Ch: SpiChannelId=29
        GateDrv1Cfg4Ch: SpiChannelId=30
        GateDrv1Cfg5Ch: SpiChannelId=31
        GateDrv1Cfg6Ch: SpiChannelId=32
        GateDrv1Cfg7Ch: SpiChannelId=33
        GateDrv1Cfg8Ch: SpiChannelId=34
        GateDrv1Cfg9Ch: SpiChannelId=35
        GateDrv1Diag0Ch: SpiChannelId=48
        GateDrv1Diag1Ch: SpiChannelId=49
        GateDrv1Diag2Ch: SpiChannelId=50
        GateDrv1CtrlCh: SpiChannelId=51
        GateDrv1VrfyCmd0Ch: SpiChannelId=40
        GateDrv1VrfyCmd1Ch: SpiChannelId=41
        GateDrv1VrfyCmd2Ch: SpiChannelId=42
        GateDrv1VrfyRes0Ch: SpiChannelId=43
        GateDrv1Mask0Ch: SpiChannelId=45
        GateDrv1Mask1Ch: SpiChannelId=46
        GateDrv1Mask2Ch: SpiChannelId=47
        GateDrv1VrfyRes1Ch: SpiChannelId=44
      GateDriver1 (SpiExternalDevice):
        SpiBaudrate = 0
        SpiBaudrateConfiguration = 10
        SpiCsIdentifier = NULL
        SpiCsPolarity = LOW
        SpiDataShiftEdge = LEADING
        SpiEnableCs = true
        SpiHwUnit = CSIH0
        SpiShiftClockIdleLevel = HIGH
        SpiTimeClk2Cs = 0
        SpiClk2CsCount = 5
        SpiInputClockSelect = PCLK_DIVBY_4
        SpiInterruptDelayMode = false
        SpiParitySelection = ODD_PARITY
        SpiFifoTimeOut = 0
        SpiBroadcastingPriority = DOMINANT
        SpiBaudrateRegisterSelect = CSIH_BAUDRATE_REGISTER_0
        SpiCsHoldTiming = HOLD_TIME_0_POINT_5
        SpiCsIdleEnforcement = true
        SpiCsIdleTiming = IDLE_TIME_3_POINT_5
        SpiCsInactiveAfterLastData = true
        SpiCsInterDataDelay = INTER_DATA_TIME_0_POINT_5
        SpiCsSetupTime = SETUP_TIME_0_POINT_5
        SpiCsSelection = CS_VIA_PERIPHERAL_ENGINE
        SpiClockFrequencyRef = McuHighspeedPeriClk0
      50 x SpiJob, all with SpiJobPriority=3, SpiHwUnitSynchronous=ASYNCHRONOUS, SpiJobEndNotification=NULL:
        GateDrv0Cfg2Job: SpiJobId=2, SpiPortPinSelect=CSL0, SpiDeviceAssignment=GateDriver0
          SpiChannelList: SpiChannelIndex=0, SpiChannelAssignment=GateDrv0Cfg2Ch
        GateDrv0Cfg3Job: SpiJobId=3, SpiPortPinSelect=CSL0, SpiDeviceAssignment=GateDriver0
          SpiChannelList: SpiChannelIndex=0, SpiChannelAssignment=GateDrv0Cfg3Ch
        GateDrv0Cfg7Job: SpiJobId=7, SpiPortPinSelect=CSL0, SpiDeviceAssignment=GateDriver0
          SpiChannelList: SpiChannelIndex=0, SpiChannelAssignment=GateDrv0Cfg7Ch
        GateDrv0Cfg4Job: SpiJobId=4, SpiPortPinSelect=CSL0, SpiDeviceAssignment=GateDriver0
          SpiChannelList: SpiChannelIndex=0, SpiChannelAssignment=GateDrv0Cfg4Ch
        GateDrv0Cfg9Job: SpiJobId=9, SpiPortPinSelect=CSL0, SpiDeviceAssignment=GateDriver0
          SpiChannelList: SpiChannelIndex=0, SpiChannelAssignment=GateDrv0Cfg9Ch
        GateDrv0Cfg5Job: SpiJobId=5, SpiPortPinSelect=CSL0, SpiDeviceAssignment=GateDriver0
          SpiChannelList: SpiChannelIndex=0, SpiChannelAssignment=GateDrv0Cfg5Ch
        GateDrv0Cfg8Job: SpiJobId=8, SpiPortPinSelect=CSL0, SpiDeviceAssignment=GateDriver0
          SpiChannelList: SpiChannelIndex=0, SpiChannelAssignment=GateDrv0Cfg8Ch
        GateDrv0Cfg6Job: SpiJobId=6, SpiPortPinSelect=CSL0, SpiDeviceAssignment=GateDriver0
          SpiChannelList: SpiChannelIndex=0, SpiChannelAssignment=GateDrv0Cfg6Ch
        GateDrv0Cfg10Job: SpiJobId=10, SpiPortPinSelect=CSL0, SpiDeviceAssignment=GateDriver0
          SpiChannelList: SpiChannelIndex=0, SpiChannelAssignment=GateDrv0Cfg10Ch
        GateDrv0Cfg12Job: SpiJobId=12, SpiPortPinSelect=CSL0, SpiDeviceAssignment=GateDriver0
          SpiChannelList: SpiChannelIndex=0, SpiChannelAssignment=GateDrv0Cfg12Ch
        GateDrv0Cfg11Job: SpiJobId=11, SpiPortPinSelect=CSL0, SpiDeviceAssignment=GateDriver0
          SpiChannelList: SpiChannelIndex=0, SpiChannelAssignment=GateDrv0Cfg11Ch
        GateDrv0Cfg13Job: SpiJobId=13, SpiPortPinSelect=CSL0, SpiDeviceAssignment=GateDriver0
          SpiChannelList: SpiChannelIndex=0, SpiChannelAssignment=GateDrv0Cfg13Ch
        GateDrv0Mask0Job: SpiJobId=19, SpiPortPinSelect=CSL0, SpiDeviceAssignment=GateDriver0
          SpiChannelList: SpiChannelIndex=0, SpiChannelAssignment=GateDrv0Mask0Ch
        GateDrv0Mask1Job: SpiJobId=20, SpiPortPinSelect=CSL0, SpiDeviceAssignment=GateDriver0
          SpiChannelList: SpiChannelIndex=0, SpiChannelAssignment=GateDrv0Mask1Ch
        GateDrv0Mask2Job: SpiJobId=21, SpiPortPinSelect=CSL0, SpiDeviceAssignment=GateDriver0
          SpiChannelList: SpiChannelIndex=0, SpiChannelAssignment=GateDrv0Mask2Ch
        GateDrv0VrfyCmd0Job: SpiJobId=14, SpiPortPinSelect=CSL0, SpiDeviceAssignment=GateDriver0
          SpiChannelList: SpiChannelIndex=0, SpiChannelAssignment=GateDrv0VrfyCmd0Ch
        GateDrv0VrfyCmd1Job: SpiJobId=15, SpiPortPinSelect=CSL0, SpiDeviceAssignment=GateDriver0
          SpiChannelList: SpiChannelIndex=0, SpiChannelAssignment=GateDrv0VrfyCmd1Ch
        GateDrv0VrfyCmd2Job: SpiJobId=16, SpiPortPinSelect=CSL0, SpiDeviceAssignment=GateDriver0
          SpiChannelList: SpiChannelIndex=0, SpiChannelAssignment=GateDrv0VrfyCmd2Ch
        GateDrv0VrfyRes0Job: SpiJobId=17, SpiPortPinSelect=CSL0, SpiDeviceAssignment=GateDriver0
          SpiChannelList: SpiChannelIndex=0, SpiChannelAssignment=GateDrv0VrfyRes0Ch
        GateDrv0VrfyRes1Job: SpiJobId=18, SpiPortPinSelect=CSL0, SpiDeviceAssignment=GateDriver0
          SpiChannelList: SpiChannelIndex=0, SpiChannelAssignment=GateDrv0VrfyRes1Ch
        GateDrv0Diag0Job: SpiJobId=22, SpiPortPinSelect=CSL0, SpiDeviceAssignment=GateDriver0
          SpiChannelList: SpiChannelIndex=0, SpiChannelAssignment=GateDrv0Diag0Ch
        GateDrv0Diag1Job: SpiJobId=23, SpiPortPinSelect=CSL0, SpiDeviceAssignment=GateDriver0
          SpiChannelList: SpiChannelIndex=0, SpiChannelAssignment=GateDrv0Diag1Ch
        GateDrv0Diag2Job: SpiJobId=24, SpiPortPinSelect=CSL0, SpiDeviceAssignment=GateDriver0
          SpiChannelList: SpiChannelIndex=0, SpiChannelAssignment=GateDrv0Diag2Ch
        GateDrv0CtrlJob: SpiJobId=25, SpiPortPinSelect=CSL0, SpiDeviceAssignment=GateDriver0
          SpiChannelList: SpiChannelIndex=0, SpiChannelAssignment=GateDrv0CtrlCh
        GateDrv1Cfg0Job: SpiJobId=26, SpiPortPinSelect=CSL2, SpiDeviceAssignment=GateDriver1
          SpiChannelList: SpiChannelIndex=0, SpiChannelAssignment=GateDrv1Cfg0Ch
        GateDrv1CtrlJob: SpiJobId=51, SpiPortPinSelect=CSL2, SpiDeviceAssignment=GateDriver1
          SpiChannelList: SpiChannelIndex=0, SpiChannelAssignment=GateDrv1CtrlCh
        GateDrv1Diag0Job: SpiJobId=48, SpiPortPinSelect=CSL2, SpiDeviceAssignment=GateDriver1
          SpiChannelList: SpiChannelIndex=0, SpiChannelAssignment=GateDrv1Diag0Ch
        GateDrv1Diag1Job: SpiJobId=49, SpiPortPinSelect=CSL2, SpiDeviceAssignment=GateDriver1
          SpiChannelList: SpiChannelIndex=0, SpiChannelAssignment=GateDrv1Diag1Ch
        GateDrv1Diag2Job: SpiJobId=50, SpiPortPinSelect=CSL2, SpiDeviceAssignment=GateDriver1
          SpiChannelList: SpiChannelIndex=0, SpiChannelAssignment=GateDrv1Diag2Ch
        GateDrv1VrfyRes0Job: SpiJobId=43, SpiPortPinSelect=CSL2, SpiDeviceAssignment=GateDriver1
          SpiChannelList: SpiChannelIndex=0, SpiChannelAssignment=GateDrv1VrfyRes0Ch
        GateDrv1VrfyRes1Job: SpiJobId=44, SpiPortPinSelect=CSL2, SpiDeviceAssignment=GateDriver1
          SpiChannelList: SpiChannelIndex=0, SpiChannelAssignment=GateDrv1VrfyRes1Ch
        GateDrv1VrfyCmd0Job: SpiJobId=40, SpiPortPinSelect=CSL2, SpiDeviceAssignment=GateDriver1
          SpiChannelList: SpiChannelIndex=0, SpiChannelAssignment=GateDrv1VrfyCmd0Ch
        GateDrv1VrfyCmd1Job: SpiJobId=41, SpiPortPinSelect=CSL2, SpiDeviceAssignment=GateDriver1
          SpiChannelList: SpiChannelIndex=0, SpiChannelAssignment=GateDrv1VrfyCmd1Ch
        GateDrv1VrfyCmd2Job: SpiJobId=42, SpiPortPinSelect=CSL2, SpiDeviceAssignment=GateDriver1
          SpiChannelList: SpiChannelIndex=0, SpiChannelAssignment=GateDrv1VrfyCmd2Ch
        GateDrv1Mask0Job: SpiJobId=45, SpiPortPinSelect=CSL2, SpiDeviceAssignment=GateDriver1
          SpiChannelList: SpiChannelIndex=0, SpiChannelAssignment=GateDrv1Mask0Ch
        GateDrv1Mask1Job: SpiJobId=46, SpiPortPinSelect=CSL2, SpiDeviceAssignment=GateDriver1
          SpiChannelList: SpiChannelIndex=0, SpiChannelAssignment=GateDrv1Mask1Ch
        GateDrv1Mask2Job: SpiJobId=47, SpiPortPinSelect=CSL2, SpiDeviceAssignment=GateDriver1
          SpiChannelList: SpiChannelIndex=0, SpiChannelAssignment=GateDrv1Mask2Ch
        GateDrv1Cfg1Job: SpiJobId=27, SpiPortPinSelect=CSL2, SpiDeviceAssignment=GateDriver1
          SpiChannelList: SpiChannelIndex=0, SpiChannelAssignment=GateDrv1Cfg1Ch
        GateDrv1Cfg2Job: SpiJobId=28, SpiPortPinSelect=CSL2, SpiDeviceAssignment=GateDriver1
          SpiChannelList: SpiChannelIndex=0, SpiChannelAssignment=GateDrv1Cfg2Ch
        GateDrv1Cfg3Job: SpiJobId=29, SpiPortPinSelect=CSL2, SpiDeviceAssignment=GateDriver1
          SpiChannelList: SpiChannelIndex=0, SpiChannelAssignment=GateDrv1Cfg3Ch
        GateDrv1Cfg7Job: SpiJobId=33, SpiPortPinSelect=CSL2, SpiDeviceAssignment=GateDriver1
          SpiChannelList: SpiChannelIndex=0, SpiChannelAssignment=GateDrv1Cfg7Ch
        GateDrv1Cfg4Job: SpiJobId=30, SpiPortPinSelect=CSL2, SpiDeviceAssignment=GateDriver1
          SpiChannelList: SpiChannelIndex=0, SpiChannelAssignment=GateDrv1Cfg4Ch
        GateDrv1Cfg9Job: SpiJobId=35, SpiPortPinSelect=CSL2, SpiDeviceAssignment=GateDriver1
          SpiChannelList: SpiChannelIndex=0, SpiChannelAssignment=GateDrv1Cfg9Ch
        GateDrv1Cfg5Job: SpiJobId=31, SpiPortPinSelect=CSL2, SpiDeviceAssignment=GateDriver1
          SpiChannelList: SpiChannelIndex=0, SpiChannelAssignment=GateDrv1Cfg5Ch
        GateDrv1Cfg8Job: SpiJobId=34, SpiPortPinSelect=CSL2, SpiDeviceAssignment=GateDriver1
          SpiChannelList: SpiChannelIndex=0, SpiChannelAssignment=GateDrv1Cfg8Ch
        GateDrv1Cfg6Job: SpiJobId=32, SpiPortPinSelect=CSL2, SpiDeviceAssignment=GateDriver1
          SpiChannelList: SpiChannelIndex=0, SpiChannelAssignment=GateDrv1Cfg6Ch
        GateDrv1Cfg10Job: SpiJobId=36, SpiPortPinSelect=CSL2, SpiDeviceAssignment=GateDriver1
          SpiChannelList: SpiChannelIndex=0, SpiChannelAssignment=GateDrv1Cfg10Ch
        GateDrv1Cfg12Job: SpiJobId=38, SpiPortPinSelect=CSL2, SpiDeviceAssignment=GateDriver1
          SpiChannelList: SpiChannelIndex=0, SpiChannelAssignment=GateDrv1Cfg12Ch
        GateDrv1Cfg11Job: SpiJobId=37, SpiPortPinSelect=CSL2, SpiDeviceAssignment=GateDriver1
          SpiChannelList: SpiChannelIndex=0, SpiChannelAssignment=GateDrv1Cfg11Ch
        GateDrv1Cfg13Job: SpiJobId=39, SpiPortPinSelect=CSL2, SpiDeviceAssignment=GateDriver1
          SpiChannelList: SpiChannelIndex=0, SpiChannelAssignment=GateDrv1Cfg13Ch
      GateDriver1MemoryMode (SpiMemoryMode): SpiHwUnitSelection=CSIH0, SpiMemoryModeSelection=DIRECT_ACCESS_MODE
      51 x SpiSequence, all with SpiInterruptibleSequence=false, SpiSeqStartNotification=NULL, SpiHighPriorityHwSequence=false, SpiSeqEndNotification=NULL:
        GateDrv0Cfg{1..3}Seq: SpiSequenceId={1..3}, SpiJobAssignment=GateDrv0Cfg{1..3}Job
        GateDrv0Cfg6Seq: SpiSequenceId=6, SpiJobAssignment=GateDrv0Cfg6Job
        GateDrv0Cfg4Seq: SpiSequenceId=4, SpiJobAssignment=GateDrv0Cfg4Job
        GateDrv0Cfg8Seq: SpiSequenceId=8, SpiJobAssignment=GateDrv0Cfg8Job
        GateDrv0Cfg5Seq: SpiSequenceId=5, SpiJobAssignment=GateDrv0Cfg5Job
        GateDrv0Cfg7Seq: SpiSequenceId=7, SpiJobAssignment=GateDrv0Cfg7Job
        GateDrv0Cfg10Seq: SpiSequenceId=10, SpiJobAssignment=GateDrv0Cfg10Job
        GateDrv0Cfg9Seq: SpiSequenceId=9, SpiJobAssignment=GateDrv0Cfg9Job
        GateDrv0Cfg12Seq: SpiSequenceId=12, SpiJobAssignment=GateDrv0Cfg12Job
        GateDrv0Cfg11Seq: SpiSequenceId=11, SpiJobAssignment=GateDrv0Cfg11Job
        GateDrv0Cfg13Seq: SpiSequenceId=13, SpiJobAssignment=GateDrv0Cfg13Job
        GateDrv0VrfyCmd0Seq: SpiSequenceId=14, SpiJobAssignment=GateDrv0VrfyCmd0Job
        GateDrv0VrfyCmd2Seq: SpiSequenceId=16, SpiJobAssignment=GateDrv0VrfyCmd2Job
        GateDrv0VrfyCmd1Seq: SpiSequenceId=15, SpiJobAssignment=GateDrv0VrfyCmd1Job
        GateDrv0VrfyRes0Seq: SpiSequenceId=17, SpiJobAssignment=GateDrv0VrfyRes0Job
        GateDrv0VrfyRes1Seq: SpiSequenceId=18, SpiJobAssignment=GateDrv0VrfyRes1Job
        GateDrv0Mask0Seq: SpiSequenceId=19, SpiJobAssignment=GateDrv0Mask0Job
        GateDrv0Mask1Seq: SpiSequenceId=20, SpiJobAssignment=GateDrv0Mask1Job
        GateDrv0Mask2Seq: SpiSequenceId=21, SpiJobAssignment=GateDrv0Mask2Job
        GateDrv0Diag0Seq: SpiSequenceId=22, SpiJobAssignment=GateDrv0Diag0Job
        GateDrv0Diag1Seq: SpiSequenceId=23, SpiJobAssignment=GateDrv0Diag1Job
        GateDrv0Diag2Seq: SpiSequenceId=24, SpiJobAssignment=GateDrv0Diag2Job
        GateDrv0CtrlSeq: SpiSequenceId=25, SpiJobAssignment=GateDrv0CtrlJob
        GateDrv1Cfg0Seq: SpiSequenceId=26, SpiJobAssignment=GateDrv1Cfg0Job
        GateDrv1Cfg1Seq: SpiSequenceId=27, SpiJobAssignment=GateDrv1Cfg1Job
        GateDrv1Cfg2Seq: SpiSequenceId=28, SpiJobAssignment=GateDrv1Cfg2Job
        GateDrv1Cfg3Seq: SpiSequenceId=29, SpiJobAssignment=GateDrv1Cfg3Job
        GateDrv1Cfg4Seq: SpiSequenceId=30, SpiJobAssignment=GateDrv1Cfg4Job
        GateDrv1Cfg5Seq: SpiSequenceId=31, SpiJobAssignment=GateDrv1Cfg5Job
        GateDrv1Cfg6Seq: SpiSequenceId=32, SpiJobAssignment=GateDrv1Cfg6Job
        GateDrv1Cfg7Seq: SpiSequenceId=33, SpiJobAssignment=GateDrv1Cfg7Job
        GateDrv1Cfg8Seq: SpiSequenceId=34, SpiJobAssignment=GateDrv1Cfg8Job
        GateDrv1Cfg9Seq: SpiSequenceId=35, SpiJobAssignment=GateDrv1Cfg9Job
        GateDrv1Cfg10Seq: SpiSequenceId=36, SpiJobAssignment=GateDrv1Cfg10Job
        GateDrv1Cfg11Seq: SpiSequenceId=37, SpiJobAssignment=GateDrv1Cfg11Job
        GateDrv1Cfg12Seq: SpiSequenceId=38, SpiJobAssignment=GateDrv1Cfg12Job
        GateDrv1Cfg13Seq: SpiSequenceId=39, SpiJobAssignment=GateDrv1Cfg13Job
        GateDrv1VrfyCmd0Seq: SpiSequenceId=40, SpiJobAssignment=GateDrv1VrfyCmd0Job
        GateDrv1VrfyCmd1Seq: SpiSequenceId=41, SpiJobAssignment=GateDrv1VrfyCmd1Job
        GateDrv1VrfyCmd2Seq: SpiSequenceId=42, SpiJobAssignment=GateDrv1VrfyCmd2Job
        GateDrv1VrfyRes0Seq: SpiSequenceId=43, SpiJobAssignment=GateDrv1VrfyRes0Job
        GateDrv1VrfyRes1Seq: SpiSequenceId=44, SpiJobAssignment=GateDrv1VrfyRes1Job
        GateDrv1Mask0Seq: SpiSequenceId=45, SpiJobAssignment=GateDrv1Mask0Job
        GateDrv1Mask1Seq: SpiSequenceId=46, SpiJobAssignment=GateDrv1Mask1Job
        GateDrv1Mask2Seq: SpiSequenceId=47, SpiJobAssignment=GateDrv1Mask2Job
        GateDrv1Diag0Seq: SpiSequenceId=48, SpiJobAssignment=GateDrv1Diag0Job
        GateDrv1Diag1Seq: SpiSequenceId=49, SpiJobAssignment=GateDrv1Diag1Job
        GateDrv1Diag2Seq: SpiSequenceId=50, SpiJobAssignment=GateDrv1Diag2Job
        GateDrv1CtrlSeq: SpiSequenceId=51, SpiJobAssignment=GateDrv1CtrlJob
      15 x SpiChannel, all with SpiChannelType=IB, SpiDataWidth=15, SpiEbMaxLength=1, SpiIbNBuffers=1, SpiTransferStart=MSB, SpiDefaultData=0:
        TmplMonrCh1: SpiChannelId=52
        TmplMonrCh2: SpiChannelId=53
        TmplMonrCh3: SpiChannelId=54
        TmplMonrCh4: SpiChannelId=55
        TmplMonrCh5: SpiChannelId=56
        PwrSplyCh3: SpiChannelId=59
        PwrSplyCh1: SpiChannelId=57
        PwrSplyCh4: SpiChannelId=60
        PwrSplyCh2: SpiChannelId=58
        PwrSplyCh5: SpiChannelId=61
        PwrSplyCh6: SpiChannelId=62
        PwrSplyCh7: SpiChannelId=63
        PwrSplyCh8: SpiChannelId=64
        PwrSplyCh9: SpiChannelId=65
        PwrSplyCh10: SpiChannelId=66
      PwrSplyTmplMonr (SpiExternalDevice):
        SpiBaudrate = 0
        SpiBaudrateConfiguration = 10
        SpiCsIdentifier = NULL
        SpiCsPolarity = LOW
        SpiDataShiftEdge = LEADING
        SpiEnableCs = true
        SpiHwUnit = CSIG0
        SpiShiftClockIdleLevel = HIGH
        SpiTimeClk2Cs = 0
        SpiClk2CsCount = 5
        SpiInputClockSelect = PCLK_DIVBY_4
        SpiInterruptDelayMode = false
        SpiParitySelection = ODD_PARITY
        SpiFifoTimeOut = 0
        SpiBroadcastingPriority = DOMINANT
        SpiCsHoldTiming = HOLD_TIME_0_POINT_5
        SpiCsIdleEnforcement = true
        SpiCsIdleTiming = IDLE_TIME_3_POINT_5
        SpiCsInactiveAfterLastData = true
        SpiCsInterDataDelay = INTER_DATA_TIME_0_POINT_5
        SpiCsSelection = CS_VIA_GPIO
        SpiCsSetupTime = SETUP_TIME_0_POINT_5
        SpiClockFrequencyRef = McuHighspeedPeriClk0
      15 x SpiJob, all with SpiJobPriority=3, SpiHwUnitSynchronous=ASYNCHRONOUS, SpiJobEndNotification=NULL, SpiPortPinSelect=PORTGROUP_5_PORTPIN_9, SpiDeviceAssignment=PwrSplyTmplMonr:
        TmplMonrJob1: SpiJobId=52
          SpiChannelList: SpiChannelIndex=0, SpiChannelAssignment=TmplMonrCh1
        TmplMonrJob2: SpiJobId=53
          SpiChannelList: SpiChannelIndex=0, SpiChannelAssignment=TmplMonrCh2
        TmplMonrJob3: SpiJobId=54
          SpiChannelList: SpiChannelIndex=0, SpiChannelAssignment=TmplMonrCh3
        TmplMonrJob4: SpiJobId=55
          SpiChannelList: SpiChannelIndex=0, SpiChannelAssignment=TmplMonrCh4
        TmplMonrJob5: SpiJobId=56
          SpiChannelList: SpiChannelIndex=0, SpiChannelAssignment=TmplMonrCh5
        PwrSplyJob1: SpiJobId=57
          SpiChannelList: SpiChannelIndex=0, SpiChannelAssignment=PwrSplyCh1
        PwrSplyJob2: SpiJobId=58
          SpiChannelList: SpiChannelIndex=0, SpiChannelAssignment=PwrSplyCh2
        PwrSplyJob3: SpiJobId=59
          SpiChannelList: SpiChannelIndex=0, SpiChannelAssignment=PwrSplyCh3
        PwrSplyJob4: SpiJobId=60
          SpiChannelList: SpiChannelIndex=0, SpiChannelAssignment=PwrSplyCh4
        PwrSplyJob5: SpiJobId=61
          SpiChannelList: SpiChannelIndex=0, SpiChannelAssignment=PwrSplyCh5
        PwrSplyJob6: SpiJobId=62
          SpiChannelList: SpiChannelIndex=0, SpiChannelAssignment=PwrSplyCh6
        PwrSplyJob7: SpiJobId=63
          SpiChannelList: SpiChannelIndex=0, SpiChannelAssignment=PwrSplyCh7
        PwrSplyJob8: SpiJobId=64
          SpiChannelList: SpiChannelIndex=0, SpiChannelAssignment=PwrSplyCh8
        PwrSplyJob9: SpiJobId=65
          SpiChannelList: SpiChannelIndex=0, SpiChannelAssignment=PwrSplyCh9
        PwrSplyJob10: SpiJobId=66
          SpiChannelList: SpiChannelIndex=0, SpiChannelAssignment=PwrSplyCh10
      15 x SpiSequence, all with SpiInterruptibleSequence=false, SpiSeqStartNotification=NULL, SpiHighPriorityHwSequence=false, SpiSeqEndNotification=NULL:
        TmplMonrSeq1: SpiSequenceId=52, SpiJobAssignment=TmplMonrJob1
        TmplMonrSeq2: SpiSequenceId=53, SpiJobAssignment=TmplMonrJob2
        TmplMonrSeq3: SpiSequenceId=54, SpiJobAssignment=TmplMonrJob3
        TmplMonrSeq4: SpiSequenceId=55, SpiJobAssignment=TmplMonrJob4
        TmplMonrSeq5: SpiSequenceId=56, SpiJobAssignment=TmplMonrJob5
        PwrSplySeq1: SpiSequenceId=57, SpiJobAssignment=PwrSplyJob1
        PwrSplySeq2: SpiSequenceId=58, SpiJobAssignment=PwrSplyJob2
        PwrSplySeq3: SpiSequenceId=59, SpiJobAssignment=PwrSplyJob3
        PwrSplySeq4: SpiSequenceId=60, SpiJobAssignment=PwrSplyJob4
        PwrSplySeq5: SpiSequenceId=61, SpiJobAssignment=PwrSplyJob5
        PwrSplySeq6: SpiSequenceId=62, SpiJobAssignment=PwrSplyJob6
        PwrSplySeq7: SpiSequenceId=63, SpiJobAssignment=PwrSplyJob7
        PwrSplySeq8: SpiSequenceId=64, SpiJobAssignment=PwrSplyJob8
        PwrSplySeq9: SpiSequenceId=65, SpiJobAssignment=PwrSplyJob9
        PwrSplySeq10: SpiSequenceId=66, SpiJobAssignment=PwrSplyJob10
    SpiPublishedInformation: SpiMaxHwUnit=5
