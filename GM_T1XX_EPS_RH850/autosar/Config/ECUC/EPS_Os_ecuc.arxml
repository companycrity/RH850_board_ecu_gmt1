AUTOSAR XML (schema 4-0-3)
package /ActiveEcuC
  module config Os: implementation-config-variant=VARIANT-PRE-COMPILE, module-description=Os_Impl
    OsOS:
      OsStackMonitoring = true
      OsOSStackUsageMeasurement = AUTO
      OsStatus = EXTENDED
      OsUseGetServiceId = false
      OsUseParameterAccess = false
      OsUseResScheduler = false
      OsOSCallISRHooks = false
      OsOSMemoryProtection = true
      OsOSCheckIntAPIStatus = true
      OsOSSupportFPU = true
      OsOSEnumeratedUnhandledISRs = false
      OsOSORTIDebugSupport = true
      OsOSTypeHeaderInclude = true
      OsOSUserConfigurationVersion = 1
      OsOSSystemStackSize = 1024
      OsOSOSInternalChecks = Additional
      OsOSCompiler = GHS
      OsOSORTIDebugLevel = ORTI_22_Additional
      OsOSTimingHooks = 
      OsScalabilityClass = SC3
      OsOSSCHEDULE
        AUTO
      OsOSCC
        NON_AUTO: OsOSCC=ECC2
      OsOSProtectionHookReaction
        Selected: OsOSSHUTDOWN=true
      OsOSPreAlarmHook
        FALSE
      OsOSTimingMeasurement
        FALSE
      OsOSUseSemaphores
        FALSE
      OsHooks: OsErrorHook=true, OsPostTaskHook=false, OsPreTaskHook=false, OsShutdownHook=true, OsStartupHook=true, OsProtectionHook=true
      5 x OsOSMpuRegion:
        CodeFlash_SX_SR_UX_UR
          Enable: OsOSASID=false, OsOSAccessRights=237, OsOSIdentifier=1023, OsOSStartAddr=0x0, OsOSEndAddr=0xFFFFF
        GeneralRAM_SW_SR_UR
          Enable: OsOSASID=false, OsOSAccessRights=217, OsOSIdentifier=1023, OsOSStartAddr=GeneralRam_StartAddr, OsOSEndAddr=GeneralRam_EndAddr
        GlobalSharedRAM_SW_SR_UW_UR
          Enable: OsOSASID=false, OsOSAccessRights=219, OsOSIdentifier=1023, OsOSStartAddr=osGlobalShared_StartAddr, OsOSEndAddr=osGlobalShared_EndAddr
        Registers_SW_SR_UW_UR
          Enable: OsOSASID=false, OsOSAccessRights=219, OsOSIdentifier=1023, OsOSStartAddr=0xFF000000, OsOSEndAddr=0xFFFFFFFF
        StackRAM_SR_UR
          Enable: OsOSASID=false, OsOSAccessRights=201, OsOSIdentifier=1023, OsOSStartAddr=StackRam_StartAddr, OsOSEndAddr=StackRam_EndAddr
    VectorCommonData: BswmdVersion=1.06.02
    OsImplementationInformation: OsVectorOilVersion=4.1, OsVectorImplementationName=RH850_P1M.i41, OsBswmdStyleVersion=2
    OSDEFAULTAPPMODE (OsAppMode)
    3 x OsApplication, all with OsApplicationASID=1023:
      Appl0: OsTrusted=true, OsAppGenerateStub=true, OsAppIsrRef=AlgnErrIrq, OsAppIsrRef=FpuErrIrq, OsAppIsrRef=MCU_FEINT_ISR, OsAppIsrRef=MotCtrlMgrIrq, OsAppIsrRef=ResdOperIrq, OsAppIsrRef=SPI_CSIG0_TIC_CAT2_ISR, OsAppIsrRef=SPI_CSIG0_TIR_CAT2_ISR, OsAppIsrRef=SPI_CSIG0_TIRE_CAT2_ISR, OsAppIsrRef=SPI_CSIH0_TIC_CAT2_ISR, OsAppIsrRef=SPI_CSIH0_TIR_CAT2_ISR, OsAppIsrRef=SPI_CSIH0_TIRE_CAT2_ISR, OsAppIsrRef=SPI_CSIH2_TIC_CAT2_ISR, OsAppIsrRef=SPI_CSIH2_TIR_CAT2_ISR, OsAppIsrRef=SPI_CSIH2_TIRE_CAT2_ISR, OsAppIsrRef=SysErrIrq, OsAppIsrRef=WDG_59_DRIVERA_TRIGGERFUNCTION_ISR, OsAppTaskRef=Task_Shutdown_Appl0
        OsApplicationHooks: OsAppStartupHook=false, OsAppShutdownHook=false, OsAppErrorHook=false
        14 x OsApplicationTrustedFunction:
          Adc0OutpInin: OsTrustedFunctionName=Adc0OutpInin, OsApplicationParams=void, OsApplicationReturnType=void
          ApplXcpWrCmn: OsTrustedFunctionName=ApplXcpWrCmn, OsApplicationParams=MTABYTEPTR addr, vuint8 size, const BYTEPTR data, OsApplicationReturnType=void
          DmaRegInin: OsTrustedFunctionName=DmaRegInin, OsApplicationParams=void, OsApplicationReturnType=void
          Fls_MainFunction: OsTrustedFunctionName=Fls_MainFunction, OsApplicationParams=void, OsApplicationReturnType=void
          IpgInin: OsTrustedFunctionName=IpgInin, OsApplicationParams=void, OsApplicationReturnType=void
          NvM_MainFunction: OsTrustedFunctionName=NvM_MainFunction, OsApplicationParams=void, OsApplicationReturnType=void
          Spi_AsyncTransmit: OsTrustedFunctionName=Spi_AsyncTransmit, OsApplicationParams=Spi_SequenceType Sequence, OsApplicationReturnType=Std_ReturnType
          NxtrWdgM_Init: OsTrustedFunctionName=NxtrWdgM_Init, OsApplicationParams=void, OsApplicationReturnType=void
          OsApplicationTrustedFunction: OsTrustedFunctionName=DtsInin, OsApplicationParams=uint32 CrcHwIdxInReg, uint32 CrcHwIdxOutReg, OsApplicationReturnType=void
          OsApplicationTrustedFunction_001: OsTrustedFunctionName=CritRegInitChk, OsApplicationParams=void, OsApplicationReturnType=uint8
          OsApplicationTrustedFunction_002: OsTrustedFunctionName=DtsClnUp, OsApplicationParams=void, OsApplicationReturnType=void
          OsApplicationTrustedFunction_003: OsTrustedFunctionName=CritRegPerChk, OsApplicationParams=void, OsApplicationReturnType=uint8
          OsApplicationTrustedFunction_005: OsTrustedFunctionName=ReleaseResource, OsApplicationParams=ResourceType ResId, OsApplicationReturnType=void
          OsApplicationTrustedFunction_004: OsTrustedFunctionName=GetResource, OsApplicationParams=ResourceType ResId, OsApplicationReturnType=void
      Appl6: OsTrusted=false, OsAppGenerateStub=false, OsApplicationNonTrusted_Function=NtWrapS_GMLANInit, OsApplicationNonTrusted_Function=NtWrapS_CanStop, OsApplicationNonTrusted_Function=NtWrapS_GmMsg778BusHiSpd_DtcStsChgd, OsApplicationNonTrusted_Function=NtWrapS_CmnMfgSrv_Init, OsAppIsrRef=CanIsrGlobalStatus, OsAppIsrRef=CanIsrRxFifo, OsAppIsrRef=CanIsrTx_0, OsAppIsrRef=CanIsrTx_1, OsAppIsrRef=CanIsrStatus_0, OsAppIsrRef=CanIsrStatus_1, OsAppTaskRef=Task_2ms_Appl6, OsAppTaskRef=Task_10ms_Appl6, OsAppTaskRef=Task_Init_Appl6, OsAppAlarmRef=Rte_Al_TE_Task_10ms_Appl6_0_10ms, OsAppAlarmRef=Rte_Al_TE_Task_2ms_Appl6_0_2ms
        OsApplicationHooks: OsAppStartupHook=false, OsAppShutdownHook=false, OsAppErrorHook=false
        ApplicationRAM (OsApplicationMpuRegion)
          Enable: OsApplicationStartAddr=Appl6_StartAddr, OsApplicationEndAddr=Appl6_EndAddr
      Appl10: OsTrusted=false, OsAppGenerateStub=false, OsApplicationNonTrusted_Function=NtWrapS_NvM_EraseNvBlock, OsApplicationNonTrusted_Function=NtWrapS_NvM_InvalidateNvBlock, OsApplicationNonTrusted_Function=NtWrapS_NvM_SetBlockProtection, OsApplicationNonTrusted_Function=NtWrapS_NvM_SetRamBlockStatus, OsApplicationNonTrusted_Function=NtWrapS_NvM_SetDataIndex, OsApplicationNonTrusted_Function=NtWrapS_NvM_GetDataIndex, OsApplicationNonTrusted_Function=NtWrapS_NvM_GetErrorStatus, OsApplicationNonTrusted_Function=NtWrapS_CmnMfgSrv_CallSvc10, OsApplicationNonTrusted_Function=NtWrapS_NvM_ReadBlock, OsApplicationNonTrusted_Function=NtWrapS_NvM_WriteBlock, OsApplicationNonTrusted_Function=NtWrapS_Rte_Call_SetCalPageReq_Oper, OsApplicationNonTrusted_Function=NtWrapS_Rte_Call_CopyCalPageReq_Oper, OsApplicationNonTrusted_Function=NtWrapS_SyncCrc_GetAvlCrcHwUnit, OsApplicationNonTrusted_Function=NtWrapS_SyncCrc_RelsCrcHwUnit, OsApplicationNonTrusted_Function=NtWrapS_StHlthSigStc_ClrDataSample, OsApplicationNonTrusted_Function=NtWrapS_StHlthSigStc_UpdNvmPim, OsApplicationNonTrusted_Function=NtWrapS_StHlthSigStc_UpdDataSample, OsApplicationNonTrusted_Function=NtWrapS_CustDiagc_UpdHwAgTrimVal, OsApplicationNonTrusted_Function=NtWrapS_CustDiagc_ClrHwAgTrimVal, OsApplicationNonTrusted_Function=NtWrapS_CustDiagc_ClrAllDiagc, OsApplicationNonTrusted_Function=NtWrapS_CustDiagc_DemDcmDisableDTCSetting, OsApplicationNonTrusted_Function=NtWrapS_CustDiagc_DemDcmEnableDTCSetting, OsApplicationNonTrusted_Function=NtWrapS_CustDiagc_GmFctDiReq, OsApplicationNonTrusted_Function=NtWrapS_CustDiagc_DiDtcRecUpd, OsApplicationNonTrusted_Function=NtWrapS_CustDiagc_EnaDtcRecUpd, OsApplicationNonTrusted_Function=NtWrapS_BswM_RequestMode, OsAppIsrRef=MCU_ECM_EIC_CAT2_ISR, OsAppIsrRef=SnsrMeasStrtIrq, OsAppTaskRef=Task_2ms_Appl10, OsAppTaskRef=Task_4ms_Appl10, OsAppTaskRef=Task_4msBsw_Appl10, OsAppTaskRef=Task_10ms_Appl10, OsAppTaskRef=Task_10msBsw_Appl10, OsAppTaskRef=Task_100ms_Appl10, OsAppTaskRef=Task_Init_Appl10, OsAppTaskRef=Task_InitBsw_Appl10, OsAppCounterRef=OsCounter, OsAppAlarmRef=Rte_Al_TE_Task_100ms_Appl10_0_100ms, OsAppAlarmRef=Rte_Al_TE2_Task_10msBsw_Appl10_0_10ms, OsAppAlarmRef=Rte_Al_TE_Task_2ms_Appl10_0_2ms, OsAppAlarmRef=Rte_Al_TE2_Task_4msBsw_Appl10_0_4ms, OsAppAlarmRef=Rte_Al_TE_Task_10ms_Appl10_0_10ms, OsAppAlarmRef=Rte_Al_TE_Task_4ms_Appl10_0_4ms, OsAppAlarmRef=Rte_Al_TE_Task_2msTmplMonr_Appl10_0_2ms, OsAppTaskRef=Task_2msTmplMonr_Appl10
        OsApplicationHooks: OsAppStartupHook=false, OsAppShutdownHook=false, OsAppErrorHook=false
        ApplicationRAM (OsApplicationMpuRegion)
          Enable: OsApplicationStartAddr=Appl10_StartAddr, OsApplicationEndAddr=Appl10_EndAddr
    OsCounter: OsCounterMaxAllowedValue=2147483647, OsCounterMinCycle=1, OsCounterTicksPerBase=160000, OsCounterType=HARDWARE, OsSecondsPerTick=0.002
      OsDriver
        OsCounterTimer
          OSTM: OsCounterEnableNesting=true, OsCounterInterruptPriority=3, OsCounterStackSize=512
    11 x OsTask, all with OsTaskActivation=1, OsTaskSchedule=FULL, OsTaskTYPE=BASIC:
      Task_2ms_Appl6: OsTaskPriority=80, OsTaskStackSize=1024, OsTaskAccessingApplication=Appl10, OsTaskResourceRef=SHUTDOWN_ONGOING
      Task_2ms_Appl10: OsTaskPriority=81, OsTaskStackSize=2048, OsTaskAccessingApplication=Appl6, OsTaskResourceRef=SHUTDOWN_ONGOING
      Task_4ms_Appl10: OsTaskPriority=70, OsTaskStackSize=1024, OsTaskAccessingApplication=Appl6, OsTaskResourceRef=SHUTDOWN_ONGOING
      Task_4msBsw_Appl10: OsTaskPriority=90, OsTaskStackSize=1024, OsTaskAccessingApplication=Appl6
      Task_10ms_Appl6: OsTaskPriority=61, OsTaskStackSize=2048, OsTaskAccessingApplication=Appl10, OsTaskResourceRef=SHUTDOWN_ONGOING
      Task_10ms_Appl10: OsTaskPriority=62, OsTaskStackSize=1024, OsTaskAccessingApplication=Appl6, OsTaskResourceRef=SHUTDOWN_ONGOING
      Task_10msBsw_Appl10: OsTaskPriority=60, OsTaskStackSize=1024, OsTaskResourceRef=RES_SCHEDULER, OsTaskAccessingApplication=Appl6, OsTaskResourceRef=SHUTDOWN_ONGOING
      Task_100ms_Appl10: OsTaskPriority=51, OsTaskStackSize=1024, OsTaskAccessingApplication=Appl6, OsTaskResourceRef=SHUTDOWN_ONGOING
      Task_Init_Appl6: OsTaskPriority=97, OsTaskStackSize=1024, OsTaskAccessingApplication=Appl10
      Task_Init_Appl10: OsTaskPriority=98, OsTaskStackSize=2048, OsTaskAccessingApplication=Appl6
      Task_InitBsw_Appl10: OsTaskPriority=99, OsTaskStackSize=1024
        OsTaskAutostart: OsTaskAppModeRef=OSDEFAULTAPPMODE
    24 x OsIsr:
      AlgnErrIrq: OsIsrCategory=CATEGORY_1, OsIsrEnableNesting=false
        OsIsrExceptionType
          GENERAL_EXCEPTION: OsIsrExceptionAddress=192
        OsIsrUseSpecialFunctionName
          FALSE
      CanIsrGlobalStatus: OsIsrCategory=CATEGORY_2, OsIsrEnableNesting=true
        OsIsrExceptionType
          EIINT: OsIsrIntChannel=189, OsIsrInterruptPriority=15, OsIsrInterruptStackSize=1024
        OsIsrUseSpecialFunctionName
          FALSE
      CanIsrRxFifo: OsIsrCategory=CATEGORY_2, OsIsrEnableNesting=true
        OsIsrExceptionType
          EIINT: OsIsrIntChannel=190, OsIsrInterruptPriority=15, OsIsrInterruptStackSize=1024
        OsIsrUseSpecialFunctionName
          FALSE
      CanIsrTx_0: OsIsrCategory=CATEGORY_2, OsIsrEnableNesting=true
        OsIsrExceptionType
          EIINT: OsIsrIntChannel=185, OsIsrInterruptPriority=15, OsIsrInterruptStackSize=1024
        OsIsrUseSpecialFunctionName
          FALSE
      CanIsrTx_1: OsIsrCategory=CATEGORY_2, OsIsrEnableNesting=true
        OsIsrExceptionType
          EIINT: OsIsrIntChannel=188, OsIsrInterruptPriority=15, OsIsrInterruptStackSize=1024
        OsIsrUseSpecialFunctionName
          FALSE
      FpuErrIrq: OsIsrCategory=CATEGORY_1, OsIsrEnableNesting=false
        OsIsrExceptionType
          GENERAL_EXCEPTION: OsIsrExceptionAddress=112
        OsIsrUseSpecialFunctionName
          TRUE: OsIsrFunctionName=Patched_FpuErrIrq
      MCU_ECM_EIC_CAT2_ISR: OsIsrCategory=CATEGORY_2, OsIsrEnableNesting=true
        OsIsrExceptionType
          EIINT: OsIsrIntChannel=8, OsIsrInterruptPriority=3, OsIsrInterruptStackSize=512
        OsIsrUseSpecialFunctionName
          FALSE
      MCU_FEINT_ISR: OsIsrCategory=CATEGORY_1, OsIsrEnableNesting=false
        OsIsrExceptionType
          GENERAL_EXCEPTION: OsIsrExceptionAddress=224
        OsIsrUseSpecialFunctionName
          TRUE: OsIsrFunctionName=Patched_MCU_FEINT_ISR
      MotCtrlMgrIrq: OsIsrCategory=CATEGORY_1, OsIsrEnableNesting=false
        OsIsrExceptionType
          EIINT: OsIsrIntChannel=16, OsIsrInterruptPriority=1, OsIsrInterruptStackSize=0
        OsIsrUseSpecialFunctionName
          FALSE
      ResdOperIrq: OsIsrCategory=CATEGORY_1, OsIsrEnableNesting=false
        OsIsrExceptionType
          GENERAL_EXCEPTION: OsIsrExceptionAddress=96
        OsIsrUseSpecialFunctionName
          FALSE
      SPI_CSIG0_TIC_CAT2_ISR: OsIsrCategory=CATEGORY_2, OsIsrEnableNesting=true
        OsIsrExceptionType
          EIINT: OsIsrIntChannel=175, OsIsrInterruptPriority=14, OsIsrInterruptStackSize=512
        OsIsrUseSpecialFunctionName
          FALSE
      SPI_CSIG0_TIRE_CAT2_ISR: OsIsrCategory=CATEGORY_2, OsIsrEnableNesting=true
        OsIsrExceptionType
          EIINT: OsIsrIntChannel=174, OsIsrInterruptPriority=14, OsIsrInterruptStackSize=512
        OsIsrUseSpecialFunctionName
          FALSE
      SPI_CSIG0_TIR_CAT2_ISR: OsIsrCategory=CATEGORY_2, OsIsrEnableNesting=true
        OsIsrExceptionType
          EIINT: OsIsrIntChannel=176, OsIsrInterruptPriority=14, OsIsrInterruptStackSize=512
        OsIsrUseSpecialFunctionName
          FALSE
      SPI_CSIH0_TIC_CAT2_ISR: OsIsrCategory=CATEGORY_2, OsIsrEnableNesting=true
        OsIsrExceptionType
          EIINT: OsIsrIntChannel=84, OsIsrInterruptPriority=14, OsIsrInterruptStackSize=512
        OsIsrUseSpecialFunctionName
          FALSE
      SPI_CSIH0_TIRE_CAT2_ISR: OsIsrCategory=CATEGORY_2, OsIsrEnableNesting=true
        OsIsrExceptionType
          EIINT: OsIsrIntChannel=82, OsIsrInterruptPriority=14, OsIsrInterruptStackSize=512
        OsIsrUseSpecialFunctionName
          FALSE
      SPI_CSIH0_TIR_CAT2_ISR: OsIsrCategory=CATEGORY_2, OsIsrEnableNesting=true
        OsIsrExceptionType
          EIINT: OsIsrIntChannel=83, OsIsrInterruptPriority=14, OsIsrInterruptStackSize=512
        OsIsrUseSpecialFunctionName
          FALSE
      SPI_CSIH2_TIC_CAT2_ISR: OsIsrCategory=CATEGORY_2, OsIsrEnableNesting=true
        OsIsrExceptionType
          EIINT: OsIsrIntChannel=100, OsIsrInterruptPriority=14, OsIsrInterruptStackSize=512
        OsIsrUseSpecialFunctionName
          FALSE
      SPI_CSIH2_TIRE_CAT2_ISR: OsIsrCategory=CATEGORY_2, OsIsrEnableNesting=true
        OsIsrExceptionType
          EIINT: OsIsrIntChannel=98, OsIsrInterruptPriority=14, OsIsrInterruptStackSize=512
        OsIsrUseSpecialFunctionName
          FALSE
      SPI_CSIH2_TIR_CAT2_ISR: OsIsrCategory=CATEGORY_2, OsIsrEnableNesting=true
        OsIsrExceptionType
          EIINT: OsIsrIntChannel=99, OsIsrInterruptPriority=14, OsIsrInterruptStackSize=512
        OsIsrUseSpecialFunctionName
          FALSE
      SnsrMeasStrtIrq: OsIsrCategory=CATEGORY_2, OsIsrEnableNesting=true
        OsIsrExceptionType
          EIINT: OsIsrIntChannel=75, OsIsrInterruptPriority=13, OsIsrInterruptStackSize=512
        OsIsrUseSpecialFunctionName
          FALSE
      SysErrIrq: OsIsrCategory=CATEGORY_1, OsIsrEnableNesting=false
        OsIsrExceptionType
          GENERAL_EXCEPTION: OsIsrExceptionAddress=16
        OsIsrUseSpecialFunctionName
          TRUE: OsIsrFunctionName=Patched_SysErrIrq
      WDG_59_DRIVERA_TRIGGERFUNCTION_ISR: OsIsrCategory=CATEGORY_1, OsIsrEnableNesting=false
        OsIsrExceptionType
          EIINT: OsIsrIntChannel=9, OsIsrInterruptPriority=2, OsIsrInterruptStackSize=0
        OsIsrUseSpecialFunctionName
          FALSE
      CanIsrStatus_0: OsIsrCategory=CATEGORY_2, OsIsrEnableNesting=true
        OsIsrExceptionType
          EIINT: OsIsrIntChannel=183, OsIsrInterruptPriority=15, OsIsrInterruptStackSize=1024
        OsIsrUseSpecialFunctionName
          FALSE
      CanIsrStatus_1: OsIsrCategory=CATEGORY_2, OsIsrEnableNesting=true
        OsIsrExceptionType
          EIINT: OsIsrIntChannel=186, OsIsrInterruptPriority=15, OsIsrInterruptStackSize=1024
        OsIsrUseSpecialFunctionName
          FALSE
    RES_SCHEDULER (OsResource): OsResourceProperty=STANDARD, OsResourceAccessingApplication=Appl10
    8 x OsAlarm, all with OsAlarmCounterRef=OsCounter:
      Rte_Al_TE_Task_100ms_Appl10_0_100ms
        OsAlarmAction
          OsAlarmActivateTask: OsAlarmActivateTaskRef=Task_100ms_Appl10
      Rte_Al_TE2_Task_10msBsw_Appl10_0_10ms
        OsAlarmAction
          OsAlarmActivateTask: OsAlarmActivateTaskRef=Task_10msBsw_Appl10
      Rte_Al_TE_Task_10ms_Appl6_0_10ms: OsAlarmAccessingApplication=Appl10
        OsAlarmAction
          OsAlarmActivateTask: OsAlarmActivateTaskRef=Task_10ms_Appl6
      Rte_Al_TE_Task_2ms_Appl10_0_2ms
        OsAlarmAction
          OsAlarmActivateTask: OsAlarmActivateTaskRef=Task_2ms_Appl10
      Rte_Al_TE_Task_2ms_Appl6_0_2ms: OsAlarmAccessingApplication=Appl10
        OsAlarmAction
          OsAlarmActivateTask: OsAlarmActivateTaskRef=Task_2ms_Appl6
      Rte_Al_TE2_Task_4msBsw_Appl10_0_4ms
        OsAlarmAction
          OsAlarmActivateTask: OsAlarmActivateTaskRef=Task_4msBsw_Appl10
      Rte_Al_TE_Task_10ms_Appl10_0_10ms
        OsAlarmAction
          OsAlarmActivateTask: OsAlarmActivateTaskRef=Task_10ms_Appl10
      Rte_Al_TE_Task_4ms_Appl10_0_4ms
        OsAlarmAction
          OsAlarmActivateTask: OsAlarmActivateTaskRef=Task_4ms_Appl10
    SHUTDOWN_ONGOING (OsResource): OsResourceProperty=STANDARD, OsResourceAccessingApplication=Appl10, OsResourceAccessingApplication=Appl6
    Rte_Al_TE_Task_2msTmplMonr_Appl10_0_2ms (OsAlarm): OsAlarmCounterRef=OsCounter
      OsAlarmAction
        OsAlarmActivateTask: OsAlarmActivateTaskRef=Task_2msTmplMonr_Appl10
    Task_Shutdown_Appl0 (OsTask): OsTaskActivation=1, OsTaskPriority=96, OsTaskSchedule=FULL, OsTaskTYPE=BASIC, OsTaskStackSize=1024, OsTaskAccessingApplication=Appl10
    Task_2msTmplMonr_Appl10 (OsTask): OsTaskActivation=1, OsTaskPriority=82, OsTaskSchedule=FULL, OsTaskTYPE=BASIC, OsTaskStackSize=768, OsTaskAccessingApplication=Appl6
