AUTOSAR XML (schema 4-0-3)
package /ActiveEcuC
  module config Port: implementation-config-variant=VARIANT-POST-BUILD-LOADABLE, module-description=Port_Impl
    PortConfigSet
      PortContainer: PortNumberOfPortPins=1
        PortPin:
          PortPinDirection = PORT_PIN_IN
          PortPinDirectionChangeable = false
          PortPinId = 1
          PortPinInitialMode = PORT_PIN_MODE_ADC
          PortPinLevelValue = PORT_PIN_LEVEL_HIGH
          PortPinMode = PORT_PIN_MODE_ADC
          PortPinModeChangeable = false
      PortFilterGroupConfig: PortDigitalFilterClockSelection=McuHighspeedPeriClk0
        PortDigitalFilterGroup20:
          PortSameLevelSamples = TWO_SAMPLES
          PortSamplingClockFrequency = DNFATCKI_DIV_BY_1
          PortDigitalFilterEnableInput0 = BYPASSED
          PortDigitalFilterModeSelection = ALTERNATIVE_MODE
        PortDigitalFilterGroup21:
          PortSameLevelSamples = TWO_SAMPLES
          PortSamplingClockFrequency = DNFATCKI_DIV_BY_1
          PortDigitalFilterEnableInput0 = BYPASSED
          PortDigitalFilterModeSelection = ALTERNATIVE_MODE
        PortDigitalFilterGroup23:
          PortSameLevelSamples = TWO_SAMPLES
          PortSamplingClockFrequency = DNFATCKI_DIV_BY_1
          PortDigitalFilterEnableInput0 = BYPASSED
          PortDigitalFilterModeSelection = ALTERNATIVE_MODE
        PortDigitalFilterGroup24:
          PortSameLevelSamples = TWO_SAMPLES
          PortSamplingClockFrequency = DNFATCKI_DIV_BY_1
          PortDigitalFilterEnableInput0 = BYPASSED
          PortDigitalFilterModeSelection = ALTERNATIVE_MODE
        PortDigitalFilterGroup25:
          PortSameLevelSamples = TWO_SAMPLES
          PortSamplingClockFrequency = DNFATCKI_DIV_BY_1
          PortDigitalFilterEnableInput0 = BYPASSED
          PortDigitalFilterModeSelection = ALTERNATIVE_MODE
        PortDigitalFilterGroup26:
          PortSameLevelSamples = TWO_SAMPLES
          PortSamplingClockFrequency = DNFATCKI_DIV_BY_1
          PortDigitalFilterEnableInput0 = BYPASSED
          PortDigitalFilterModeSelection = ALTERNATIVE_MODE
        SamplingClockSourceSelection:
          PortClockSource0 = CLK_HSB_DNFCKS100C
          PortClockSource1 = CLK_HSB_DNFCKS108C
          PortClockSource2 = CLK_HSB_DNFCKS109C
          PortClockSource3 = CLK_HSB_DNFCKS110C
          PortClockSource4 = CLK_HSB_DNFCKS112C
          PortClockSource5 = CLK_HSB_DNFCKS113C
          PortClockSource6 = CLK_HSB_DNFCKS114C
          PortClockSource7 = CLK_HSB_DNFCKS104C
          PortClockSource8 = CLK_HSB_DNFCKS105C
          PortClockSource9 = CLK_HSB_DNFCKS102C
          PortClockSource10 = CLK_HSB_DNFCKS101C
          PortClockSource11 = CLK_HSB_DNFCKS106C
          PortClockSource12 = CLK_HSB_DNFCKS107C
      PortGroup0
        PortPin0:
          PortPinDirectionChangeable = false
          PortPinDioAltModeChangeable = false
          PortPinModeChangeable = false
          PortPinLevelValue = PORT_PIN_LEVEL_LOW
          PortPinInitialMode = TAUJ0I1_ALT1_IN
          PortPinDirection = PORT_PIN_IN
          PortInputBufferControl = false
          PortBiDirectionControl = false
          PortPullUpOption = false
          PortPullDownOption = false
          PortOpenDrainControl_Expansion = OpenDrain_PushPull
          PortOutputLevelInversion = false
          PortOutputDriveStrength = SLOW
        PortPin1:
          PortPinDirectionChangeable = false
          PortPinDioAltModeChangeable = false
          PortPinModeChangeable = true
          PortPinLevelValue = PORT_PIN_LEVEL_HIGH
          PortPinInitialMode = DIO
          PortPinDirection = PORT_PIN_IN
          PortInputBufferControl = false
          PortBiDirectionControl = true
          PortPullUpOption = false
          PortPullDownOption = false
          PortOpenDrainControl_Expansion = OpenDrain_N_Channel
          PortOutputLevelInversion = false
          PortOutputDriveStrength = SLOW
        PortPin2:
          PortPinDirectionChangeable = false
          PortPinDioAltModeChangeable = false
          PortPinModeChangeable = true
          PortPinLevelValue = PORT_PIN_LEVEL_HIGH
          PortPinInitialMode = DIO
          PortPinDirection = PORT_PIN_IN
          PortInputBufferControl = false
          PortBiDirectionControl = true
          PortPullUpOption = false
          PortPullDownOption = false
          PortOpenDrainControl_Expansion = OpenDrain_N_Channel
          PortOutputLevelInversion = false
          PortOutputDriveStrength = SLOW
        PortPin3:
          PortPinDirectionChangeable = false
          PortPinDioAltModeChangeable = false
          PortPinModeChangeable = false
          PortPinLevelValue = PORT_PIN_LEVEL_LOW
          PortPinInitialMode = DIO
          PortPinDirection = PORT_PIN_IN
          PortInputBufferControl = false
          PortBiDirectionControl = false
          PortPullUpOption = false
          PortPullDownOption = false
          PortOpenDrainControl_Expansion = OpenDrain_PushPull
          PortOutputLevelInversion = false
          PortInputSelection = TYPE_1_SUPP_PISA
          PortOutputDriveStrength = SLOW
        PortPin4:
          PortPinDirectionChangeable = false
          PortPinDioAltModeChangeable = false
          PortPinModeChangeable = false
          PortPinLevelValue = PORT_PIN_LEVEL_LOW
          PortPinInitialMode = DIO
          PortPinDirection = PORT_PIN_IN
          PortInputBufferControl = false
          PortBiDirectionControl = false
          PortPullUpOption = false
          PortPullDownOption = false
          PortOpenDrainControl_Expansion = OpenDrain_PushPull
          PortOutputLevelInversion = false
          PortInputSelection = TYPE_1_SUPP_PISA
          PortOutputDriveStrength = SLOW
        PortPin5:
          PortPinDirectionChangeable = false
          PortPinDioAltModeChangeable = false
          PortPinModeChangeable = false
          PortPinLevelValue = PORT_PIN_LEVEL_LOW
          PortPinInitialMode = TAUJ1I0_ALT1_IN
          PortPinDirection = PORT_PIN_IN
          PortInputBufferControl = false
          PortBiDirectionControl = false
          PortPullUpOption = false
          PortPullDownOption = false
          PortOpenDrainControl_Expansion = OpenDrain_PushPull
          PortOutputLevelInversion = false
          PortInputSelection = TYPE_1_SUPP_PISA
          PortOutputDriveStrength = SLOW
        PortPin6:
          PortPinDirectionChangeable = false
          PortPinDioAltModeChangeable = false
          PortPinModeChangeable = false
          PortPinLevelValue = PORT_PIN_LEVEL_LOW
          PortPinInitialMode = TAUJ1I1_ALT1_IN
          PortPinDirection = PORT_PIN_IN
          PortInputBufferControl = false
          PortBiDirectionControl = false
          PortPullUpOption = false
          PortPullDownOption = false
          PortOpenDrainControl_Expansion = OpenDrain_PushPull
          PortOutputLevelInversion = false
          PortInputSelection = TYPE_1_SUPP_PISA
          PortOutputDriveStrength = SLOW
        PortPin7:
          PortPinDirectionChangeable = false
          PortPinDioAltModeChangeable = false
          PortPinModeChangeable = false
          PortPinLevelValue = PORT_PIN_LEVEL_LOW
          PortPinInitialMode = TAUJ1I2_ALT1_IN
          PortPinDirection = PORT_PIN_IN
          PortInputBufferControl = false
          PortBiDirectionControl = false
          PortPullUpOption = false
          PortPullDownOption = false
          PortOpenDrainControl_Expansion = OpenDrain_PushPull
          PortOutputLevelInversion = false
          PortInputSelection = TYPE_1_SUPP_PISA
          PortOutputDriveStrength = SLOW
        PortPin8:
          PortPinDirectionChangeable = false
          PortPinDioAltModeChangeable = false
          PortPinModeChangeable = false
          PortPinLevelValue = PORT_PIN_LEVEL_LOW
          PortPinInitialMode = DIO
          PortPinDirection = PORT_PIN_IN
          PortInputBufferControl = false
          PortBiDirectionControl = false
          PortPullUpOption = false
          PortPullDownOption = false
          PortOpenDrainControl_Expansion = OpenDrain_PushPull
          PortOutputLevelInversion = false
          PortInputSelection = TYPE_1_SUPP_PISA
          PortOutputDriveStrength = SLOW
        PortPin9:
          PortPinDirectionChangeable = false
          PortPinDioAltModeChangeable = false
          PortPinModeChangeable = false
          PortPinLevelValue = PORT_PIN_LEVEL_LOW
          PortPinDirection = PORT_PIN_IN
          PortInputBufferControl = false
          PortBiDirectionControl = false
          PortPullUpOption = false
          PortPullDownOption = false
          PortOpenDrainControl_Expansion = OpenDrain_PushPull
          PortOutputLevelInversion = false
          PortInputSelection = TYPE_1_SUPP_PISA
          PortOutputDriveStrength = SLOW
          PortPinInitialMode = DIO_SUPP_PFC_PFCE_PMCSR
        PortPin10:
          PortPinDirectionChangeable = false
          PortPinDioAltModeChangeable = false
          PortPinModeChangeable = false
          PortPinLevelValue = PORT_PIN_LEVEL_LOW
          PortPinDirection = PORT_PIN_IN
          PortInputBufferControl = false
          PortBiDirectionControl = false
          PortPullUpOption = false
          PortPullDownOption = false
          PortOpenDrainControl_Expansion = OpenDrain_PushPull
          PortOutputLevelInversion = false
          PortOutputDriveStrength = SLOW
          PortPinInitialMode = DIO_SUPP_PFC_PMCSR
        PortPin11:
          PortPinDirectionChangeable = false
          PortPinDioAltModeChangeable = false
          PortPinModeChangeable = false
          PortPinLevelValue = PORT_PIN_LEVEL_LOW
          PortPinDirection = PORT_PIN_IN
          PortInputBufferControl = false
          PortBiDirectionControl = false
          PortPullUpOption = false
          PortPullDownOption = false
          PortOpenDrainControl_Expansion = OpenDrain_PushPull
          PortOutputLevelInversion = false
          PortOutputDriveStrength = SLOW
          PortPinInitialMode = DIO_SUPP_PFC_PMCSR
        PortPin12:
          PortPinDirectionChangeable = false
          PortPinDioAltModeChangeable = false
          PortPinModeChangeable = false
          PortPinLevelValue = PORT_PIN_LEVEL_LOW
          PortPinDirection = PORT_PIN_IN
          PortInputBufferControl = false
          PortBiDirectionControl = false
          PortPullUpOption = false
          PortPullDownOption = false
          PortOpenDrainControl_Expansion = OpenDrain_PushPull
          PortOutputLevelInversion = false
          PortOutputDriveStrength = SLOW
          PortPinInitialMode = DIO_SUPP_PFC_PMCSR
        PortPin13:
          PortPinDirectionChangeable = false
          PortPinDioAltModeChangeable = false
          PortPinModeChangeable = false
          PortPinLevelValue = PORT_PIN_LEVEL_LOW
          PortPinDirection = PORT_PIN_OUT
          PortInputBufferControl = false
          PortBiDirectionControl = false
          PortPullUpOption = false
          PortPullDownOption = false
          PortOpenDrainControl_Expansion = OpenDrain_PushPull
          PortOutputLevelInversion = false
          PortInputSelection = TYPE_1_SUPP_PISA
          PortOutputDriveStrength = SLOW
          PortPinInitialMode = DIO_SUPP_PFC_PFCE_PMCSR
        PortPin14:
          PortPinDirectionChangeable = false
          PortPinDioAltModeChangeable = false
          PortPinModeChangeable = false
          PortPinLevelValue = PORT_PIN_LEVEL_LOW
          PortPinDirection = PORT_PIN_IN
          PortInputBufferControl = false
          PortBiDirectionControl = false
          PortPullUpOption = false
          PortPullDownOption = false
          PortOpenDrainControl_Expansion = OpenDrain_PushPull
          PortOutputLevelInversion = false
          PortOutputDriveStrength = SLOW
          PortPinInitialMode = DIO_SUPP_PFC_PMCSR
      PortGroup1
        PortPin0:
          PortPinDirectionChangeable = false
          PortPinDioAltModeChangeable = false
          PortPinModeChangeable = false
          PortPinLevelValue = PORT_PIN_LEVEL_LOW
          PortPinInitialMode = DIO
          PortPinDirection = PORT_PIN_IN
          PortInputBufferControl = false
          PortBiDirectionControl = false
          PortPullUpOption = false
          PortPullDownOption = false
          PortOpenDrainControl_Expansion = OpenDrain_PushPull
          PortOutputLevelInversion = false
          PortOutputDriveStrength = SLOW
        PortPin1:
          PortPinDirectionChangeable = false
          PortPinDioAltModeChangeable = false
          PortPinModeChangeable = false
          PortPinLevelValue = PORT_PIN_LEVEL_LOW
          PortPinInitialMode = CSIH2CSS0_ALT4_OUT
          PortPinDirection = PORT_PIN_OUT
          PortInputBufferControl = false
          PortBiDirectionControl = false
          PortPullUpOption = false
          PortPullDownOption = false
          PortOpenDrainControl_Expansion = OpenDrain_PushPull
          PortOutputLevelInversion = false
          PortInputSelection = TYPE_1_SUPP_PISA
          PortOutputDriveStrength = SLOW
        PortPin2:
          PortPinDirectionChangeable = false
          PortPinDioAltModeChangeable = false
          PortPinModeChangeable = false
          PortPinLevelValue = PORT_PIN_LEVEL_LOW
          PortPinInitialMode = CSIH2SI_ALT4_IN
          PortPinDirection = PORT_PIN_IN
          PortInputBufferControl = false
          PortBiDirectionControl = false
          PortPullUpOption = false
          PortPullDownOption = false
          PortOpenDrainControl_Expansion = OpenDrain_PushPull
          PortOutputLevelInversion = false
          PortInputSelection = TYPE_1_SUPP_PISA
          PortOutputDriveStrength = SLOW
        PortPin3:
          PortPinDirectionChangeable = false
          PortPinDioAltModeChangeable = false
          PortPinModeChangeable = false
          PortPinLevelValue = PORT_PIN_LEVEL_LOW
          PortPinInitialMode = CSIH2SO_ALT4_OUT
          PortPinDirection = PORT_PIN_OUT
          PortInputBufferControl = false
          PortBiDirectionControl = false
          PortPullUpOption = false
          PortPullDownOption = false
          PortOpenDrainControl_Expansion = OpenDrain_PushPull
          PortOutputLevelInversion = false
          PortInputSelection = TYPE_1_SUPP_PISA
          PortOutputDriveStrength = SLOW
          PortIpControl = true
        PortPin4:
          PortPinDirectionChangeable = false
          PortPinDioAltModeChangeable = false
          PortPinModeChangeable = false
          PortPinLevelValue = PORT_PIN_LEVEL_LOW
          PortPinInitialMode = CSIH2SCO_ALT4_OUT
          PortPinDirection = PORT_PIN_OUT
          PortInputBufferControl = false
          PortBiDirectionControl = false
          PortIpControl = false
          PortPullUpOption = false
          PortPullDownOption = false
          PortOpenDrainControl_Expansion = OpenDrain_PushPull
          PortOutputLevelInversion = false
          PortInputSelection = TYPE_1_SUPP_PISA
          PortOutputDriveStrength = SLOW
      PortGroup2
        PortPin0:
          PortPinDirectionChangeable = false
          PortPinDioAltModeChangeable = false
          PortPinModeChangeable = false
          PortPinLevelValue = PORT_PIN_LEVEL_LOW
          PortPinDirection = PORT_PIN_IN
          PortInputBufferControl = false
          PortBiDirectionControl = false
          PortPullUpOption = false
          PortPullDownOption = false
          PortOpenDrainControl_Expansion = OpenDrain_PushPull
          PortOutputLevelInversion = false
          PortInputSelection = TYPE_1_SUPP_PISA
          PortOutputDriveStrength = SLOW
          PortPinInitialMode = RSCAN0RX0_ALT1_IN_SUPP_PFC_PFCE_PMCSR
        PortPin1:
          PortPinDirectionChangeable = false
          PortPinDioAltModeChangeable = false
          PortPinModeChangeable = false
          PortPinLevelValue = PORT_PIN_LEVEL_LOW
          PortPinInitialMode = RSCAN0TX0_ALT1_OUT
          PortPinDirection = PORT_PIN_OUT
          PortInputBufferControl = false
          PortBiDirectionControl = false
          PortIpControl = false
          PortPullUpOption = false
          PortPullDownOption = false
          PortOpenDrainControl_Expansion = OpenDrain_PushPull
          PortOutputLevelInversion = false
          PortInputSelection = TYPE_1_SUPP_PISA
          PortOutputDriveStrength = SLOW
        PortPin2:
          PortPinDirectionChangeable = false
          PortPinDioAltModeChangeable = false
          PortPinModeChangeable = false
          PortPinLevelValue = PORT_PIN_LEVEL_LOW
          PortPinInitialMode = DIO
          PortPinDirection = PORT_PIN_IN
          PortInputBufferControl = true
          PortBiDirectionControl = false
          PortIpControl = false
          PortPullUpOption = false
          PortPullDownOption = false
          PortOpenDrainControl_Expansion = OpenDrain_PushPull
          PortOutputLevelInversion = false
          PortInputSelection = TYPE_1_SUPP_PISA
          PortOutputDriveStrength = SLOW
        PortPin3:
          PortPinDirectionChangeable = false
          PortPinDioAltModeChangeable = false
          PortPinModeChangeable = false
          PortPinLevelValue = PORT_PIN_LEVEL_LOW
          PortPinInitialMode = RSCAN0TX1_ALT1_OUT
          PortPinDirection = PORT_PIN_OUT
          PortInputBufferControl = false
          PortBiDirectionControl = false
          PortIpControl = false
          PortPullUpOption = false
          PortPullDownOption = false
          PortOpenDrainControl_Expansion = OpenDrain_PushPull
          PortOutputLevelInversion = false
          PortOutputDriveStrength = SLOW
        PortPin4:
          PortPinDirectionChangeable = false
          PortPinDioAltModeChangeable = false
          PortPinModeChangeable = false
          PortPinLevelValue = PORT_PIN_LEVEL_HIGH
          PortPinInitialMode = DIO
          PortPinDirection = PORT_PIN_OUT
          PortInputBufferControl = false
          PortBiDirectionControl = false
          PortPullUpOption = false
          PortPullDownOption = false
          PortOpenDrainControl_Expansion = OpenDrain_PushPull
          PortOutputLevelInversion = false
          PortOutputDriveStrength = SLOW
        PortPin5:
          PortPinDirectionChangeable = false
          PortPinDioAltModeChangeable = false
          PortPinModeChangeable = false
          PortPinLevelValue = PORT_PIN_LEVEL_LOW
          PortPinInitialMode = CSIH3SO_ALT4_OUT
          PortPinDirection = PORT_PIN_OUT
          PortInputBufferControl = false
          PortBiDirectionControl = false
          PortIpControl = false
          PortPullUpOption = false
          PortPullDownOption = false
          PortOpenDrainControl_Expansion = OpenDrain_PushPull
          PortOutputLevelInversion = false
          PortInputSelection = TYPE_1_SUPP_PISA
          PortOutputDriveStrength = SLOW
        PortPin6:
          PortPinDirectionChangeable = false
          PortPinDioAltModeChangeable = false
          PortPinModeChangeable = false
          PortPinLevelValue = PORT_PIN_LEVEL_LOW
          PortPinInitialMode = CSIH3SI_ALT4_IN
          PortPinDirection = PORT_PIN_IN
          PortInputBufferControl = false
          PortBiDirectionControl = false
          PortIpControl = false
          PortPullUpOption = false
          PortPullDownOption = false
          PortOpenDrainControl_Expansion = OpenDrain_PushPull
          PortOutputLevelInversion = false
          PortOutputDriveStrength = SLOW
        PortPin7:
          PortPinDirectionChangeable = false
          PortPinDioAltModeChangeable = false
          PortPinModeChangeable = false
          PortPinLevelValue = PORT_PIN_LEVEL_LOW
          PortPinInitialMode = CSIH3SCO_ALT4_OUT
          PortPinDirection = PORT_PIN_OUT
          PortInputBufferControl = false
          PortBiDirectionControl = false
          PortIpControl = false
          PortPullUpOption = false
          PortPullDownOption = false
          PortOpenDrainControl_Expansion = OpenDrain_PushPull
          PortOutputLevelInversion = false
          PortInputSelection = TYPE_1_SUPP_PISA
          PortOutputDriveStrength = SLOW
        PortPin8:
          PortPinDirectionChangeable = false
          PortPinDioAltModeChangeable = false
          PortPinModeChangeable = false
          PortPinLevelValue = PORT_PIN_LEVEL_LOW
          PortPinInitialMode = CSIH1SO_ALT3_OUT
          PortPinDirection = PORT_PIN_OUT
          PortInputBufferControl = false
          PortBiDirectionControl = false
          PortIpControl = false
          PortPullUpOption = false
          PortPullDownOption = false
          PortOpenDrainControl_Expansion = OpenDrain_PushPull
          PortOutputLevelInversion = false
          PortOutputDriveStrength = SLOW
        PortPin9:
          PortPinDirectionChangeable = false
          PortPinDioAltModeChangeable = false
          PortPinModeChangeable = false
          PortPinLevelValue = PORT_PIN_LEVEL_LOW
          PortPinInitialMode = CSIH1SCO_ALT3_OUT
          PortPinDirection = PORT_PIN_OUT
          PortInputBufferControl = false
          PortBiDirectionControl = false
          PortIpControl = false
          PortPullUpOption = false
          PortPullDownOption = false
          PortOpenDrainControl_Expansion = OpenDrain_PushPull
          PortOutputLevelInversion = false
          PortOutputDriveStrength = SLOW
        PortPin10:
          PortPinDirectionChangeable = false
          PortPinDioAltModeChangeable = false
          PortPinModeChangeable = false
          PortPinLevelValue = PORT_PIN_LEVEL_LOW
          PortPinInitialMode = DIO
          PortPinDirection = PORT_PIN_IN
          PortInputBufferControl = false
          PortBiDirectionControl = false
          PortPullUpOption = false
          PortPullDownOption = false
          PortOpenDrainControl_Expansion = OpenDrain_PushPull
          PortOutputLevelInversion = false
          PortOutputDriveStrength = SLOW
        PortPin11:
          PortPinDirectionChangeable = false
          PortPinDioAltModeChangeable = false
          PortPinModeChangeable = false
          PortPinLevelValue = PORT_PIN_LEVEL_LOW
          PortPinInitialMode = DIO
          PortPinDirection = PORT_PIN_IN
          PortInputBufferControl = false
          PortBiDirectionControl = false
          PortPullUpOption = false
          PortPullDownOption = false
          PortOpenDrainControl_Expansion = OpenDrain_PushPull
          PortOutputLevelInversion = false
          PortOutputDriveStrength = SLOW
        PortPin12:
          PortPinDirectionChangeable = false
          PortPinDioAltModeChangeable = false
          PortPinModeChangeable = false
          PortPinLevelValue = PORT_PIN_LEVEL_LOW
          PortPinInitialMode = DIO
          PortPinDirection = PORT_PIN_IN
          PortInputBufferControl = false
          PortBiDirectionControl = false
          PortIpControl = false
          PortPullUpOption = false
          PortPullDownOption = false
          PortOpenDrainControl_Expansion = OpenDrain_PushPull
          PortOutputLevelInversion = false
          PortInputSelection = TYPE_1_SUPP_PISA
          PortOutputDriveStrength = SLOW
        PortPin13:
          PortPinDirectionChangeable = false
          PortPinDioAltModeChangeable = false
          PortPinModeChangeable = false
          PortPinLevelValue = PORT_PIN_LEVEL_LOW
          PortPinInitialMode = DIO
          PortPinDirection = PORT_PIN_IN
          PortInputBufferControl = false
          PortBiDirectionControl = false
          PortPullUpOption = false
          PortPullDownOption = false
          PortOpenDrainControl_Expansion = OpenDrain_PushPull
          PortOutputLevelInversion = false
          PortOutputDriveStrength = SLOW
        PortPin14:
          PortPinDirectionChangeable = false
          PortPinDioAltModeChangeable = false
          PortPinModeChangeable = false
          PortPinLevelValue = PORT_PIN_LEVEL_LOW
          PortPinInitialMode = CSIH0CSS2_ALT5_OUT
          PortPinDirection = PORT_PIN_OUT
          PortInputBufferControl = false
          PortBiDirectionControl = false
          PortPullUpOption = false
          PortPullDownOption = false
          PortOpenDrainControl_Expansion = OpenDrain_PushPull
          PortOutputLevelInversion = false
          PortOutputDriveStrength = SLOW
        PortPin15:
          PortPinDirectionChangeable = false
          PortPinDioAltModeChangeable = false
          PortPinModeChangeable = false
          PortPinLevelValue = PORT_PIN_LEVEL_LOW
          PortPinInitialMode = DIO
          PortPinDirection = PORT_PIN_OUT
          PortInputBufferControl = false
          PortBiDirectionControl = false
          PortPullDownOption = false
          PortOpenDrainControl_Expansion = OpenDrain_PushPull
          PortOutputLevelInversion = false
          PortOutputDriveStrength = SLOW
      PortGroup3
        PortPin0:
          PortPinDirectionChangeable = false
          PortPinDioAltModeChangeable = false
          PortPinModeChangeable = false
          PortPinLevelValue = PORT_PIN_LEVEL_LOW
          PortPinInitialMode = CSIH0SO_ALT5_OUT
          PortPinDirection = PORT_PIN_OUT
          PortInputBufferControl = false
          PortBiDirectionControl = false
          PortPullUpOption = false
          PortPullDownOption = false
          PortOpenDrainControl_Expansion = OpenDrain_PushPull
          PortOutputLevelInversion = false
          PortInputSelection = TYPE_1_SUPP_PISA
          PortOutputDriveStrength = SLOW
          PortIpControl = true
        PortPin1:
          PortPinDirectionChangeable = false
          PortPinDioAltModeChangeable = false
          PortPinModeChangeable = false
          PortPinLevelValue = PORT_PIN_LEVEL_LOW
          PortPinInitialMode = CSIH0SCO_ALT5_OUT
          PortPinDirection = PORT_PIN_OUT
          PortInputBufferControl = false
          PortBiDirectionControl = false
          PortIpControl = false
          PortPullUpOption = false
          PortPullDownOption = false
          PortOpenDrainControl_Expansion = OpenDrain_PushPull
          PortOutputLevelInversion = false
          PortInputSelection = TYPE_1_SUPP_PISA
          PortOutputDriveStrength = SLOW
        PortPin2:
          PortPinDirectionChangeable = false
          PortPinDioAltModeChangeable = false
          PortPinModeChangeable = false
          PortPinLevelValue = PORT_PIN_LEVEL_LOW
          PortPinInitialMode = CSIH0SI_ALT5_IN
          PortPinDirection = PORT_PIN_IN
          PortInputBufferControl = false
          PortBiDirectionControl = false
          PortIpControl = false
          PortPullUpOption = false
          PortPullDownOption = false
          PortOpenDrainControl_Expansion = OpenDrain_PushPull
          PortOutputLevelInversion = false
          PortOutputDriveStrength = SLOW
        PortPin3:
          PortPinDirectionChangeable = false
          PortPinDioAltModeChangeable = false
          PortPinModeChangeable = false
          PortPinLevelValue = PORT_PIN_LEVEL_LOW
          PortPinInitialMode = CSIH3CSS4_ALT4_OUT
          PortPinDirection = PORT_PIN_OUT
          PortInputBufferControl = false
          PortBiDirectionControl = false
          PortPullUpOption = false
          PortPullDownOption = false
          PortOpenDrainControl_Expansion = OpenDrain_PushPull
          PortOutputLevelInversion = false
          PortOutputDriveStrength = SLOW
        PortPin4:
          PortPinDirectionChangeable = false
          PortPinDioAltModeChangeable = false
          PortPinModeChangeable = false
          PortPinLevelValue = PORT_PIN_LEVEL_LOW
          PortPinInitialMode = DIO
          PortPinDirection = PORT_PIN_IN
          PortInputBufferControl = false
          PortBiDirectionControl = false
          PortPullUpOption = false
          PortPullDownOption = false
          PortOpenDrainControl_Expansion = OpenDrain_PushPull
          PortOutputLevelInversion = false
          PortOutputDriveStrength = SLOW
        PortPin5:
          PortPinDirectionChangeable = false
          PortPinDioAltModeChangeable = false
          PortPinModeChangeable = false
          PortPinLevelValue = PORT_PIN_LEVEL_LOW
          PortPinInitialMode = DIO
          PortPinDirection = PORT_PIN_OUT
          PortInputBufferControl = false
          PortBiDirectionControl = false
          PortPullDownOption = false
          PortOpenDrainControl_Expansion = OpenDrain_PushPull
          PortOutputLevelInversion = false
          PortOutputDriveStrength = SLOW
        PortPin6:
          PortPinDirectionChangeable = false
          PortPinDioAltModeChangeable = false
          PortPinModeChangeable = false
          PortPinLevelValue = PORT_PIN_LEVEL_LOW
          PortPinInitialMode = DIO
          PortPinDirection = PORT_PIN_IN
          PortInputBufferControl = true
          PortBiDirectionControl = false
          PortPullUpOption = false
          PortPullDownOption = false
          PortOpenDrainControl_Expansion = OpenDrain_PushPull
          PortOutputLevelInversion = false
          PortOutputDriveStrength = SLOW
        PortPin7:
          PortPinDirectionChangeable = false
          PortPinDioAltModeChangeable = true
          PortPinModeChangeable = false
          PortPinLevelValue = PORT_PIN_LEVEL_LOW
          PortPinInitialMode = TSG31O1_ALT2_OUT
          PortPinDirection = PORT_PIN_OUT
          PortInputBufferControl = false
          PortBiDirectionControl = false
          PortIpControl = false
          PortPullUpOption = false
          PortPullDownOption = false
          PortOpenDrainControl_Expansion = OpenDrain_PushPull
          PortOutputLevelInversion = false
          PortOutputDriveStrength = SLOW
        PortPin8:
          PortPinDirectionChangeable = false
          PortPinDioAltModeChangeable = true
          PortPinModeChangeable = false
          PortPinLevelValue = PORT_PIN_LEVEL_LOW
          PortPinInitialMode = TSG31O2_ALT2_OUT
          PortPinDirection = PORT_PIN_OUT
          PortInputBufferControl = false
          PortBiDirectionControl = false
          PortIpControl = false
          PortPullUpOption = false
          PortPullDownOption = false
          PortOpenDrainControl_Expansion = OpenDrain_PushPull
          PortOutputLevelInversion = false
          PortOutputDriveStrength = SLOW
        PortPin9:
          PortPinDirectionChangeable = false
          PortPinDioAltModeChangeable = true
          PortPinModeChangeable = false
          PortPinLevelValue = PORT_PIN_LEVEL_LOW
          PortPinInitialMode = TSG31O3_ALT2_OUT
          PortPinDirection = PORT_PIN_OUT
          PortInputBufferControl = false
          PortBiDirectionControl = false
          PortIpControl = false
          PortPullUpOption = false
          PortPullDownOption = false
          PortOpenDrainControl_Expansion = OpenDrain_PushPull
          PortOutputLevelInversion = false
          PortOutputDriveStrength = SLOW
        PortPin10:
          PortPinDirectionChangeable = false
          PortPinDioAltModeChangeable = true
          PortPinModeChangeable = false
          PortPinLevelValue = PORT_PIN_LEVEL_LOW
          PortPinDirection = PORT_PIN_OUT
          PortInputBufferControl = false
          PortBiDirectionControl = false
          PortIpControl = false
          PortPullUpOption = false
          PortPullDownOption = false
          PortOpenDrainControl_Expansion = OpenDrain_PushPull
          PortOutputLevelInversion = false
          PortOutputDriveStrength = SLOW
          PortPinInitialMode = TSG31O4_ALT2_OUT_SUPP_PFC_PFCAE_PMCSR
        PortPin11:
          PortPinDirectionChangeable = false
          PortPinDioAltModeChangeable = false
          PortPinModeChangeable = false
          PortPinLevelValue = PORT_PIN_LEVEL_LOW
          PortPinInitialMode = TAUJ0I3_ALT1_IN
          PortPinDirection = PORT_PIN_IN
          PortInputBufferControl = false
          PortBiDirectionControl = false
          PortPullUpOption = false
          PortPullDownOption = false
          PortOpenDrainControl_Expansion = OpenDrain_PushPull
          PortOutputLevelInversion = false
          PortOutputDriveStrength = SLOW
        PortPin12:
          PortPinDirectionChangeable = false
          PortPinDioAltModeChangeable = true
          PortPinModeChangeable = false
          PortPinLevelValue = PORT_PIN_LEVEL_LOW
          PortPinInitialMode = TSG31O5_ALT2_OUT
          PortPinDirection = PORT_PIN_OUT
          PortInputBufferControl = false
          PortBiDirectionControl = false
          PortIpControl = false
          PortPullUpOption = false
          PortPullDownOption = false
          PortOpenDrainControl_Expansion = OpenDrain_PushPull
          PortOutputLevelInversion = false
          PortOutputDriveStrength = SLOW
        PortPin13:
          PortPinDirectionChangeable = false
          PortPinDioAltModeChangeable = true
          PortPinModeChangeable = false
          PortPinLevelValue = PORT_PIN_LEVEL_LOW
          PortPinInitialMode = TSG31O6_ALT2_OUT
          PortPinDirection = PORT_PIN_OUT
          PortInputBufferControl = false
          PortBiDirectionControl = false
          PortIpControl = false
          PortPullUpOption = false
          PortPullDownOption = false
          PortOpenDrainControl_Expansion = OpenDrain_PushPull
          PortOutputLevelInversion = false
          PortOutputDriveStrength = SLOW
        PortPin14:
          PortPinDirectionChangeable = false
          PortPinDioAltModeChangeable = false
          PortPinModeChangeable = false
          PortPinLevelValue = PORT_PIN_LEVEL_LOW
          PortPinInitialMode = CSIH1SI_ALT1_IN
          PortPinDirection = PORT_PIN_IN
          PortInputBufferControl = false
          PortBiDirectionControl = false
          PortPullUpOption = false
          PortPullDownOption = false
          PortOpenDrainControl_Expansion = OpenDrain_PushPull
          PortOutputLevelInversion = false
          PortInputSelection = TYPE_1_SUPP_PISA
          PortOutputDriveStrength = SLOW
      PortGroup4
        PortPin0:
          PortPinDirectionChangeable = false
          PortPinDioAltModeChangeable = false
          PortPinModeChangeable = false
          PortPinLevelValue = PORT_PIN_LEVEL_LOW
          PortPinInitialMode = DIO
          PortPinDirection = PORT_PIN_IN
          PortInputBufferControl = false
          PortBiDirectionControl = false
          PortIpControl = false
          PortPullUpOption = false
          PortPullDownOption = false
          PortOpenDrainControl_Expansion = OpenDrain_PushPull
          PortOutputLevelInversion = false
          PortInputSelection = TYPE_1_SUPP_PISA
          PortOutputDriveStrength = SLOW
        PortPin1:
          PortPinDirectionChangeable = false
          PortPinDioAltModeChangeable = false
          PortPinModeChangeable = false
          PortPinLevelValue = PORT_PIN_LEVEL_LOW
          PortPinInitialMode = DIO
          PortPinDirection = PORT_PIN_IN
          PortInputBufferControl = false
          PortBiDirectionControl = false
          PortIpControl = false
          PortPullUpOption = false
          PortPullDownOption = false
          PortOpenDrainControl_Expansion = OpenDrain_PushPull
          PortOutputLevelInversion = false
          PortInputSelection = TYPE_1_SUPP_PISA
          PortOutputDriveStrength = SLOW
        PortPin2:
          PortPinDirectionChangeable = false
          PortPinDioAltModeChangeable = false
          PortPinModeChangeable = false
          PortPinLevelValue = PORT_PIN_LEVEL_LOW
          PortPinInitialMode = DIO
          PortPinDirection = PORT_PIN_IN
          PortInputBufferControl = false
          PortBiDirectionControl = false
          PortPullUpOption = false
          PortPullDownOption = false
          PortOpenDrainControl_Expansion = OpenDrain_PushPull
          PortOutputLevelInversion = false
          PortInputSelection = TYPE_1_SUPP_PISA
          PortOutputDriveStrength = SLOW
        PortPin3:
          PortPinDirectionChangeable = false
          PortPinDioAltModeChangeable = false
          PortPinModeChangeable = false
          PortPinLevelValue = PORT_PIN_LEVEL_LOW
          PortPinInitialMode = CSIH1CSS0_ALT4_OUT
          PortPinDirection = PORT_PIN_OUT
          PortInputBufferControl = false
          PortBiDirectionControl = false
          PortPullUpOption = false
          PortPullDownOption = false
          PortOpenDrainControl_Expansion = OpenDrain_PushPull
          PortOutputLevelInversion = false
          PortInputSelection = TYPE_1_SUPP_PISA
          PortOutputDriveStrength = SLOW
        PortPin4:
          PortPinDirectionChangeable = false
          PortPinDioAltModeChangeable = false
          PortPinModeChangeable = false
          PortPinLevelValue = PORT_PIN_LEVEL_LOW
          PortPinInitialMode = DIO
          PortPinDirection = PORT_PIN_IN
          PortInputBufferControl = false
          PortBiDirectionControl = false
          PortPullUpOption = false
          PortPullDownOption = false
          PortOpenDrainControl_Expansion = OpenDrain_PushPull
          PortOutputLevelInversion = false
          PortInputSelection = TYPE_1_SUPP_PISA
          PortOutputDriveStrength = SLOW
        PortPin5:
          PortPinDirectionChangeable = false
          PortPinDioAltModeChangeable = false
          PortPinModeChangeable = false
          PortPinLevelValue = PORT_PIN_LEVEL_LOW
          PortPinInitialMode = DIO
          PortPinDirection = PORT_PIN_IN
          PortInputBufferControl = false
          PortBiDirectionControl = false
          PortIpControl = false
          PortPullUpOption = false
          PortPullDownOption = false
          PortOpenDrainControl_Expansion = OpenDrain_PushPull
          PortOutputLevelInversion = false
          PortInputSelection = TYPE_1_SUPP_PISA
          PortOutputDriveStrength = SLOW
        PortPin6:
          PortPinDirectionChangeable = false
          PortPinDioAltModeChangeable = false
          PortPinModeChangeable = false
          PortPinLevelValue = PORT_PIN_LEVEL_LOW
          PortPinInitialMode = DIO
          PortPinDirection = PORT_PIN_IN
          PortInputBufferControl = false
          PortBiDirectionControl = false
          PortIpControl = false
          PortPullUpOption = false
          PortPullDownOption = false
          PortOpenDrainControl_Expansion = OpenDrain_PushPull
          PortOutputLevelInversion = false
          PortInputSelection = TYPE_1_SUPP_PISA
          PortOutputDriveStrength = SLOW
        PortPin7:
          PortPinDirectionChangeable = false
          PortPinDioAltModeChangeable = false
          PortPinModeChangeable = false
          PortPinLevelValue = PORT_PIN_LEVEL_LOW
          PortPinInitialMode = RSCAN0RX1_ALT1_IN
          PortPinDirection = PORT_PIN_IN
          PortInputBufferControl = false
          PortBiDirectionControl = false
          PortPullUpOption = false
          PortPullDownOption = false
          PortOpenDrainControl_Expansion = OpenDrain_PushPull
          PortOutputLevelInversion = false
          PortOutputDriveStrength = SLOW
        PortPin8:
          PortPinDirectionChangeable = false
          PortPinDioAltModeChangeable = false
          PortPinModeChangeable = false
          PortPinLevelValue = PORT_PIN_LEVEL_LOW
          PortPinInitialMode = DIO
          PortPinDirection = PORT_PIN_IN
          PortInputBufferControl = false
          PortBiDirectionControl = false
          PortPullUpOption = false
          PortPullDownOption = false
          PortOpenDrainControl_Expansion = OpenDrain_PushPull
          PortOutputLevelInversion = false
          PortOutputDriveStrength = SLOW
        PortPin9:
          PortPinDirectionChangeable = false
          PortPinDioAltModeChangeable = false
          PortPinModeChangeable = false
          PortPinLevelValue = PORT_PIN_LEVEL_LOW
          PortPinInitialMode = DIO
          PortPinDirection = PORT_PIN_IN
          PortInputBufferControl = false
          PortBiDirectionControl = false
          PortPullUpOption = false
          PortPullDownOption = false
          PortOpenDrainControl_Expansion = OpenDrain_PushPull
          PortOutputLevelInversion = false
          PortInputSelection = TYPE_1_SUPP_PISA
          PortOutputDriveStrength = SLOW
        PortPin10:
          PortPinDirectionChangeable = false
          PortPinDioAltModeChangeable = false
          PortPinModeChangeable = false
          PortPinLevelValue = PORT_PIN_LEVEL_LOW
          PortPinInitialMode = DIO
          PortPinDirection = PORT_PIN_IN
          PortInputBufferControl = false
          PortBiDirectionControl = false
          PortPullUpOption = false
          PortPullDownOption = false
          PortOpenDrainControl_Expansion = OpenDrain_PushPull
          PortOutputLevelInversion = false
          PortInputSelection = TYPE_1_SUPP_PISA
          PortOutputDriveStrength = SLOW
        PortPin11:
          PortPinDirectionChangeable = false
          PortPinDioAltModeChangeable = false
          PortPinModeChangeable = false
          PortPinLevelValue = PORT_PIN_LEVEL_LOW
          PortPinInitialMode = DIO
          PortPinDirection = PORT_PIN_IN
          PortInputBufferControl = true
          PortBiDirectionControl = false
          PortPullUpOption = false
          PortPullDownOption = false
          PortOpenDrainControl_Expansion = OpenDrain_PushPull
          PortOutputLevelInversion = false
          PortOutputDriveStrength = SLOW
        PortPin12:
          PortPinDirectionChangeable = false
          PortPinDioAltModeChangeable = false
          PortPinModeChangeable = false
          PortPinLevelValue = PORT_PIN_LEVEL_LOW
          PortPinInitialMode = DIO
          PortPinDirection = PORT_PIN_IN
          PortInputBufferControl = false
          PortBiDirectionControl = false
          PortPullUpOption = false
          PortPullDownOption = false
          PortOpenDrainControl_Expansion = OpenDrain_PushPull
          PortOutputLevelInversion = false
          PortInputSelection = TYPE_1_SUPP_PISA
          PortOutputDriveStrength = SLOW
        PortPin13:
          PortPinDirectionChangeable = false
          PortPinDioAltModeChangeable = false
          PortPinModeChangeable = false
          PortPinLevelValue = PORT_PIN_LEVEL_LOW
          PortPinInitialMode = DIO
          PortPinDirection = PORT_PIN_IN
          PortInputBufferControl = false
          PortBiDirectionControl = false
          PortPullUpOption = false
          PortPullDownOption = false
          PortOpenDrainControl_Expansion = OpenDrain_PushPull
          PortOutputLevelInversion = false
          PortInputSelection = TYPE_1_SUPP_PISA
          PortOutputDriveStrength = SLOW
        PortPin14:
          PortPinDirectionChangeable = false
          PortPinDioAltModeChangeable = false
          PortPinModeChangeable = false
          PortPinLevelValue = PORT_PIN_LEVEL_LOW
          PortPinInitialMode = DIO
          PortPinDirection = PORT_PIN_IN
          PortInputBufferControl = false
          PortBiDirectionControl = false
          PortPullUpOption = false
          PortPullDownOption = false
          PortOpenDrainControl_Expansion = OpenDrain_PushPull
          PortOutputLevelInversion = false
          PortOutputDriveStrength = SLOW
      PortGroup5
        PortPin0:
          PortPinDirectionChangeable = false
          PortPinDioAltModeChangeable = false
          PortPinModeChangeable = false
          PortPinLevelValue = PORT_PIN_LEVEL_LOW
          PortPinInitialMode = CSIG0SI_ALT1_IN
          PortPinDirection = PORT_PIN_IN
          PortInputBufferControl = false
          PortBiDirectionControl = false
          PortPullUpOption = false
          PortPullDownOption = false
          PortOpenDrainControl_Expansion = OpenDrain_PushPull
          PortOutputLevelInversion = false
          PortOutputDriveStrength = SLOW
        PortPin1:
          PortPinDirectionChangeable = false
          PortPinDioAltModeChangeable = false
          PortPinModeChangeable = false
          PortPinLevelValue = PORT_PIN_LEVEL_LOW
          PortPinInitialMode = CSIG0SO_ALT1_OUT
          PortPinDirection = PORT_PIN_OUT
          PortInputBufferControl = false
          PortBiDirectionControl = false
          PortPullUpOption = false
          PortPullDownOption = false
          PortOpenDrainControl_Expansion = OpenDrain_PushPull
          PortOutputLevelInversion = false
          PortOutputDriveStrength = SLOW
          PortIpControl = true
        PortPin2:
          PortPinDirectionChangeable = false
          PortPinDioAltModeChangeable = false
          PortPinModeChangeable = false
          PortPinLevelValue = PORT_PIN_LEVEL_LOW
          PortPinInitialMode = DIO
          PortPinDirection = PORT_PIN_IN
          PortInputBufferControl = false
          PortBiDirectionControl = false
          PortIpControl = false
          PortPullUpOption = false
          PortPullDownOption = false
          PortOpenDrainControl_Expansion = OpenDrain_PushPull
          PortOutputLevelInversion = false
          PortOutputDriveStrength = SLOW
        PortPin3:
          PortPinDirectionChangeable = false
          PortPinDioAltModeChangeable = false
          PortPinModeChangeable = false
          PortPinLevelValue = PORT_PIN_LEVEL_HIGH
          PortPinDirection = PORT_PIN_OUT
          PortInputBufferControl = false
          PortBiDirectionControl = false
          PortPullUpOption = false
          PortPullDownOption = false
          PortOpenDrainControl_Expansion = OpenDrain_PushPull
          PortOutputLevelInversion = false
          PortOutputDriveStrength = SLOW
          PortPinInitialMode = DIO_SUPP_PFCE_PFCAE_PMCSR
        PortPin4:
          PortPinDirectionChangeable = false
          PortPinDioAltModeChangeable = false
          PortPinModeChangeable = false
          PortPinLevelValue = PORT_PIN_LEVEL_LOW
          PortPinInitialMode = CSIG0SCO_ALT1_OUT
          PortPinDirection = PORT_PIN_OUT
          PortInputBufferControl = false
          PortBiDirectionControl = false
          PortIpControl = false
          PortPullUpOption = false
          PortPullDownOption = false
          PortOpenDrainControl_Expansion = OpenDrain_PushPull
          PortOutputLevelInversion = false
          PortOutputDriveStrength = SLOW
        PortPin5:
          PortPinDirectionChangeable = false
          PortPinDioAltModeChangeable = false
          PortPinModeChangeable = true
          PortPinLevelValue = PORT_PIN_LEVEL_HIGH
          PortPinInitialMode = DIO
          PortPinDirection = PORT_PIN_IN
          PortInputBufferControl = false
          PortBiDirectionControl = true
          PortPullUpOption = false
          PortPullDownOption = false
          PortOpenDrainControl_Expansion = OpenDrain_N_Channel
          PortOutputLevelInversion = false
          PortOutputDriveStrength = SLOW
        PortPin6:
          PortPinDirectionChangeable = false
          PortPinDioAltModeChangeable = false
          PortPinModeChangeable = false
          PortPinLevelValue = PORT_PIN_LEVEL_LOW
          PortPinInitialMode = DIO
          PortPinDirection = PORT_PIN_IN
          PortInputBufferControl = false
          PortBiDirectionControl = false
          PortPullUpOption = false
          PortPullDownOption = false
          PortOpenDrainControl_Expansion = OpenDrain_PushPull
          PortOutputLevelInversion = false
          PortOutputDriveStrength = SLOW
        PortPin7:
          PortPinDirectionChangeable = false
          PortPinDioAltModeChangeable = false
          PortPinModeChangeable = false
          PortPinLevelValue = PORT_PIN_LEVEL_LOW
          PortPinInitialMode = DIO
          PortPinDirection = PORT_PIN_IN
          PortInputBufferControl = true
          PortBiDirectionControl = false
          PortPullUpOption = false
          PortPullDownOption = false
          PortOpenDrainControl_Expansion = OpenDrain_PushPull
          PortOutputLevelInversion = false
          PortOutputDriveStrength = SLOW
        PortPin8:
          PortPinDirectionChangeable = false
          PortPinDioAltModeChangeable = false
          PortPinModeChangeable = true
          PortPinLevelValue = PORT_PIN_LEVEL_HIGH
          PortPinInitialMode = DIO
          PortPinDirection = PORT_PIN_IN
          PortInputBufferControl = false
          PortBiDirectionControl = true
          PortPullUpOption = false
          PortPullDownOption = false
          PortOpenDrainControl_Expansion = OpenDrain_N_Channel
          PortOutputLevelInversion = false
          PortOutputDriveStrength = SLOW
        PortPin9:
          PortPinDirectionChangeable = false
          PortPinDioAltModeChangeable = false
          PortPinModeChangeable = false
          PortPinLevelValue = PORT_PIN_LEVEL_HIGH
          PortPinInitialMode = DIO
          PortPinDirection = PORT_PIN_OUT
          PortInputBufferControl = false
          PortBiDirectionControl = false
          PortPullUpOption = false
          PortPullDownOption = false
          PortOpenDrainControl_Expansion = OpenDrain_PushPull
          PortOutputLevelInversion = false
          PortOutputDriveStrength = SLOW
        PortPin10:
          PortPinDirectionChangeable = false
          PortPinDioAltModeChangeable = false
          PortPinModeChangeable = false
          PortPinLevelValue = PORT_PIN_LEVEL_LOW
          PortPinInitialMode = DIO
          PortPinDirection = PORT_PIN_OUT
          PortInputBufferControl = false
          PortBiDirectionControl = false
          PortPullUpOption = false
          PortPullDownOption = false
          PortOpenDrainControl_Expansion = OpenDrain_PushPull
          PortOutputLevelInversion = false
          PortOutputDriveStrength = SLOW
        PortPin11:
          PortPinDirectionChangeable = false
          PortPinDioAltModeChangeable = false
          PortPinModeChangeable = true
          PortPinLevelValue = PORT_PIN_LEVEL_HIGH
          PortPinDirection = PORT_PIN_IN
          PortInputBufferControl = false
          PortBiDirectionControl = true
          PortPullUpOption = false
          PortPullDownOption = false
          PortOpenDrainControl_Expansion = OpenDrain_N_Channel
          PortOutputLevelInversion = false
          PortOutputDriveStrength = SLOW
          PortPinInitialMode = DIO_SUPP_PFC_PFCE_PMCSR
        PortPin12:
          PortPinDirectionChangeable = false
          PortPinDioAltModeChangeable = false
          PortPinModeChangeable = true
          PortPinLevelValue = PORT_PIN_LEVEL_HIGH
          PortPinDirection = PORT_PIN_IN
          PortInputBufferControl = false
          PortBiDirectionControl = true
          PortPullUpOption = false
          PortPullDownOption = false
          PortOpenDrainControl_Expansion = OpenDrain_N_Channel
          PortOutputLevelInversion = false
          PortOutputDriveStrength = SLOW
          PortPinInitialMode = DIO_SUPP_PFC_PFCE_PMCSR
        PortPin13:
          PortPinDirectionChangeable = false
          PortPinDioAltModeChangeable = false
          PortPinModeChangeable = false
          PortPinLevelValue = PORT_PIN_LEVEL_LOW
          PortPinInitialMode = DIO
          PortPinDirection = PORT_PIN_IN
          PortInputBufferControl = false
          PortBiDirectionControl = false
          PortPullUpOption = false
          PortPullDownOption = false
          PortOpenDrainControl_Expansion = OpenDrain_PushPull
          PortOutputLevelInversion = false
          PortOutputDriveStrength = SLOW
        PortPin14:
          PortPinDirectionChangeable = false
          PortPinDioAltModeChangeable = false
          PortPinModeChangeable = false
          PortPinLevelValue = PORT_PIN_LEVEL_LOW
          PortPinInitialMode = TAUJ0I0_ALT1_IN
          PortPinDirection = PORT_PIN_IN
          PortInputBufferControl = false
          PortBiDirectionControl = false
          PortPullUpOption = false
          PortPullDownOption = false
          PortOpenDrainControl_Expansion = OpenDrain_PushPull
          PortOutputLevelInversion = false
          PortOutputDriveStrength = SLOW
        PortPin15:
          PortPinDirectionChangeable = false
          PortPinDioAltModeChangeable = false
          PortPinModeChangeable = false
          PortPinLevelValue = PORT_PIN_LEVEL_LOW
          PortPinDirection = PORT_PIN_IN
          PortInputBufferControl = false
          PortBiDirectionControl = false
          PortPullUpOption = false
          PortPullDownOption = false
          PortOpenDrainControl_Expansion = OpenDrain_PushPull
          PortOutputLevelInversion = false
          PortOutputDriveStrength = SLOW
          PortPinInitialMode = DIO_SUPP_PFC_PFCAE_PMCSR
      PortGroupJtag0
        PortPin0:
          PortPinDirectionChangeable = false
          PortPinDioAltModeChangeable = false
          PortPinModeChangeable = false
          PortPinLevelValue = PORT_PIN_LEVEL_LOW
          PortPinInitialMode = DIO_SUPP_PFCE_PMCSR
          PortPinDirection = PORT_PIN_IN
          PortInputBufferControl = false
          PortBiDirectionControl = false
          PortPullUpOption = false
          PortPullDownOption = false
          PortOpenDrainControl_Expansion = OpenDrain_PushPull_SUPP_PODC
          PortInputSelection = TYPE_1_SUPP_PISA
          PortOutputDriveStrength = SLOW
        PortPin1:
          PortPinDirectionChangeable = false
          PortPinDioAltModeChangeable = false
          PortPinModeChangeable = false
          PortPinLevelValue = PORT_PIN_LEVEL_LOW
          PortPinInitialMode = DIO_SUPP_PFCE_PMCSR
          PortPinDirection = PORT_PIN_IN
          PortInputBufferControl = false
          PortBiDirectionControl = false
          PortPullUpOption = false
          PortPullDownOption = false
          PortOpenDrainControl_Expansion = OpenDrain_PushPull_SUPP_PODC
          PortInputSelection = TYPE_1_SUPP_PISA
          PortOutputDriveStrength = SLOW
        PortPin2:
          PortPinDioAltModeChangeable = false
          PortPinModeChangeable = false
          PortPinInitialMode = DIO_SUPP_PFCE_PMCSR
          PortPinDirection = PORT_PIN_IN
          PortInputBufferControl = false
          PortInputSelection = TYPE_1_SUPP_PISA
        PortPin3:
          PortPinDirectionChangeable = false
          PortPinDioAltModeChangeable = false
          PortPinModeChangeable = false
          PortPinLevelValue = PORT_PIN_LEVEL_LOW
          PortPinDirection = PORT_PIN_IN
          PortInputBufferControl = false
          PortBiDirectionControl = false
          PortPullUpOption = false
          PortPullDownOption = false
          PortOpenDrainControl_Expansion = OpenDrain_PushPull_SUPP_PODC
          PortInputSelection = TYPE_1_SUPP_PISA
          PortOutputDriveStrength = SLOW
          PortPinInitialMode = ALT_NOT_SUPPORTED
        PortPin4:
          PortPinDioAltModeChangeable = false
          PortPinModeChangeable = false
          PortPinLevelValue = PORT_PIN_LEVEL_LOW
          PortPinDirection = PORT_PIN_IN
          PortInputBufferControl = false
          PortBiDirectionControl = false
          PortPullUpOption = false
          PortPullDownOption = false
          PortPinInitialMode = ALT_NOT_SUPPORTED
        PortPin5:
          PortPinDirectionChangeable = false
          PortPinDioAltModeChangeable = false
          PortPinModeChangeable = false
          PortPinLevelValue = PORT_PIN_LEVEL_LOW
          PortPinDirection = PORT_PIN_IN
          PortInputBufferControl = false
          PortBiDirectionControl = false
          PortPullUpOption = false
          PortPullDownOption = false
          PortOpenDrainControl_Expansion = OpenDrain_PushPull_SUPP_PODC
          PortInputSelection = TYPE_1_SUPP_PISA
          PortOutputDriveStrength = SLOW
          PortPinInitialMode = ALT_NOT_SUPPORTED
    PortGeneral:
      PortDevErrorDetect = true
      PortSetPinModeApi = true
      PortVersionCheckExternalModules = false
      PortDeviceName = R7F701311
      PortCriticalSectionProtection = true
      PortMaxMode = 6
      PortSetToDioAltModeApi = true
      PortWriteVerify = WV_INIT_RUNTIME
      PortWriteVerifyErrorInterface = PortWrVrfyFailr
      PortUseWriteVerifyErrorInterface = true
      PortLoopTimeout = 5
      PortVersionInfoApi = false
      PortSetPinDirectionApi = false
      PortSetPinDefaultDirectionApi = false
      PortSetPinDefaultModeApi = false
    PortDemEventParameterRefs: PORT_E_WRITE_TIMEOUT_FAILURE=PORT_E_WRITE_TIMEOUT_FAILURE, PORT_E_REG_WRITE_VERIFY=PORT_E_REG_WRITE_VERIFY
