AUTOSAR XML (schema 4-0-3)
package /ActiveEcuC
  module config TunSelnMngt: implementation-config-variant=VARIANT-PRE-COMPILE
    3 x CalRegions:
      CalRegn01
        CalRegn01Rt00 (RuntimeComponent): ComponentPartOfIntegration=true
        CalRegn01Inin00 (InitializationComponent): ComponentPartOfIntegration=true
        CalRegn01Inin00GroupB (InitializationComponent): ComponentPartOfIntegration=true
        3 x CommonComponent, all with ComponentPartOfIntegration=true:
          CalRegn01Cmn
          CalRegn01CmnGroupB
          CalRegn01CmnGroupC
        CalRegn01Inin00GroupC (InitializationComponent): ComponentPartOfIntegration=true
        4 x RuntimeComponent, all with ComponentPartOfIntegration=false, RuntimeComponentReference=CalRegn01Rt00:
          CalRegn01Rt{01..04}
      CalRegn02
        CalRegn02Cmn (CommonComponent): ComponentPartOfIntegration=true
        CalRegn02CmnGroupC (CommonComponent): ComponentPartOfIntegration=true
        CalRegn02Inin00 (InitializationComponent): ComponentPartOfIntegration=true
        CalRegn02CmnGroupA (CommonComponent): ComponentPartOfIntegration=true
        CalRegn02CmnGroupB (CommonComponent): ComponentPartOfIntegration=true
        CalRegn02Inin00GroupA (InitializationComponent): ComponentPartOfIntegration=true
        CalRegn02Inin00GroupC (InitializationComponent): ComponentPartOfIntegration=true
        5 x RuntimeComponent:
          CalRegn02Rt00GroupC: ComponentPartOfIntegration=true
          CalRegn02Rt{01..04}GroupC: ComponentPartOfIntegration=false, RuntimeComponentReference=CalRegn02Rt00GroupC
      CalRegn03
        CalRegn03Rt00GroupA (RuntimeComponent): ComponentPartOfIntegration=true
        CalRegn03Rt00GroupB (RuntimeComponent): ComponentPartOfIntegration=true
        CalRegn03Inin00 (InitializationComponent): ComponentPartOfIntegration=true
        CalRegn03Inin00GroupA (InitializationComponent): ComponentPartOfIntegration=true
        CalRegn03CmnGroupA (CommonComponent): ComponentPartOfIntegration=true
        CalRegn03Cmn (CommonComponent): ComponentPartOfIntegration=true
        CalRegn03Inin00GroupC (InitializationComponent): ComponentPartOfIntegration=true
        CalRegn03CmnGroupB (CommonComponent): ComponentPartOfIntegration=true
        CalRegn03Inin00GroupB (InitializationComponent): ComponentPartOfIntegration=true
        8 x RuntimeComponent, all with ComponentPartOfIntegration=false:
          CalRegn03Rt01GroupA: RuntimeComponentReference=CalRegn03Rt00GroupA
          CalRegn03Rt01GroupB: RuntimeComponentReference=CalRegn03Rt00GroupB
          CalRegn03Rt02GroupA: RuntimeComponentReference=CalRegn03Rt00GroupA
          CalRegn03Rt02GroupB: RuntimeComponentReference=CalRegn03Rt00GroupB
          CalRegn03Rt03GroupA: RuntimeComponentReference=CalRegn03Rt00GroupA
          CalRegn03Rt03GroupB: RuntimeComponentReference=CalRegn03Rt00GroupB
          CalRegn03Rt04GroupA: RuntimeComponentReference=CalRegn03Rt00GroupA
          CalRegn03Rt04GroupB: RuntimeComponentReference=CalRegn03Rt00GroupB
        CalRegn03CmnGroupC (CommonComponent): ComponentPartOfIntegration=true
        5 x RuntimeComponent:
          CalRegn03Rt00: ComponentPartOfIntegration=true
          CalRegn03Rt{01..04}: ComponentPartOfIntegration=false, RuntimeComponentReference=CalRegn03Rt00
    CalibrationConfiguration
      RtIdx00 (RuntimeSelectableCalibrationConfiguration):
        RuntimeIndex = 0
        RuntimeComponentReference = CalRegn01Rt00
        RuntimeComponentReference = CalRegn02Rt00GroupC
        RuntimeComponentReference = CalRegn03Rt00
        RuntimeComponentReference = CalRegn03Rt00GroupA
        RuntimeComponentReference = CalRegn03Rt00GroupB
      IninIdx00 (InitializationCalibrationConfiguration):
        InitializationIndex = 0
        InitializationComponentReference = CalRegn03Inin00
        InitializationComponentReference = CalRegn03Inin00GroupA
        InitializationComponentReference = CalRegn03Inin00GroupB
        InitializationComponentReference = CalRegn03Inin00GroupC
        InitializationComponentReference = CalRegn01Inin00
        InitializationComponentReference = CalRegn01Inin00GroupB
        InitializationComponentReference = CalRegn01Inin00GroupC
        InitializationComponentReference = CalRegn02Inin00
        InitializationComponentReference = CalRegn02Inin00GroupA
        InitializationComponentReference = CalRegn02Inin00GroupC
      4 x RuntimeSelectableCalibrationConfiguration:
        RtIdx01: RuntimeIndex=1, RuntimeComponentReference=CalRegn01Rt01, RuntimeComponentReference=CalRegn02Rt01GroupC, RuntimeComponentReference=CalRegn03Rt01, RuntimeComponentReference=CalRegn03Rt01GroupA, RuntimeComponentReference=CalRegn03Rt01GroupB
        RtIdx02: RuntimeIndex=2, RuntimeComponentReference=CalRegn01Rt02, RuntimeComponentReference=CalRegn02Rt02GroupC, RuntimeComponentReference=CalRegn03Rt02, RuntimeComponentReference=CalRegn03Rt02GroupA, RuntimeComponentReference=CalRegn03Rt02GroupB
        RtIdx03: RuntimeIndex=3, RuntimeComponentReference=CalRegn01Rt03, RuntimeComponentReference=CalRegn02Rt03GroupC, RuntimeComponentReference=CalRegn03Rt03, RuntimeComponentReference=CalRegn03Rt03GroupA, RuntimeComponentReference=CalRegn03Rt03GroupB
        RtIdx04: RuntimeIndex=4, RuntimeComponentReference=CalRegn01Rt04, RuntimeComponentReference=CalRegn02Rt04GroupC, RuntimeComponentReference=CalRegn03Rt04, RuntimeComponentReference=CalRegn03Rt04GroupA, RuntimeComponentReference=CalRegn03Rt04GroupB
    3 x OnlineCalibrationGroup:
      GroupA: GroupIndex=0, RuntimeComponentReference=CalRegn03Rt00GroupA, RuntimeComponentReference=CalRegn03Rt01GroupA, RuntimeComponentReference=CalRegn03Rt02GroupA, RuntimeComponentReference=CalRegn03Rt03GroupA, RuntimeComponentReference=CalRegn03Rt04GroupA, CommonComponentReference=CalRegn03CmnGroupA, CommonComponentReference=CalRegn02CmnGroupA, InitializationComponentReference=CalRegn03Inin00GroupA, InitializationComponentReference=CalRegn02Inin00GroupA
      GroupB: GroupIndex=1, InitializationComponentReference=CalRegn03Inin00GroupB, RuntimeComponentReference=CalRegn03Rt00GroupB, InitializationComponentReference=CalRegn01Inin00GroupB, RuntimeComponentReference=CalRegn03Rt01GroupB, RuntimeComponentReference=CalRegn03Rt02GroupB, RuntimeComponentReference=CalRegn03Rt03GroupB, RuntimeComponentReference=CalRegn03Rt04GroupB, CommonComponentReference=CalRegn03CmnGroupB, CommonComponentReference=CalRegn01CmnGroupB, CommonComponentReference=CalRegn02CmnGroupB
      GroupC: GroupIndex=2, CommonComponentReference=CalRegn03CmnGroupC, InitializationComponentReference=CalRegn03Inin00GroupC, RuntimeComponentReference=CalRegn02Rt00GroupC, CommonComponentReference=CalRegn01CmnGroupC, InitializationComponentReference=CalRegn01Inin00GroupC, RuntimeComponentReference=CalRegn02Rt01GroupC, RuntimeComponentReference=CalRegn02Rt02GroupC, RuntimeComponentReference=CalRegn02Rt03GroupC, RuntimeComponentReference=CalRegn02Rt04GroupC, CommonComponentReference=CalRegn02CmnGroupC, InitializationComponentReference=CalRegn02Inin00GroupC
    TunSelnMngtCommon: OnlineCalibrationRamSize=5000
    XcpWriteAccess: EnableDevelopmentMode=STD_OFF
      XcpWriteAccessRegions:
        StartingAddress = 0
        EndingAddress = 0
        UseSymbolName = true
        ProductionModeOnly = false
        StartingAddressSymbol = osGlobalShared_StartAddr
        EndingAddressSymbol = osGlobalShared_EndAddr + 4
