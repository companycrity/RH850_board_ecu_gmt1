AUTOSAR XML (schema 4-0-3)
package /MICROSAR/IoHwAb_ib_bswmd/BswModuleDescriptions
  bsw module description IoHwAb
    bsw internal behavior IoHwAbBehavior
      exclusive area IOHWAB_EXCLUSIVE_AREA_0
