AUTOSAR XML (schema 4-1-2)
package /MICROSAR/Dem_ib_bswmd/BswModuleDescriptions
  bsw module description Dem: provided-entrys=Dem_MainFunction
    bsw internal behavior DemBehavior
      exclusive area DEM_EXCLUSIVE_AREA_{0..2}
      bsw schedulable entity Dem_MainFunction: implemented-entry=Dem_MainFunction
      bsw timing event Dem_MainFunctionTimingEvent0: starts-on-event=Dem_MainFunction, period=0.01
  bsw module entry Dem_MainFunction: call-type=SCHEDULED, execution-context=TASK
