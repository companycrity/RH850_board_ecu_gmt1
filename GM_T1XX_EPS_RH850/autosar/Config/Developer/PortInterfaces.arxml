[part 1 of 2: packages /DataDictionary/Calibrations to /Nexteer/CDD_NvMProxy_swc/Interfaces]
AUTOSAR XML (schema 4-0-3)
package /DataDictionary/Calibrations
  168 x parameter interface:
    Ary1D_boolean_4_CalPortIf1
      parameter data prototype Ary1D: sw-calibration-access=READ-WRITE, type=Ary1D_boolean_4
    Ary1D_float32_4_CalPortIf1
      parameter data prototype Ary1D: sw-calibration-access=READ-WRITE, type=Ary1D_float32_4
    Ary1D_float32_8_CalPortIf1
      parameter data prototype Ary1D: sw-calibration-access=READ-WRITE, type=Ary1D_float32_8
    Ary1D_s11p4_11_CalPortIf1
      parameter data prototype Ary1D: sw-calibration-access=READ-WRITE, type=Ary1D_s11p4_11
    Ary1D_s11p4_14_CalPortIf1
      parameter data prototype Ary1D: sw-calibration-access=READ-WRITE, type=Ary1D_s11p4_14
    Ary1D_s11p4_5_CalPortIf1
      parameter data prototype Ary1D: sw-calibration-access=READ-WRITE, type=Ary1D_s11p4_5
    Ary1D_s14p1_8_CalPortIf1
      parameter data prototype Ary1D: sw-calibration-access=READ-WRITE, type=Ary1D_s14p1_8
    Ary1D_s15p0_4_CalPortIf1
      parameter data prototype Ary1D: sw-calibration-access=READ-WRITE, type=Ary1D_s15p0_4
    Ary1D_s15p0_5_CalPortIf1
      parameter data prototype Ary1D: sw-calibration-access=READ-WRITE, type=Ary1D_s15p0_5
    Ary1D_s4p11_20_CalPortIf1
      parameter data prototype Ary1D: sw-calibration-access=READ-WRITE, type=Ary1D_s4p11_20
    Ary1D_s4p11_5_CalPortIf1
      parameter data prototype Ary1D: sw-calibration-access=READ-WRITE, type=Ary1D_s4p11_5
    Ary1D_s8p7_14_CalPortIf1
      parameter data prototype Ary1D: sw-calibration-access=READ-WRITE, type=Ary1D_s8p7_14
    Ary1D_s8p7_3_CalPortIf1
      parameter data prototype Ary1D: sw-calibration-access=READ-WRITE, type=Ary1D_s8p7_3
    Ary1D_sint16_22_CalPortIf1
      parameter data prototype Ary1D: sw-calibration-access=READ-WRITE, type=Ary1D_sint16_22
    Ary1D_u08_22_CalPortIf1
      parameter data prototype Ary1D: sw-calibration-access=READ-WRITE, type=Ary1D_u08_22
    Ary1D_u0p16_10_CalPortIf1
      parameter data prototype Ary1D: sw-calibration-access=READ-WRITE, type=Ary1D_u0p16_10
    Ary1D_u0p16_3_CalPortIf1
      parameter data prototype Ary1D: sw-calibration-access=READ-WRITE, type=Ary1D_u0p16_3
    Ary1D_u10p6_13_CalPortIf1
      parameter data prototype Ary1D: sw-calibration-access=READ-WRITE, type=Ary1D_u10p6_13
    Ary1D_u10p6_3_CalPortIf1
      parameter data prototype Ary1D: sw-calibration-access=READ-WRITE, type=Ary1D_u10p6_3
    Ary1D_u10p6_4_CalPortIf1
      parameter data prototype Ary1D: sw-calibration-access=READ-WRITE, type=Ary1D_u10p6_4
    Ary1D_u10p6_5_CalPortIf1
      parameter data prototype Ary1D: sw-calibration-access=READ-WRITE, type=Ary1D_u10p6_5
    Ary1D_u10p6_7_CalPortIf1
      parameter data prototype Ary1D: sw-calibration-access=READ-WRITE, type=Ary1D_u10p6_7
    Ary1D_u10p6_8_CalPortIf1
      parameter data prototype Ary1D: sw-calibration-access=READ-WRITE, type=Ary1D_u10p6_8
    Ary1D_u11p5_10_CalPortIf1
      parameter data prototype Ary1D: sw-calibration-access=READ-WRITE, type=Ary1D_u11p5_10
    Ary1D_u11p5_11_CalPortIf1
      parameter data prototype Ary1D: sw-calibration-access=READ-WRITE, type=Ary1D_u11p5_11
    Ary1D_u11p5_13_CalPortIf1
      parameter data prototype Ary1D: sw-calibration-access=READ-WRITE, type=Ary1D_u11p5_13
    Ary1D_u11p5_4_CalPortIf1
      parameter data prototype Ary1D: sw-calibration-access=READ-WRITE, type=Ary1D_u11p5_4
    Ary1D_u11p5_6_CalPortIf1
      parameter data prototype Ary1D: sw-calibration-access=READ-WRITE, type=Ary1D_u11p5_6
    Ary1D_u11p5_8_CalPortIf1
      parameter data prototype Ary1D: sw-calibration-access=READ-WRITE, type=Ary1D_u11p5_8
    Ary1D_u12p4_2_CalPortIf1
      parameter data prototype Ary1D: sw-calibration-access=READ-WRITE, type=Ary1D_u12p4_2
    Ary1D_u12p4_7_CalPortIf1
      parameter data prototype Ary1D: sw-calibration-access=READ-WRITE, type=Ary1D_u12p4_7
    Ary1D_u13p3_2_CalPortIf1
      parameter data prototype Ary1D: sw-calibration-access=READ-WRITE, type=Ary1D_u13p3_2
    Ary1D_u13p3_6_CalPortIf1
      parameter data prototype Ary1D: sw-calibration-access=READ-WRITE, type=Ary1D_u13p3_6
    Ary1D_u16p0_2_CalPortIf1
      parameter data prototype Ary1D: sw-calibration-access=READ-WRITE, type=Ary1D_u16p0_2
    Ary1D_u16p0_20_CalPortIf1
      parameter data prototype Ary1D: sw-calibration-access=READ-WRITE, type=Ary1D_u16p0_20
    Ary1D_u16p0_8_CalPortIf1
      parameter data prototype Ary1D: sw-calibration-access=READ-WRITE, type=Ary1D_u16p0_8
    Ary1D_u1p15_10_CalPortIf1
      parameter data prototype Ary1D: sw-calibration-access=READ-WRITE, type=Ary1D_u1p15_10
    Ary1D_u1p15_11_CalPortIf1
      parameter data prototype Ary1D: sw-calibration-access=READ-WRITE, type=Ary1D_u1p15_11
    Ary1D_u1p15_12_CalPortIf1
      parameter data prototype Ary1D: sw-calibration-access=READ-WRITE, type=Ary1D_u1p15_12
    Ary1D_u1p15_2_CalPortIf1
      parameter data prototype Ary1D: sw-calibration-access=READ-WRITE, type=Ary1D_u1p15_2
    Ary1D_u1p15_5_CalPortIf1
      parameter data prototype Ary1D: sw-calibration-access=READ-WRITE, type=Ary1D_u1p15_5
    Ary1D_u1p15_6_CalPortIf1
      parameter data prototype Ary1D: sw-calibration-access=READ-WRITE, type=Ary1D_u1p15_6
    Ary1D_u2p14_12_CalPortIf1
      parameter data prototype Ary1D: sw-calibration-access=READ-WRITE, type=Ary1D_u2p14_12
    Ary1D_u2p14_16_CalPortIf1
      parameter data prototype Ary1D: sw-calibration-access=READ-WRITE, type=Ary1D_u2p14_16
    Ary1D_u2p14_2_CalPortIf1
      parameter data prototype Ary1D: sw-calibration-access=READ-WRITE, type=Ary1D_u2p14_2
    Ary1D_u2p14_3_CalPortIf1
      parameter data prototype Ary1D: sw-calibration-access=READ-WRITE, type=Ary1D_u2p14_3
    Ary1D_u2p14_4_CalPortIf1
      parameter data prototype Ary1D: sw-calibration-access=READ-WRITE, type=Ary1D_u2p14_4
    Ary1D_u2p14_5_CalPortIf1
      parameter data prototype Ary1D: sw-calibration-access=READ-WRITE, type=Ary1D_u2p14_5
    Ary1D_u2p14_6_CalPortIf1
      parameter data prototype Ary1D: sw-calibration-access=READ-WRITE, type=Ary1D_u2p14_6
    Ary1D_u2p14_8_CalPortIf1
      parameter data prototype Ary1D: sw-calibration-access=READ-WRITE, type=Ary1D_u2p14_8
    Ary1D_u3p13_10_CalPortIf1
      parameter data prototype Ary1D: sw-calibration-access=READ-WRITE, type=Ary1D_u3p13_10
    Ary1D_u3p13_5_CalPortIf1
      parameter data prototype Ary1D: sw-calibration-access=READ-WRITE, type=Ary1D_u3p13_5
    Ary1D_u4p12_10_CalPortIf1
      parameter data prototype Ary1D: sw-calibration-access=READ-WRITE, type=Ary1D_u4p12_10
    Ary1D_u4p12_11_CalPortIf1
      parameter data prototype Ary1D: sw-calibration-access=READ-WRITE, type=Ary1D_u4p12_11
    Ary1D_u4p12_12_CalPortIf1
      parameter data prototype Ary1D: sw-calibration-access=READ-WRITE, type=Ary1D_u4p12_12
    Ary1D_u4p12_14_CalPortIf1
      parameter data prototype Ary1D: sw-calibration-access=READ-WRITE, type=Ary1D_u4p12_14
    Ary1D_u4p12_2_CalPortIf1
      parameter data prototype Ary1D: sw-calibration-access=READ-WRITE, type=Ary1D_u4p12_2
    Ary1D_u4p12_4_CalPortIf1
      parameter data prototype Ary1D: sw-calibration-access=READ-WRITE, type=Ary1D_u4p12_4
    Ary1D_u4p12_5_CalPortIf1
      parameter data prototype Ary1D: sw-calibration-access=READ-WRITE, type=Ary1D_u4p12_5
    Ary1D_u4p12_6_CalPortIf1
      parameter data prototype Ary1D: sw-calibration-access=READ-WRITE, type=Ary1D_u4p12_6
    Ary1D_u4p12_8_CalPortIf1
      parameter data prototype Ary1D: sw-calibration-access=READ-WRITE, type=Ary1D_u4p12_8
    Ary1D_u5p11_10_CalPortIf1
      parameter data prototype Ary1D: sw-calibration-access=READ-WRITE, type=Ary1D_u5p11_10
    Ary1D_u5p11_11_CalPortIf1
      parameter data prototype Ary1D: sw-calibration-access=READ-WRITE, type=Ary1D_u5p11_11
    Ary1D_u5p11_14_CalPortIf1
      parameter data prototype Ary1D: sw-calibration-access=READ-WRITE, type=Ary1D_u5p11_14
    Ary1D_u5p11_17_CalPortIf1
      parameter data prototype Ary1D: sw-calibration-access=READ-WRITE, type=Ary1D_u5p11_17
    Ary1D_u5p11_5_CalPortIf1
      parameter data prototype Ary1D: sw-calibration-access=READ-WRITE, type=Ary1D_u5p11_5
    Ary1D_u5p11_6_CalPortIf1
      parameter data prototype Ary1D: sw-calibration-access=READ-WRITE, type=Ary1D_u5p11_6
    Ary1D_u5p11_8_CalPortIf1
      parameter data prototype Ary1D: sw-calibration-access=READ-WRITE, type=Ary1D_u5p11_8
    Ary1D_u6p10_10_CalPortIf1
      parameter data prototype Ary1D: sw-calibration-access=READ-WRITE, type=Ary1D_u6p10_10
    Ary1D_u6p10_17_CalPortIf1
      parameter data prototype Ary1D: sw-calibration-access=READ-WRITE, type=Ary1D_u6p10_17
    Ary1D_u6p10_6_CalPortIf1
      parameter data prototype Ary1D: sw-calibration-access=READ-WRITE, type=Ary1D_u6p10_6
    Ary1D_u7p9_12_CalPortIf1
      parameter data prototype Ary1D: sw-calibration-access=READ-WRITE, type=Ary1D_u7p9_12
    Ary1D_u7p9_3_CalPortIf1
      parameter data prototype Ary1D: sw-calibration-access=READ-WRITE, type=Ary1D_u7p9_3
    Ary1D_u7p9_6_CalPortIf1
      parameter data prototype Ary1D: sw-calibration-access=READ-WRITE, type=Ary1D_u7p9_6
    Ary1D_u8_14_CalPortIf1
      parameter data prototype Ary1D: sw-calibration-access=READ-WRITE, type=Ary1D_u8_14
    Ary1D_u8_22_CalPortIf1
      parameter data prototype Ary1D: sw-calibration-access=READ-WRITE, type=Ary1D_u8_22
    Ary1D_u8_48_CalPortIf1
      parameter data prototype Ary1D: sw-calibration-access=READ-WRITE, type=Ary1D_u8_48
    Ary1D_u8_6_CalPortIf1
      parameter data prototype Ary1D: sw-calibration-access=READ-WRITE, type=Ary1D_u8_6
    Ary1D_u8p8_11_CalPortIf1
      parameter data prototype Ary1D: sw-calibration-access=READ-WRITE, type=Ary1D_u8p8_11
    Ary1D_u8p8_14_CalPortIf1
      parameter data prototype Ary1D: sw-calibration-access=READ-WRITE, type=Ary1D_u8p8_14
    Ary1D_u8p8_2_CalPortIf1
      parameter data prototype Ary1D: sw-calibration-access=READ-WRITE, type=Ary1D_u8p8_2
    Ary1D_u8p8_20_CalPortIf1
      parameter data prototype Ary1D: sw-calibration-access=READ-WRITE, type=Ary1D_u8p8_20
    Ary1D_u8p8_3_CalPortIf1
      parameter data prototype Ary1D: sw-calibration-access=READ-WRITE, type=Ary1D_u8p8_3
    Ary1D_u8p8_4_CalPortIf1
      parameter data prototype Ary1D: sw-calibration-access=READ-WRITE, type=Ary1D_u8p8_4
    Ary1D_u8p8_5_CalPortIf1
      parameter data prototype Ary1D: sw-calibration-access=READ-WRITE, type=Ary1D_u8p8_5
    Ary1D_u8p8_6_CalPortIf1
      parameter data prototype Ary1D: sw-calibration-access=READ-WRITE, type=Ary1D_u8p8_6
    Ary1D_u8p8_7_CalPortIf1
      parameter data prototype Ary1D: sw-calibration-access=READ-WRITE, type=Ary1D_u8p8_7
    Ary1D_u8p8_8_CalPortIf1
      parameter data prototype Ary1D: sw-calibration-access=READ-WRITE, type=Ary1D_u8p8_8
    Ary1D_u9p7_10_CalPortIf1
      parameter data prototype Ary1D: sw-calibration-access=READ-WRITE, type=Ary1D_u9p7_10
    Ary1D_u9p7_12_CalPortIf1
      parameter data prototype Ary1D: sw-calibration-access=READ-WRITE, type=Ary1D_u9p7_12
    Ary1D_u9p7_16_CalPortIf1
      parameter data prototype Ary1D: sw-calibration-access=READ-WRITE, type=Ary1D_u9p7_16
    Ary1D_u9p7_2_CalPortIf1
      parameter data prototype Ary1D: sw-calibration-access=READ-WRITE, type=Ary1D_u9p7_2
    Ary1D_u9p7_3_CalPortIf1
      parameter data prototype Ary1D: sw-calibration-access=READ-WRITE, type=Ary1D_u9p7_3
    Ary1D_u9p7_4_CalPortIf1
      parameter data prototype Ary1D: sw-calibration-access=READ-WRITE, type=Ary1D_u9p7_4
    Ary1D_u9p7_5_CalPortIf1
      parameter data prototype Ary1D: sw-calibration-access=READ-WRITE, type=Ary1D_u9p7_5
    Ary1D_u9p7_6_CalPortIf1
      parameter data prototype Ary1D: sw-calibration-access=READ-WRITE, type=Ary1D_u9p7_6
    Ary1D_u9p7_7_CalPortIf1
      parameter data prototype Ary1D: sw-calibration-access=READ-WRITE, type=Ary1D_u9p7_7
    Ary1D_u9p7_8_CalPortIf1
      parameter data prototype Ary1D: sw-calibration-access=READ-WRITE, type=Ary1D_u9p7_8
    Ary1D_u9p7_9_CalPortIf1
      parameter data prototype Ary1D: sw-calibration-access=READ-WRITE, type=Ary1D_u9p7_9
    Ary1D_uint32_512_CalPortIf1
      parameter data prototype Ary1D: sw-calibration-access=READ-WRITE, type=Ary1D_uint32_512
    Ary1D_uint8_14_CalPortIf1
      parameter data prototype Ary1D: sw-calibration-access=READ-WRITE, type=Ary1D_uint8_14
    Ary1D_uint8_22_CalPortIf1
      parameter data prototype Ary1D: sw-calibration-access=READ-WRITE, type=Ary1D_uint8_22
    Ary1D_uint8_48_CalPortIf1
      parameter data prototype Ary1D: sw-calibration-access=READ-WRITE, type=Ary1D_uint8_48
    Ary1D_uint8_6_CalPortIf1
      parameter data prototype Ary1D: sw-calibration-access=READ-WRITE, type=Ary1D_uint8_6
    Ary2D_float32_4_2_CalPortIf1
      parameter data prototype Ary2D: sw-calibration-access=READ-WRITE, type=Ary2D_float32_4_2
    Ary2D_float32_8_4_CalPortIf1
      parameter data prototype Ary2D: sw-calibration-access=READ-WRITE, type=Ary2D_float32_8_4
    Ary2D_s11p4_1_5_CalPortIf1
      parameter data prototype Ary2D: sw-calibration-access=READ-WRITE, type=Ary2D_s11p4_1_5
    Ary2D_s1p14_10_12_CalPortIf1
      parameter data prototype Ary2D: sw-calibration-access=READ-WRITE, type=Ary2D_s1p14_10_12
    Ary2D_s4p11_11_8_CalPortIf1
      parameter data prototype Ary2D: sw-calibration-access=READ-WRITE, type=Ary2D_s4p11_11_8
    Ary2D_s4p11_12_11_CalPortIf1
      parameter data prototype Ary2D: sw-calibration-access=READ-WRITE, type=Ary2D_s4p11_12_11
    Ary2D_s4p11_12_20_CalPortIf1
      parameter data prototype Ary2D: sw-calibration-access=READ-WRITE, type=Ary2D_s4p11_12_20
    Ary2D_s4p11_8_11_CalPortIf1
      parameter data prototype Ary2D: sw-calibration-access=READ-WRITE, type=Ary2D_s4p11_8_11
    Ary2D_s7p8_12_11_CalPortIf1
      parameter data prototype Ary2D: sw-calibration-access=READ-WRITE, type=Ary2D_s7p8_12_11
    Ary2D_s7p8_3_5_CalPortIf1
      parameter data prototype Ary2D: sw-calibration-access=READ-WRITE, type=Ary2D_s7p8_3_5
    Ary2D_s7p8_3_6_CalPortIf1
      parameter data prototype Ary2D: sw-calibration-access=READ-WRITE, type=Ary2D_s7p8_3_6
    Ary2D_s7p8_4_5_CalPortIf1
      parameter data prototype Ary2D: sw-calibration-access=READ-WRITE, type=Ary2D_s7p8_4_5
    Ary2D_s7p8_9_5_CalPortIf1
      parameter data prototype Ary2D: sw-calibration-access=READ-WRITE, type=Ary2D_s7p8_9_5
    Ary2D_s7p8_9_6_CalPortIf1
      parameter data prototype Ary2D: sw-calibration-access=READ-WRITE, type=Ary2D_s7p8_9_6
    Ary2D_u0p16_20_8_CalPortIf1
      parameter data prototype Ary2D: sw-calibration-access=READ-WRITE, type=Ary2D_u0p16_20_8
    Ary2D_u0p16_4_2_CalPortIf1
      parameter data prototype Ary2D: sw-calibration-access=READ-WRITE, type=Ary2D_u0p16_4_2
    Ary2D_u10p6_1_5_CalPortIf1
      parameter data prototype Ary2D: sw-calibration-access=READ-WRITE, type=Ary2D_u10p6_1_5
    Ary2D_u10p6_1_8_CalPortIf1
      parameter data prototype Ary2D: sw-calibration-access=READ-WRITE, type=Ary2D_u10p6_1_8
    Ary2D_u10p6_3_7_CalPortIf1
      parameter data prototype Ary2D: sw-calibration-access=READ-WRITE, type=Ary2D_u10p6_3_7
    Ary2D_u12p4_12_13_CalPortIf1
      parameter data prototype Ary2D: sw-calibration-access=READ-WRITE, type=Ary2D_u12p4_12_13
    Ary2D_u12p4_4_2_CalPortIf1
      parameter data prototype Ary2D: sw-calibration-access=READ-WRITE, type=Ary2D_u12p4_4_2
    Ary2D_u12p4_5_4_CalPortIf1
      parameter data prototype Ary2D: sw-calibration-access=READ-WRITE, type=Ary2D_u12p4_5_4
    Ary2D_u12p4_9_16_CalPortIf1
      parameter data prototype Ary2D: sw-calibration-access=READ-WRITE, type=Ary2D_u12p4_9_16
    Ary2D_u1p15_1_5_CalPortIf1
      parameter data prototype Ary2D: sw-calibration-access=READ-WRITE, type=Ary2D_u1p15_1_5
    Ary2D_u1p15_12_5_CalPortIf1
      parameter data prototype Ary2D: sw-calibration-access=READ-WRITE, type=Ary2D_u1p15_12_5
    Ary2D_u1p15_5_4_CalPortIf1
      parameter data prototype Ary2D: sw-calibration-access=READ-WRITE, type=Ary2D_u1p15_5_4
    Ary2D_u1p15_8_4_CalPortIf1
      parameter data prototype Ary2D: sw-calibration-access=READ-WRITE, type=Ary2D_u1p15_8_4
    Ary2D_u2p14_1_4_CalPortIf1
      parameter data prototype Ary2D: sw-calibration-access=READ-WRITE, type=Ary2D_u2p14_1_4
    Ary2D_u2p14_12_5_CalPortIf1
      parameter data prototype Ary2D: sw-calibration-access=READ-WRITE, type=Ary2D_u2p14_12_5
    Ary2D_u2p14_6_5_CalPortIf1
      parameter data prototype Ary2D: sw-calibration-access=READ-WRITE, type=Ary2D_u2p14_6_5
    Ary2D_u2p14_6_7_CalPortIf1
      parameter data prototype Ary2D: sw-calibration-access=READ-WRITE, type=Ary2D_u2p14_6_7
    Ary2D_u2p14_7_6_CalPortIf1
      parameter data prototype Ary2D: sw-calibration-access=READ-WRITE, type=Ary2D_u2p14_7_6
    Ary2D_u3p13_12_13_CalPortIf1
      parameter data prototype Ary2D: sw-calibration-access=READ-WRITE, type=Ary2D_u3p13_12_13
    Ary2D_u3p13_20_8_CalPortIf1
      parameter data prototype Ary2D: sw-calibration-access=READ-WRITE, type=Ary2D_u3p13_20_8
    Ary2D_u4p12_1_8_CalPortIf1
      parameter data prototype Ary2D: sw-calibration-access=READ-WRITE, type=Ary2D_u4p12_1_8
    Ary2D_u4p12_12_20_CalPortIf1
      parameter data prototype Ary2D: sw-calibration-access=READ-WRITE, type=Ary2D_u4p12_12_20
    Ary2D_u4p12_12_5_CalPortIf1
      parameter data prototype Ary2D: sw-calibration-access=READ-WRITE, type=Ary2D_u4p12_12_5
    Ary2D_u4p12_12_8_CalPortIf1
      parameter data prototype Ary2D: sw-calibration-access=READ-WRITE, type=Ary2D_u4p12_12_8
    Ary2D_u4p12_3_13_CalPortIf1
      parameter data prototype Ary2D: sw-calibration-access=READ-WRITE, type=Ary2D_u4p12_3_13
    Ary2D_u5p11_12_13_CalPortIf1
      parameter data prototype Ary2D: sw-calibration-access=READ-WRITE, type=Ary2D_u5p11_12_13
    Ary2D_u5p11_12_5_CalPortIf1
      parameter data prototype Ary2D: sw-calibration-access=READ-WRITE, type=Ary2D_u5p11_12_5
    Ary2D_u5p11_9_16_CalPortIf1
      parameter data prototype Ary2D: sw-calibration-access=READ-WRITE, type=Ary2D_u5p11_9_16
    Ary2D_u7p9_9_4_CalPortIf1
      parameter data prototype Ary2D: sw-calibration-access=READ-WRITE, type=Ary2D_u7p9_9_4
    Ary2D_u8p8_12_20_CalPortIf1
      parameter data prototype Ary2D: sw-calibration-access=READ-WRITE, type=Ary2D_u8p8_12_20
    Ary2D_u8p8_3_5_CalPortIf1
      parameter data prototype Ary2D: sw-calibration-access=READ-WRITE, type=Ary2D_u8p8_3_5
    Ary2D_u8p8_3_6_CalPortIf1
      parameter data prototype Ary2D: sw-calibration-access=READ-WRITE, type=Ary2D_u8p8_3_6
    Ary2D_u8p8_6_5_CalPortIf1
      parameter data prototype Ary2D: sw-calibration-access=READ-WRITE, type=Ary2D_u8p8_6_5
    Ary2D_u8p8_9_4_CalPortIf1
      parameter data prototype Ary2D: sw-calibration-access=READ-WRITE, type=Ary2D_u8p8_9_4
    Ary2D_u8p8_9_5_CalPortIf1
      parameter data prototype Ary2D: sw-calibration-access=READ-WRITE, type=Ary2D_u8p8_9_5
    Ary2D_u8p8_9_6_CalPortIf1
      parameter data prototype Ary2D: sw-calibration-access=READ-WRITE, type=Ary2D_u8p8_9_6
    Ary2D_u8p8_9_8_CalPortIf1
      parameter data prototype Ary2D: sw-calibration-access=READ-WRITE, type=Ary2D_u8p8_9_8
    Ary2D_uint16_8_3_CalPortIf1
      parameter data prototype Ary2D: sw-calibration-access=READ-WRITE, type=Ary2D_uint16_8_3
    boolean_CalPortIf1
      parameter data prototype Logl: sw-calibration-access=READ-WRITE, type=boolean
    FilNotchGainRec1_CalPortIf1
      parameter data prototype Rec: sw-calibration-access=READ-WRITE, type=FilNotchGainRec1
    float32_CalPortIf1
      parameter data prototype Val: sw-calibration-access=READ-WRITE, type=float32
    s18p13_CalPortIf1
      parameter data prototype Val: sw-calibration-access=READ-WRITE, type=s18p13
    sint8_CalPortIf1
      parameter data prototype Val: sw-calibration-access=READ-WRITE, type=sint8
    u0p16_CalPortIf1
      parameter data prototype Val: sw-calibration-access=READ-WRITE, type=u0p16
    u16p0_CalPortIf1
      parameter data prototype Val: sw-calibration-access=READ-WRITE, type=u16p0
    u2p14_CalPortIf1
      parameter data prototype Val: sw-calibration-access=READ-WRITE, type=u2p14
    u9p7_CalPortIf1
      parameter data prototype Val: sw-calibration-access=READ-WRITE, type=u9p7
    uint16_CalPortIf1
      parameter data prototype Val: sw-calibration-access=READ-WRITE, type=uint16
    uint32_CalPortIf1
      parameter data prototype Val: sw-calibration-access=READ-WRITE, type=uint32
    uint8_CalPortIf1
      parameter data prototype Val: sw-calibration-access=READ-WRITE, type=uint8
package /MICROSAR/Dem_swc/Interfaces
  30 x client server interface, all with is-service=true, service-kind=DIAGNOSTIC-EVENT-MANAGER:
    CallbackDTCStatusChange
      operation DTCStatusChanged: possible-error=CallbackDTCStatusChange/E_NOT_OK
        arg DTC: type=uint32, direction=IN, server-argument-impl-policy=USE-ARGUMENT-TYPE
        arg DTCStatusOld: type=Dem_DTCStatusMaskType, direction=IN, server-argument-impl-policy=USE-ARGUMENT-TYPE
        arg DTCStatusNew: type=Dem_DTCStatusMaskType, direction=IN, server-argument-impl-policy=USE-ARGUMENT-TYPE
      error E_NOT_OK: error-code=1
    CddIf
      operation ClearDTC: possible-error=[CddIf/DEM_CLEAR_WRONG_DTCORIGIN, CddIf/DEM_CLEAR_WRONG_DTC, CddIf/DEM_CLEAR_BUSY, CddIf/DEM_CLEAR_PENDING, CddIf/DEM_CLEAR_FAILED]
        arg DTC: type=uint32, direction=IN, server-argument-impl-policy=USE-ARGUMENT-TYPE
        arg DTCFormat: type=Dem_DTCFormatType, direction=IN, server-argument-impl-policy=USE-ARGUMENT-TYPE
        arg DTCOrigin: type=Dem_DTCOriginType, direction=IN, server-argument-impl-policy=USE-ARGUMENT-TYPE
      5 x error:
        DEM_CLEAR_BUSY: error-code=5
        DEM_CLEAR_FAILED: error-code=3
        DEM_CLEAR_PENDING: error-code=4
        DEM_CLEAR_WRONG_DTC: error-code=1
        DEM_CLEAR_WRONG_DTCORIGIN: error-code=2
    CSDataServices_BattVltgEcu
      operation ReadData: possible-error=CSDataServices_BattVltgEcu/E_NOT_OK
        arg Data: type=DataArray_Type_1, direction=OUT, server-argument-impl-policy=USE-ARGUMENT-TYPE
      error E_NOT_OK: error-code=1
    CSDataServices_EcuIntT
      operation ReadData: possible-error=CSDataServices_EcuIntT/E_NOT_OK
        arg Data: type=DataArray_Type_1, direction=OUT, server-argument-impl-policy=USE-ARGUMENT-TYPE
      error E_NOT_OK: error-code=1
    CSDataServices_EngSpd
      operation ReadData: possible-error=CSDataServices_EngSpd/E_NOT_OK
        arg Data: type=DataArray_Type_2, direction=OUT, server-argument-impl-policy=USE-ARGUMENT-TYPE
      error E_NOT_OK: error-code=1
    CSDataServices_EpdMotOvldProtnCntr
      operation ReadData: possible-error=CSDataServices_EpdMotOvldProtnCntr/E_NOT_OK
        arg Data: type=DataArray_Type_1, direction=OUT, server-argument-impl-policy=USE-ARGUMENT-TYPE
      error E_NOT_OK: error-code=1
    CSDataServices_EpsAgOvrlSts
      operation ReadData: possible-error=CSDataServices_EpsAgOvrlSts/E_NOT_OK
        arg Data: type=DataArray_Type_1, direction=OUT, server-argument-impl-policy=USE-ARGUMENT-TYPE
      error E_NOT_OK: error-code=1
    CSDataServices_EpsApaAgOvrlReq
      operation ReadData: possible-error=CSDataServices_EpsApaAgOvrlReq/E_NOT_OK
        arg Data: type=DataArray_Type_2, direction=OUT, server-argument-impl-policy=USE-ARGUMENT-TYPE
      error E_NOT_OK: error-code=1
    CSDataServices_EpsMotCurr
      operation ReadData: possible-error=CSDataServices_EpsMotCurr/E_NOT_OK
        arg Data: type=DataArray_Type_2, direction=OUT, server-argument-impl-policy=USE-ARGUMENT-TYPE
      error E_NOT_OK: error-code=1
    CSDataServices_EpsMotCurrFb
      operation ReadData: possible-error=CSDataServices_EpsMotCurrFb/E_NOT_OK
        arg Data: type=DataArray_Type_2, direction=OUT, server-argument-impl-policy=USE-ARGUMENT-TYPE
      error E_NOT_OK: error-code=1
    CSDataServices_EpsStopStrtSts
      operation ReadData: possible-error=CSDataServices_EpsStopStrtSts/E_NOT_OK
        arg Data: type=DataArray_Type_1, direction=OUT, server-argument-impl-policy=USE-ARGUMENT-TYPE
      error E_NOT_OK: error-code=1
    CSDataServices_EpsTqOvrlReq
      operation ReadData: possible-error=CSDataServices_EpsTqOvrlReq/E_NOT_OK
        arg Data: type=DataArray_Type_2, direction=OUT, server-argument-impl-policy=USE-ARGUMENT-TYPE
      error E_NOT_OK: error-code=1
    CSDataServices_EpsTqOvrlSts
      operation ReadData: possible-error=CSDataServices_EpsTqOvrlSts/E_NOT_OK
        arg Data: type=DataArray_Type_1, direction=OUT, server-argument-impl-policy=USE-ARGUMENT-TYPE
      error E_NOT_OK: error-code=1
    CSDataServices_IgnCycCntr
      operation ReadData: possible-error=CSDataServices_IgnCycCntr/E_NOT_OK
        arg Data: type=DataArray_Type_2, direction=OUT, server-argument-impl-policy=USE-ARGUMENT-TYPE
      error E_NOT_OK: error-code=1
    CSDataServices_SplrIntDtcInfo
      operation ReadData: possible-error=CSDataServices_SplrIntDtcInfo/E_NOT_OK
        arg Data: type=DataArray_Type_4, direction=OUT, server-argument-impl-policy=USE-ARGUMENT-TYPE
      error E_NOT_OK: error-code=1
    CSDataServices_SteerInpTq
      operation ReadData: possible-error=CSDataServices_SteerInpTq/E_NOT_OK
        arg Data: type=DataArray_Type_2, direction=OUT, server-argument-impl-policy=USE-ARGUMENT-TYPE
      error E_NOT_OK: error-code=1
    CSDataServices_SteerOutpTq
      operation ReadData: possible-error=CSDataServices_SteerOutpTq/E_NOT_OK
        arg Data: type=DataArray_Type_2, direction=OUT, server-argument-impl-policy=USE-ARGUMENT-TYPE
      error E_NOT_OK: error-code=1
    CSDataServices_SteerWhlAg
      operation ReadData: possible-error=CSDataServices_SteerWhlAg/E_NOT_OK
        arg Data: type=DataArray_Type_2, direction=OUT, server-argument-impl-policy=USE-ARGUMENT-TYPE
      error E_NOT_OK: error-code=1
    CSDataServices_SysPwrMod
      operation ReadData: possible-error=CSDataServices_SysPwrMod/E_NOT_OK
        arg Data: type=DataArray_Type_1, direction=OUT, server-argument-impl-policy=USE-ARGUMENT-TYPE
      error E_NOT_OK: error-code=1
    CSDataServices_TiIgnOn
      operation ReadData: possible-error=CSDataServices_TiIgnOn/E_NOT_OK
        arg Data: type=DataArray_Type_4, direction=OUT, server-argument-impl-policy=USE-ARGUMENT-TYPE
      error E_NOT_OK: error-code=1
    CSDataServices_VehSpd
      operation ReadData: possible-error=CSDataServices_VehSpd/E_NOT_OK
        arg Data: type=DataArray_Type_1, direction=OUT, server-argument-impl-policy=USE-ARGUMENT-TYPE
      error E_NOT_OK: error-code=1
    DcmIf
      5 x operation:
        DcmClearDTC: possible-error=[DcmIf/DEM_CLEAR_FAILED, DcmIf/DEM_CLEAR_BUSY, DcmIf/DEM_CLEAR_PENDING, DcmIf/DEM_CLEAR_WRONG_DTCORIGIN, DcmIf/DEM_CLEAR_WRONG_DTC]
          arg DTC: type=uint32, direction=IN, server-argument-impl-policy=USE-ARGUMENT-TYPE
          arg DTCFormat: type=Dem_DTCFormatType, direction=IN, server-argument-impl-policy=USE-ARGUMENT-TYPE
          arg DTCOrigin: type=Dem_DTCOriginType, direction=IN, server-argument-impl-policy=USE-ARGUMENT-TYPE
        DcmEnableDTCSetting: possible-error=[DcmIf/DEM_CONTROL_DTC_WRONG_DTCGROUP, DcmIf/DEM_CONTROL_DTC_SETTING_N_OK]
          arg DTCGroup: type=Dem_DTCGroupType, direction=IN, server-argument-impl-policy=USE-ARGUMENT-TYPE
          arg DTCKind: type=Dem_DTCKindType, direction=IN, server-argument-impl-policy=USE-ARGUMENT-TYPE
        DcmGetExtendedDataRecordByDTC: possible-error=[DcmIf/DEM_RECORD_WRONG_DTC, DcmIf/DEM_RECORD_PENDING, DcmIf/DEM_RECORD_WRONG_BUFFERSIZE, DcmIf/DEM_RECORD_WRONG_NUMBER, DcmIf/DEM_RECORD_WRONG_DTCORIGIN]
          5 x arg, all with server-argument-impl-policy=USE-ARGUMENT-TYPE:
            DTC: type=uint32, direction=IN
            DTCOrigin: type=Dem_DTCOriginType, direction=IN
            ExtendedDataNumber: type=UInt8, direction=IN
            DestBuffer: type=UInt8, direction=OUT
            BufSize: type=uint16, direction=INOUT
        DcmGetFreezeFrameDataByDTC: possible-error=[DcmIf/DEM_GET_FFDATABYDTC_WRONG_DTC, DcmIf/DEM_GET_FFDATABYDTC_PENDING, DcmIf/DEM_GET_FFDATABYDTC_WRONG_BUFFERSIZE, DcmIf/DEM_GET_FFDATABYDTC_WRONG_RECORDNUMBER, DcmIf/DEM_GET_FFDATABYDTC_WRONG_DTCORIGIN]
          5 x arg, all with server-argument-impl-policy=USE-ARGUMENT-TYPE:
            DTC: type=uint32, direction=IN
            DTCOrigin: type=Dem_DTCOriginType, direction=IN
            RecordNumber: type=UInt8, direction=IN
            DestBuffer: type=UInt8, direction=OUT
            BufSize: type=uint16, direction=INOUT
        DcmGetNextFilteredDTCAndFDC: possible-error=DcmIf/DEM_FILTERED_NO_MATCHING_DTC
          arg DTC: type=uint32, direction=OUT, server-argument-impl-policy=USE-ARGUMENT-TYPE
          arg DTCFaultDetectionCounter: type=sint8, direction=OUT, server-argument-impl-policy=USE-ARGUMENT-TYPE
      18 x error:
        DEM_CLEAR_BUSY: error-code=5
        DEM_CLEAR_FAILED: error-code=3
        DEM_CLEAR_PENDING: error-code=4
        DEM_CLEAR_WRONG_DTC: error-code=1
        DEM_CLEAR_WRONG_DTCORIGIN: error-code=2
        DEM_CONTROL_DTC_SETTING_N_OK: error-code=1
        DEM_CONTROL_DTC_WRONG_DTCGROUP: error-code=2
        DEM_FILTERED_NO_MATCHING_DTC: error-code=1
        DEM_GET_FFDATABYDTC_PENDING: error-code=5
        DEM_GET_FFDATABYDTC_WRONG_BUFFERSIZE: error-code=4
        DEM_GET_FFDATABYDTC_WRONG_DTC: error-code=1
        DEM_GET_FFDATABYDTC_WRONG_DTCORIGIN: error-code=2
        DEM_GET_FFDATABYDTC_WRONG_RECORDNUMBER: error-code=3
        DEM_RECORD_PENDING: error-code=5
        DEM_RECORD_WRONG_BUFFERSIZE: error-code=4
        DEM_RECORD_WRONG_DTC: error-code=1
        DEM_RECORD_WRONG_DTCORIGIN: error-code=2
        DEM_RECORD_WRONG_NUMBER: error-code=3
    DemServices
      operation GetDTCStatusAvailabilityMask: possible-error=DemServices/E_NOT_OK
        arg DTCStatusMask: type=UInt8, direction=OUT, server-argument-impl-policy=USE-ARGUMENT-TYPE
      operation GetPostRunRequested: possible-error=DemServices/E_NOT_OK
        arg IsRequested: type=Boolean, direction=OUT, server-argument-impl-policy=USE-ARGUMENT-TYPE
      error E_NOT_OK: error-code=1
    DiagnosticInfo
      9 x operation:
        GetDebouncingOfEvent: possible-error=DiagnosticInfo/E_NOT_OK
          arg DebouncingState: type=Dem_DebouncingStateType, direction=OUT, server-argument-impl-policy=USE-ARGUMENT-TYPE
        GetDTCOfEvent: possible-error=[DiagnosticInfo/E_NOT_OK, DiagnosticInfo/DEM_E_NO_DTC_AVAILABLE]
          arg DTCFormat: type=Dem_DTCFormatType, direction=IN, server-argument-impl-policy=USE-ARGUMENT-TYPE
          arg DTCOfEvent: type=uint32, direction=OUT, server-argument-impl-policy=USE-ARGUMENT-TYPE
        GetEventEnableCondition: possible-error=DiagnosticInfo/E_NOT_OK
          arg ConditionFullfilled: type=Boolean, direction=OUT, server-argument-impl-policy=USE-ARGUMENT-TYPE
        GetEventExtendedDataRecord: possible-error=[DiagnosticInfo/E_NOT_OK, DiagnosticInfo/DEM_E_NODATAAVAILABLE, DiagnosticInfo/DEM_E_WRONG_RECORDNUMBER]
          arg RecordNumber: type=UInt8, direction=IN, server-argument-impl-policy=USE-ARGUMENT-TYPE
          arg DestBuffer: type=Dem_MaxDataValueType, direction=OUT, server-argument-impl-policy=USE-ARGUMENT-TYPE
        GetEventFailed: possible-error=DiagnosticInfo/E_NOT_OK
          arg EventFailed: type=Boolean, direction=OUT, server-argument-impl-policy=USE-ARGUMENT-TYPE
        GetEventFreezeFrameData: possible-error=[DiagnosticInfo/E_NOT_OK, DiagnosticInfo/DEM_E_NODATAAVAILABLE, DiagnosticInfo/DEM_E_WRONG_RECORDNUMBER, DiagnosticInfo/DEM_E_WRONG_DIDNUMBER]
          4 x arg, all with server-argument-impl-policy=USE-ARGUMENT-TYPE:
            RecordNumber: type=UInt8, direction=IN
            ReportTotalRecord: type=Boolean, direction=IN
            DataId: type=uint16, direction=IN
            DestBuffer: type=Dem_MaxDataValueType, direction=OUT
        GetEventStatus: possible-error=DiagnosticInfo/E_NOT_OK
          arg EventStatusExtended: type=Dem_EventStatusExtendedType, direction=OUT, server-argument-impl-policy=USE-ARGUMENT-TYPE
        GetEventTested: possible-error=DiagnosticInfo/E_NOT_OK
          arg EventTested: type=Boolean, direction=OUT, server-argument-impl-policy=USE-ARGUMENT-TYPE
        GetFaultDetectionCounter: possible-error=[DiagnosticInfo/E_NOT_OK, DiagnosticInfo/DEM_E_NO_FDC_AVAILABLE]
          arg FaultDetectionCounter: type=sint8, direction=OUT, server-argument-impl-policy=USE-ARGUMENT-TYPE
      6 x error:
        DEM_E_NO_DTC_AVAILABLE: error-code=2
        DEM_E_NO_FDC_AVAILABLE: error-code=3
        DEM_E_NODATAAVAILABLE: error-code=48
        DEM_E_WRONG_DIDNUMBER: error-code=50
        DEM_E_WRONG_RECORDNUMBER: error-code=49
        E_NOT_OK: error-code=1
    DiagnosticMonitor
      10 x operation:
        GetDTCOfEvent: possible-error=[DiagnosticMonitor/E_NOT_OK, DiagnosticMonitor/DEM_E_NO_DTC_AVAILABLE]
          arg DTCFormat: type=Dem_DTCFormatType, direction=IN, server-argument-impl-policy=USE-ARGUMENT-TYPE
          arg DTCOfEvent: type=uint32, direction=OUT, server-argument-impl-policy=USE-ARGUMENT-TYPE
        GetEventExtendedDataRecord: possible-error=[DiagnosticMonitor/E_NOT_OK, DiagnosticMonitor/DEM_E_NODATAAVAILABLE, DiagnosticMonitor/DEM_E_WRONG_RECORDNUMBER]
          arg RecordNumber: type=UInt8, direction=IN, server-argument-impl-policy=USE-ARGUMENT-TYPE
          arg DestBuffer: type=Dem_MaxDataValueType, direction=OUT, server-argument-impl-policy=USE-ARGUMENT-TYPE
        GetEventFailed: possible-error=DiagnosticMonitor/E_NOT_OK
          arg EventFailed: type=Boolean, direction=OUT, server-argument-impl-policy=USE-ARGUMENT-TYPE
        GetEventFreezeFrameData: possible-error=[DiagnosticMonitor/E_NOT_OK, DiagnosticMonitor/DEM_E_NODATAAVAILABLE, DiagnosticMonitor/DEM_E_WRONG_RECORDNUMBER, DiagnosticMonitor/DEM_E_WRONG_DIDNUMBER]
          4 x arg, all with server-argument-impl-policy=USE-ARGUMENT-TYPE:
            RecordNumber: type=UInt8, direction=IN
            ReportTotalRecord: type=Boolean, direction=IN
            DataId: type=uint16, direction=IN
            DestBuffer: type=Dem_MaxDataValueType, direction=OUT
        GetEventStatus: possible-error=DiagnosticMonitor/E_NOT_OK
          arg EventStatusExtended: type=Dem_EventStatusExtendedType, direction=OUT, server-argument-impl-policy=USE-ARGUMENT-TYPE
        GetEventTested: possible-error=DiagnosticMonitor/E_NOT_OK
          arg EventTested: type=Boolean, direction=OUT, server-argument-impl-policy=USE-ARGUMENT-TYPE
        GetFaultDetectionCounter: possible-error=[DiagnosticMonitor/E_NOT_OK, DiagnosticMonitor/DEM_E_NO_FDC_AVAILABLE]
          arg FaultDetectionCounter: type=sint8, direction=OUT, server-argument-impl-policy=USE-ARGUMENT-TYPE
        ResetEventDebounceStatus: possible-error=DiagnosticMonitor/E_NOT_OK
          arg DebounceResetStatus: type=Dem_DebounceResetStatusType, direction=IN, server-argument-impl-policy=USE-ARGUMENT-TYPE
        ResetEventStatus: possible-error=DiagnosticMonitor/E_NOT_OK
        SetEventStatus: possible-error=DiagnosticMonitor/E_NOT_OK
          arg EventStatus: type=Dem_EventStatusType, direction=IN, server-argument-impl-policy=USE-ARGUMENT-TYPE
      6 x error:
        DEM_E_NO_DTC_AVAILABLE: error-code=2
        DEM_E_NO_FDC_AVAILABLE: error-code=3
        DEM_E_NODATAAVAILABLE: error-code=48
        DEM_E_WRONG_DIDNUMBER: error-code=50
        DEM_E_WRONG_RECORDNUMBER: error-code=49
        E_NOT_OK: error-code=1
    EnableCondition
      operation SetEnableCondition: possible-error=EnableCondition/E_NOT_OK
        arg ConditionFulfilled: type=Boolean, direction=IN, server-argument-impl-policy=USE-ARGUMENT-TYPE
      error E_NOT_OK: error-code=1
    EvMemOverflowIndication
      operation GetEventMemoryOverflow: possible-error=EvMemOverflowIndication/E_NOT_OK
        arg OverflowIndication: type=Boolean, direction=OUT, server-argument-impl-policy=USE-ARGUMENT-TYPE
      operation GetNumberOfEventMemoryEntries: possible-error=EvMemOverflowIndication/E_NOT_OK
        arg NumberOfEventMemoryEntries: type=UInt8, direction=OUT, server-argument-impl-policy=USE-ARGUMENT-TYPE
      error E_NOT_OK: error-code=1
    GeneralDiagnosticInfo
      9 x operation:
        GetDebouncingOfEvent: possible-error=GeneralDiagnosticInfo/E_NOT_OK
          arg EventId: type=Dem_EventIdType, direction=IN, server-argument-impl-policy=USE-ARGUMENT-TYPE
          arg DebouncingState: type=Dem_DebouncingStateType, direction=OUT, server-argument-impl-policy=USE-ARGUMENT-TYPE
        GetDTCOfEvent: possible-error=[GeneralDiagnosticInfo/E_NOT_OK, GeneralDiagnosticInfo/DEM_E_NO_DTC_AVAILABLE]
          arg EventId: type=Dem_EventIdType, direction=IN, server-argument-impl-policy=USE-ARGUMENT-TYPE
          arg DTCFormat: type=Dem_DTCFormatType, direction=IN, server-argument-impl-policy=USE-ARGUMENT-TYPE
          arg DTCOfEvent: type=uint32, direction=OUT, server-argument-impl-policy=USE-ARGUMENT-TYPE
        GetEventEnableCondition: possible-error=GeneralDiagnosticInfo/E_NOT_OK
          arg EventId: type=Dem_EventIdType, direction=IN, server-argument-impl-policy=USE-ARGUMENT-TYPE
          arg ConditionFullfilled: type=Boolean, direction=OUT, server-argument-impl-policy=USE-ARGUMENT-TYPE
        GetEventExtendedDataRecord: possible-error=[GeneralDiagnosticInfo/E_NOT_OK, GeneralDiagnosticInfo/DEM_E_NODATAAVAILABLE, GeneralDiagnosticInfo/DEM_E_WRONG_RECORDNUMBER]
          arg EventId: type=Dem_EventIdType, direction=IN, server-argument-impl-policy=USE-ARGUMENT-TYPE
          arg RecordNumber: type=UInt8, direction=IN, server-argument-impl-policy=USE-ARGUMENT-TYPE
          arg DestBuffer: type=Dem_MaxDataValueType, direction=OUT, server-argument-impl-policy=USE-ARGUMENT-TYPE
        GetEventFailed: possible-error=GeneralDiagnosticInfo/E_NOT_OK
          arg EventId: type=Dem_EventIdType, direction=IN, server-argument-impl-policy=USE-ARGUMENT-TYPE
          arg EventFailed: type=Boolean, direction=OUT, server-argument-impl-policy=USE-ARGUMENT-TYPE
        GetEventFreezeFrameData: possible-error=[GeneralDiagnosticInfo/E_NOT_OK, GeneralDiagnosticInfo/DEM_E_NODATAAVAILABLE, GeneralDiagnosticInfo/DEM_E_WRONG_RECORDNUMBER, GeneralDiagnosticInfo/DEM_E_WRONG_DIDNUMBER]
          5 x arg, all with server-argument-impl-policy=USE-ARGUMENT-TYPE:
            EventId: type=Dem_EventIdType, direction=IN
            RecordNumber: type=UInt8, direction=IN
            ReportTotalRecord: type=Boolean, direction=IN
            DataId: type=uint16, direction=IN
            DestBuffer: type=Dem_MaxDataValueType, direction=OUT
        GetEventStatus: possible-error=GeneralDiagnosticInfo/E_NOT_OK
          arg EventId: type=Dem_EventIdType, direction=IN, server-argument-impl-policy=USE-ARGUMENT-TYPE
          arg EventStatusExtended: type=Dem_EventStatusExtendedType, direction=OUT, server-argument-impl-policy=USE-ARGUMENT-TYPE
        GetEventTested: possible-error=GeneralDiagnosticInfo/E_NOT_OK
          arg EventId: type=Dem_EventIdType, direction=IN, server-argument-impl-policy=USE-ARGUMENT-TYPE
          arg EventTested: type=Boolean, direction=OUT, server-argument-impl-policy=USE-ARGUMENT-TYPE
        GetFaultDetectionCounter: possible-error=[GeneralDiagnosticInfo/E_NOT_OK, GeneralDiagnosticInfo/DEM_E_NO_FDC_AVAILABLE]
          arg EventId: type=Dem_EventIdType, direction=IN, server-argument-impl-policy=USE-ARGUMENT-TYPE
          arg FaultDetectionCounter: type=sint8, direction=OUT, server-argument-impl-policy=USE-ARGUMENT-TYPE
      6 x error:
        DEM_E_NO_DTC_AVAILABLE: error-code=2
        DEM_E_NO_FDC_AVAILABLE: error-code=3
        DEM_E_NODATAAVAILABLE: error-code=48
        DEM_E_WRONG_DIDNUMBER: error-code=50
        DEM_E_WRONG_RECORDNUMBER: error-code=49
        E_NOT_OK: error-code=1
    IndicatorStatus
      operation GetIndicatorStatus: possible-error=IndicatorStatus/E_NOT_OK
        arg IndicatorStatus: type=Dem_IndicatorStatusType, direction=OUT, server-argument-impl-policy=USE-ARGUMENT-TYPE
      error E_NOT_OK: error-code=1
    OperationCycle
      operation SetOperationCycleState: possible-error=OperationCycle/E_NOT_OK
        arg CycleState: type=Dem_OperationCycleStateType, direction=IN, server-argument-impl-policy=USE-ARGUMENT-TYPE
      error E_NOT_OK: error-code=1
package /MICROSAR/NvM_swc/Interfaces
  client server interface NvMAdministration: is-service=true, service-kind=NON-VOLATILE-RAM-MANAGER
    operation SetBlockProtection: possible-error=NvMAdministration/E_NOT_OK
      arg ProtectionEnabled: type=boolean, direction=IN, server-argument-impl-policy=USE-ARGUMENT-TYPE
    error E_NOT_OK: error-code=1
  client server interface NvMService_AC3_SRBS: is-service=true, service-kind=NON-VOLATILE-RAM-MANAGER
    6 x operation, all with possible-error=NvMService_AC3_SRBS/E_NOT_OK:
      EraseBlock
      GetErrorStatus
        arg ErrorStatus: type=NvM_RequestResultType, direction=OUT, server-argument-impl-policy=USE-ARGUMENT-TYPE
      InvalidateNvBlock
      ReadBlock
        arg DstPtr: type=dtRef_VOID, direction=IN, server-argument-impl-policy=USE-ARGUMENT-TYPE
      SetRamBlockStatus
        arg RamBlockStatus: type=boolean, direction=IN, server-argument-impl-policy=USE-ARGUMENT-TYPE
      WriteBlock
        arg SrcPtr: type=dtRef_const_VOID, direction=IN, server-argument-impl-policy=USE-ARGUMENT-TYPE
    error E_NOT_OK: error-code=1
  client server interface NvMService_AC3_SRBS_Defs: is-service=true, service-kind=NON-VOLATILE-RAM-MANAGER
    7 x operation, all with possible-error=NvMService_AC3_SRBS_Defs/E_NOT_OK:
      EraseBlock
      GetErrorStatus
        arg ErrorStatus: type=NvM_RequestResultType, direction=OUT, server-argument-impl-policy=USE-ARGUMENT-TYPE
      InvalidateNvBlock
      ReadBlock
        arg DstPtr: type=dtRef_VOID, direction=IN, server-argument-impl-policy=USE-ARGUMENT-TYPE
      RestoreBlockDefaults
        arg DstPtr: type=dtRef_VOID, direction=IN, server-argument-impl-policy=USE-ARGUMENT-TYPE
      SetRamBlockStatus
        arg RamBlockStatus: type=boolean, direction=IN, server-argument-impl-policy=USE-ARGUMENT-TYPE
      WriteBlock
        arg SrcPtr: type=dtRef_const_VOID, direction=IN, server-argument-impl-policy=USE-ARGUMENT-TYPE
    error E_NOT_OK: error-code=1
package /MICROSAR_SWCS_DEV/BswM_swc
  mode declaration group ModeGroup_Logl: category=ALPHABETIC_ORDER, initial-mode=FALSE
    mode FALSE
    mode TRUE
  mode declaration group ModeGroup_SysSt: category=ALPHABETIC_ORDER, initial-mode=DISABLE
    5 x mode:
      DISABLE
      ENABLE
      OFF
      TRANSITION
      WARMININ
package /MICROSAR_SWCS_DEV/BswM_swc/Interfaces
  mode switch interface BswM_MSI_ModeGroup_Logl: is-service=true, service-kind=BASIC-SOFTWARE-MODE-MANAGER
    mode group BswM_MDGP_ModeGroup_Logl: type=ModeGroup_Logl
  mode switch interface BswM_MSI_ModeGroup_SysSt: is-service=true, service-kind=BASIC-SOFTWARE-MODE-MANAGER
    mode group BswM_MDGP_ModeGroup_SysSt: type=ModeGroup_SysSt
  sender receiver interface BswM_SRI_BswM_MSI_ModeGroup_Logl_BswM_MDGP_ModeGroup_Logl: is-service=true, service-kind=BASIC-SOFTWARE-MODE-MANAGER, invalidation-policy{data-element=BswM_SRI_BswM_MSI_ModeGroup_Logl_BswM_MDGP_ModeGroup_Logl/requestedMode, handle-invalid=DONT-INVALIDATE}
    data requestedMode: type=BswM_ModeGroup_Logl
  sender receiver interface BswM_SRI_BswM_MSI_ModeGroup_SysSt_BswM_MDGP_ModeGroup_SysSt: is-service=true, service-kind=BASIC-SOFTWARE-MODE-MANAGER, invalidation-policy{data-element=BswM_SRI_BswM_MSI_ModeGroup_SysSt_BswM_MDGP_ModeGroup_SysSt/requestedMode, handle-invalid=DONT-INVALIDATE}
    data requestedMode: type=BswM_ModeGroup_SysSt
package /MICROSAR_SWCS_DEV/Dem_swc/Interfaces
  33 x client server interface, all with is-service=true, service-kind=DIAGNOSTIC-EVENT-MANAGER:
    CallbackDTCStatusChange
      operation DTCStatusChanged: possible-error=CallbackDTCStatusChange/E_NOT_OK
        arg DTC: type=uint32, direction=IN, server-argument-impl-policy=USE-ARGUMENT-TYPE
        arg DTCStatusOld: type=Dem_DTCStatusMaskType, direction=IN, server-argument-impl-policy=USE-ARGUMENT-TYPE
        arg DTCStatusNew: type=Dem_DTCStatusMaskType, direction=IN, server-argument-impl-policy=USE-ARGUMENT-TYPE
      error E_NOT_OK: error-code=1
    CallbackEventStatusChange
      operation EventStatusChanged: possible-error=CallbackEventStatusChange/E_NOT_OK
        arg EventStatusOld: type=Dem_EventStatusExtendedType, direction=IN, server-argument-impl-policy=USE-ARGUMENT-TYPE
        arg EventStatusNew: type=Dem_EventStatusExtendedType, direction=IN, server-argument-impl-policy=USE-ARGUMENT-TYPE
      error E_NOT_OK: error-code=1
    CddIf
      operation ClearDTC: possible-error=[CddIf/DEM_CLEAR_WRONG_DTC, CddIf/DEM_CLEAR_WRONG_DTCORIGIN, CddIf/DEM_CLEAR_FAILED, CddIf/DEM_CLEAR_PENDING, CddIf/DEM_CLEAR_BUSY]
        arg DTC: type=uint32, direction=IN, server-argument-impl-policy=USE-ARGUMENT-TYPE
        arg DTCFormat: type=Dem_DTCFormatType, direction=IN, server-argument-impl-policy=USE-ARGUMENT-TYPE
        arg DTCOrigin: type=Dem_DTCOriginType, direction=IN, server-argument-impl-policy=USE-ARGUMENT-TYPE
      5 x error:
        DEM_CLEAR_BUSY: error-code=5
        DEM_CLEAR_FAILED: error-code=3
        DEM_CLEAR_PENDING: error-code=4
        DEM_CLEAR_WRONG_DTC: error-code=1
        DEM_CLEAR_WRONG_DTCORIGIN: error-code=2
    CSDataServices_BattVltgEcu
      operation ReadData: possible-error=CSDataServices_BattVltgEcu/E_NOT_OK
        arg Data: type=DataArray_Type_1, direction=OUT, server-argument-impl-policy=USE-ARGUMENT-TYPE
      error E_NOT_OK: error-code=1
    CSDataServices_DemDataElementClass
      operation ReadData: possible-error=CSDataServices_DemDataElementClass/E_NOT_OK
        arg Data: type=DataArray_Type_2, direction=OUT, server-argument-impl-policy=USE-ARGUMENT-TYPE
      error E_NOT_OK: error-code=1
    CSDataServices_EcuIntT
      operation ReadData: possible-error=CSDataServices_EcuIntT/E_NOT_OK
        arg Data: type=DataArray_Type_1, direction=OUT, server-argument-impl-policy=USE-ARGUMENT-TYPE
      error E_NOT_OK: error-code=1
    CSDataServices_EngSpd
      operation ReadData: possible-error=CSDataServices_EngSpd/E_NOT_OK
        arg Data: type=DataArray_Type_2, direction=OUT, server-argument-impl-policy=USE-ARGUMENT-TYPE
      error E_NOT_OK: error-code=1
    CSDataServices_EpdMotOvldProtnCntr
      operation ReadData: possible-error=CSDataServices_EpdMotOvldProtnCntr/E_NOT_OK
        arg Data: type=DataArray_Type_1, direction=OUT, server-argument-impl-policy=USE-ARGUMENT-TYPE
      error E_NOT_OK: error-code=1
    CSDataServices_EpsAgOvrlSts
      operation ReadData: possible-error=CSDataServices_EpsAgOvrlSts/E_NOT_OK
        arg Data: type=DataArray_Type_1, direction=OUT, server-argument-impl-policy=USE-ARGUMENT-TYPE
      error E_NOT_OK: error-code=1
    CSDataServices_EpsApaAgOvrlReq
      operation ReadData: possible-error=CSDataServices_EpsApaAgOvrlReq/E_NOT_OK
        arg Data: type=DataArray_Type_2, direction=OUT, server-argument-impl-policy=USE-ARGUMENT-TYPE
      error E_NOT_OK: error-code=1
    CSDataServices_EpsMotCurr
      operation ReadData: possible-error=CSDataServices_EpsMotCurr/E_NOT_OK
        arg Data: type=DataArray_Type_2, direction=OUT, server-argument-impl-policy=USE-ARGUMENT-TYPE
      error E_NOT_OK: error-code=1
    CSDataServices_EpsMotCurrFb
      operation ReadData: possible-error=CSDataServices_EpsMotCurrFb/E_NOT_OK
        arg Data: type=DataArray_Type_2, direction=OUT, server-argument-impl-policy=USE-ARGUMENT-TYPE
      error E_NOT_OK: error-code=1
    CSDataServices_EpsStopStrtSts
      operation ReadData: possible-error=CSDataServices_EpsStopStrtSts/E_NOT_OK
        arg Data: type=DataArray_Type_1, direction=OUT, server-argument-impl-policy=USE-ARGUMENT-TYPE
      error E_NOT_OK: error-code=1
    CSDataServices_EpsTqOvrlReq
      operation ReadData: possible-error=CSDataServices_EpsTqOvrlReq/E_NOT_OK
        arg Data: type=DataArray_Type_2, direction=OUT, server-argument-impl-policy=USE-ARGUMENT-TYPE
      error E_NOT_OK: error-code=1
    CSDataServices_EpsTqOvrlSts
      operation ReadData: possible-error=CSDataServices_EpsTqOvrlSts/E_NOT_OK
        arg Data: type=DataArray_Type_1, direction=OUT, server-argument-impl-policy=USE-ARGUMENT-TYPE
      error E_NOT_OK: error-code=1
    CSDataServices_IgnCycCntr
      operation ReadData: possible-error=CSDataServices_IgnCycCntr/E_NOT_OK
        arg Data: type=DataArray_Type_2, direction=OUT, server-argument-impl-policy=USE-ARGUMENT-TYPE
      error E_NOT_OK: error-code=1
    CSDataServices_SplrIntDtcInfo
      operation ReadData: possible-error=CSDataServices_SplrIntDtcInfo/E_NOT_OK
        arg Data: type=DataArray_Type_4, direction=OUT, server-argument-impl-policy=USE-ARGUMENT-TYPE
      error E_NOT_OK: error-code=1
    CSDataServices_SteerInpTq
      operation ReadData: possible-error=CSDataServices_SteerInpTq/E_NOT_OK
        arg Data: type=DataArray_Type_2, direction=OUT, server-argument-impl-policy=USE-ARGUMENT-TYPE
      error E_NOT_OK: error-code=1
    CSDataServices_SteerOutpTq
      operation ReadData: possible-error=CSDataServices_SteerOutpTq/E_NOT_OK
        arg Data: type=DataArray_Type_2, direction=OUT, server-argument-impl-policy=USE-ARGUMENT-TYPE
      error E_NOT_OK: error-code=1
    CSDataServices_SteerWhlAg
      operation ReadData: possible-error=CSDataServices_SteerWhlAg/E_NOT_OK
        arg Data: type=DataArray_Type_2, direction=OUT, server-argument-impl-policy=USE-ARGUMENT-TYPE
      error E_NOT_OK: error-code=1
    CSDataServices_SysPwrMod
      operation ReadData: possible-error=CSDataServices_SysPwrMod/E_NOT_OK
        arg Data: type=DataArray_Type_1, direction=OUT, server-argument-impl-policy=USE-ARGUMENT-TYPE
      error E_NOT_OK: error-code=1
    CSDataServices_TiIgnOn
      operation ReadData: possible-error=CSDataServices_TiIgnOn/E_NOT_OK
        arg Data: type=DataArray_Type_4, direction=OUT, server-argument-impl-policy=USE-ARGUMENT-TYPE
      error E_NOT_OK: error-code=1
    CSDataServices_VehSpd
      operation ReadData: possible-error=CSDataServices_VehSpd/E_NOT_OK
        arg Data: type=DataArray_Type_1, direction=OUT, server-argument-impl-policy=USE-ARGUMENT-TYPE
      error E_NOT_OK: error-code=1
    DcmIf
      5 x operation:
        DcmClearDTC: possible-error=[DcmIf/DEM_CLEAR_WRONG_DTC, DcmIf/DEM_CLEAR_WRONG_DTCORIGIN, DcmIf/DEM_CLEAR_FAILED, DcmIf/DEM_CLEAR_PENDING, DcmIf/DEM_CLEAR_BUSY]
          arg DTC: type=uint32, direction=IN, server-argument-impl-policy=USE-ARGUMENT-TYPE
          arg DTCFormat: type=Dem_DTCFormatType, direction=IN, server-argument-impl-policy=USE-ARGUMENT-TYPE
          arg DTCOrigin: type=Dem_DTCOriginType, direction=IN, server-argument-impl-policy=USE-ARGUMENT-TYPE
        DcmEnableDTCSetting: possible-error=[DcmIf/DEM_CONTROL_DTC_SETTING_N_OK, DcmIf/DEM_CONTROL_DTC_WRONG_DTCGROUP]
          arg DTCGroup: type=Dem_DTCGroupType, direction=IN, server-argument-impl-policy=USE-ARGUMENT-TYPE
          arg DTCKind: type=Dem_DTCKindType, direction=IN, server-argument-impl-policy=USE-ARGUMENT-TYPE
        DcmGetExtendedDataRecordByDTC: possible-error=[DcmIf/DEM_RECORD_WRONG_DTC, DcmIf/DEM_RECORD_WRONG_DTCORIGIN, DcmIf/DEM_RECORD_WRONG_NUMBER, DcmIf/DEM_RECORD_WRONG_BUFFERSIZE, DcmIf/DEM_RECORD_PENDING]
          5 x arg, all with server-argument-impl-policy=USE-ARGUMENT-TYPE:
            DTC: type=uint32, direction=IN
            DTCOrigin: type=Dem_DTCOriginType, direction=IN
            ExtendedDataNumber: type=uint8, direction=IN
            DestBuffer: type=uint8, direction=OUT
            BufSize: type=uint16, direction=INOUT
        DcmGetFreezeFrameDataByDTC: possible-error=[DcmIf/DEM_GET_FFDATABYDTC_WRONG_DTC, DcmIf/DEM_GET_FFDATABYDTC_WRONG_DTCORIGIN, DcmIf/DEM_GET_FFDATABYDTC_WRONG_RECORDNUMBER, DcmIf/DEM_GET_FFDATABYDTC_WRONG_BUFFERSIZE, DcmIf/DEM_GET_FFDATABYDTC_PENDING]
          5 x arg, all with server-argument-impl-policy=USE-ARGUMENT-TYPE:
            DTC: type=uint32, direction=IN
            DTCOrigin: type=Dem_DTCOriginType, direction=IN
            RecordNumber: type=uint8, direction=IN
            DestBuffer: type=uint8, direction=OUT
            BufSize: type=uint16, direction=INOUT
        DcmGetNextFilteredDTCAndFDC: possible-error=DcmIf/DEM_FILTERED_NO_MATCHING_DTC
          arg DTC: type=uint32, direction=OUT, server-argument-impl-policy=USE-ARGUMENT-TYPE
          arg DTCFaultDetectionCounter: type=sint8, direction=OUT, server-argument-impl-policy=USE-ARGUMENT-TYPE
      18 x error:
        DEM_CLEAR_BUSY: error-code=5
        DEM_CLEAR_FAILED: error-code=3
        DEM_CLEAR_PENDING: error-code=4
        DEM_CLEAR_WRONG_DTC: error-code=1
        DEM_CLEAR_WRONG_DTCORIGIN: error-code=2
        DEM_CONTROL_DTC_SETTING_N_OK: error-code=1
        DEM_CONTROL_DTC_WRONG_DTCGROUP: error-code=2
        DEM_FILTERED_NO_MATCHING_DTC: error-code=1
        DEM_GET_FFDATABYDTC_PENDING: error-code=5
        DEM_GET_FFDATABYDTC_WRONG_BUFFERSIZE: error-code=4
        DEM_GET_FFDATABYDTC_WRONG_DTC: error-code=1
        DEM_GET_FFDATABYDTC_WRONG_DTCORIGIN: error-code=2
        DEM_GET_FFDATABYDTC_WRONG_RECORDNUMBER: error-code=3
        DEM_RECORD_PENDING: error-code=5
        DEM_RECORD_WRONG_BUFFERSIZE: error-code=4
        DEM_RECORD_WRONG_DTC: error-code=1
        DEM_RECORD_WRONG_DTCORIGIN: error-code=2
        DEM_RECORD_WRONG_NUMBER: error-code=3
    DemServices
      operation GetDTCStatusAvailabilityMask: possible-error=DemServices/E_NOT_OK
        arg DTCStatusMask: type=uint8, direction=OUT, server-argument-impl-policy=USE-ARGUMENT-TYPE
      operation GetPostRunRequested: possible-error=DemServices/E_NOT_OK
        arg IsRequested: type=boolean, direction=OUT, server-argument-impl-policy=USE-ARGUMENT-TYPE
      error E_NOT_OK: error-code=1
    DiagnosticInfo
      9 x operation:
        GetDebouncingOfEvent: possible-error=DiagnosticInfo/E_NOT_OK
          arg DebouncingState: type=Dem_DebouncingStateType, direction=OUT, server-argument-impl-policy=USE-ARGUMENT-TYPE
        GetDTCOfEvent: possible-error=[DiagnosticInfo/E_NOT_OK, DiagnosticInfo/DEM_E_NO_DTC_AVAILABLE]
          arg DTCFormat: type=Dem_DTCFormatType, direction=IN, server-argument-impl-policy=USE-ARGUMENT-TYPE
          arg DTCOfEvent: type=uint32, direction=OUT, server-argument-impl-policy=USE-ARGUMENT-TYPE
        GetEventEnableCondition: possible-error=DiagnosticInfo/E_NOT_OK
          arg ConditionFullfilled: type=boolean, direction=OUT, server-argument-impl-policy=USE-ARGUMENT-TYPE
        GetEventExtendedDataRecord: possible-error=[DiagnosticInfo/E_NOT_OK, DiagnosticInfo/DEM_E_NODATAAVAILABLE, DiagnosticInfo/DEM_E_WRONG_RECORDNUMBER]
          arg RecordNumber: type=uint8, direction=IN, server-argument-impl-policy=USE-ARGUMENT-TYPE
          arg DestBuffer: type=Dem_MaxDataValueType, direction=OUT, server-argument-impl-policy=USE-ARGUMENT-TYPE
        GetEventFailed: possible-error=DiagnosticInfo/E_NOT_OK
          arg EventFailed: type=boolean, direction=OUT, server-argument-impl-policy=USE-ARGUMENT-TYPE
        GetEventFreezeFrameData: possible-error=[DiagnosticInfo/E_NOT_OK, DiagnosticInfo/DEM_E_NODATAAVAILABLE, DiagnosticInfo/DEM_E_WRONG_RECORDNUMBER, DiagnosticInfo/DEM_E_WRONG_DIDNUMBER]
          4 x arg, all with server-argument-impl-policy=USE-ARGUMENT-TYPE:
            RecordNumber: type=uint8, direction=IN
            ReportTotalRecord: type=boolean, direction=IN
            DataId: type=uint16, direction=IN
            DestBuffer: type=Dem_MaxDataValueType, direction=OUT
        GetEventStatus: possible-error=DiagnosticInfo/E_NOT_OK
          arg EventStatusExtended: type=Dem_EventStatusExtendedType, direction=OUT, server-argument-impl-policy=USE-ARGUMENT-TYPE
        GetEventTested: possible-error=DiagnosticInfo/E_NOT_OK
          arg EventTested: type=boolean, direction=OUT, server-argument-impl-policy=USE-ARGUMENT-TYPE
        GetFaultDetectionCounter: possible-error=[DiagnosticInfo/E_NOT_OK, DiagnosticInfo/DEM_E_NO_FDC_AVAILABLE]
          arg FaultDetectionCounter: type=sint8, direction=OUT, server-argument-impl-policy=USE-ARGUMENT-TYPE
      6 x error:
        DEM_E_NO_DTC_AVAILABLE: error-code=2
        DEM_E_NO_FDC_AVAILABLE: error-code=3
        DEM_E_NODATAAVAILABLE: error-code=48
        DEM_E_WRONG_DIDNUMBER: error-code=50
        DEM_E_WRONG_RECORDNUMBER: error-code=49
        E_NOT_OK: error-code=1
    DiagnosticMonitor
      10 x operation:
        GetDTCOfEvent: possible-error=[DiagnosticMonitor/E_NOT_OK, DiagnosticMonitor/DEM_E_NO_DTC_AVAILABLE]
          arg DTCFormat: type=Dem_DTCFormatType, direction=IN, server-argument-impl-policy=USE-ARGUMENT-TYPE
          arg DTCOfEvent: type=uint32, direction=OUT, server-argument-impl-policy=USE-ARGUMENT-TYPE
        GetEventExtendedDataRecord: possible-error=[DiagnosticMonitor/E_NOT_OK, DiagnosticMonitor/DEM_E_NODATAAVAILABLE, DiagnosticMonitor/DEM_E_WRONG_RECORDNUMBER]
          arg RecordNumber: type=uint8, direction=IN, server-argument-impl-policy=USE-ARGUMENT-TYPE
          arg DestBuffer: type=Dem_MaxDataValueType, direction=OUT, server-argument-impl-policy=USE-ARGUMENT-TYPE
        GetEventFailed: possible-error=DiagnosticMonitor/E_NOT_OK
          arg EventFailed: type=boolean, direction=OUT, server-argument-impl-policy=USE-ARGUMENT-TYPE
        GetEventFreezeFrameData: possible-error=[DiagnosticMonitor/E_NOT_OK, DiagnosticMonitor/DEM_E_NODATAAVAILABLE, DiagnosticMonitor/DEM_E_WRONG_RECORDNUMBER, DiagnosticMonitor/DEM_E_WRONG_DIDNUMBER]
          4 x arg, all with server-argument-impl-policy=USE-ARGUMENT-TYPE:
            RecordNumber: type=uint8, direction=IN
            ReportTotalRecord: type=boolean, direction=IN
            DataId: type=uint16, direction=IN
            DestBuffer: type=Dem_MaxDataValueType, direction=OUT
        GetEventStatus: possible-error=DiagnosticMonitor/E_NOT_OK
          arg EventStatusExtended: type=Dem_EventStatusExtendedType, direction=OUT, server-argument-impl-policy=USE-ARGUMENT-TYPE
        GetEventTested: possible-error=DiagnosticMonitor/E_NOT_OK
          arg EventTested: type=boolean, direction=OUT, server-argument-impl-policy=USE-ARGUMENT-TYPE
        GetFaultDetectionCounter: possible-error=[DiagnosticMonitor/E_NOT_OK, DiagnosticMonitor/DEM_E_NO_FDC_AVAILABLE]
          arg FaultDetectionCounter: type=sint8, direction=OUT, server-argument-impl-policy=USE-ARGUMENT-TYPE
        ResetEventDebounceStatus: possible-error=DiagnosticMonitor/E_NOT_OK
          arg DebounceResetStatus: type=Dem_DebounceResetStatusType, direction=IN, server-argument-impl-policy=USE-ARGUMENT-TYPE
        ResetEventStatus: possible-error=DiagnosticMonitor/E_NOT_OK
        SetEventStatus: possible-error=DiagnosticMonitor/E_NOT_OK
          arg EventStatus: type=Dem_EventStatusType, direction=IN, server-argument-impl-policy=USE-ARGUMENT-TYPE
      6 x error:
        DEM_E_NO_DTC_AVAILABLE: error-code=2
        DEM_E_NO_FDC_AVAILABLE: error-code=3
        DEM_E_NODATAAVAILABLE: error-code=48
        DEM_E_WRONG_DIDNUMBER: error-code=50
        DEM_E_WRONG_RECORDNUMBER: error-code=49
        E_NOT_OK: error-code=1
    EnableCondition
      operation SetEnableCondition: possible-error=EnableCondition/E_NOT_OK
        arg ConditionFulfilled: type=boolean, direction=IN, server-argument-impl-policy=USE-ARGUMENT-TYPE
      error E_NOT_OK: error-code=1
    EvMemOverflowIndication
      operation GetEventMemoryOverflow: possible-error=EvMemOverflowIndication/E_NOT_OK
        arg OverflowIndication: type=boolean, direction=OUT, server-argument-impl-policy=USE-ARGUMENT-TYPE
      operation GetNumberOfEventMemoryEntries: possible-error=EvMemOverflowIndication/E_NOT_OK
        arg NumberOfEventMemoryEntries: type=uint8, direction=OUT, server-argument-impl-policy=USE-ARGUMENT-TYPE
      error E_NOT_OK: error-code=1
    GeneralCallbackEventStatusChange
      operation EventStatusChanged: possible-error=GeneralCallbackEventStatusChange/E_NOT_OK
        arg EventId: type=Dem_EventIdType, direction=IN, server-argument-impl-policy=USE-ARGUMENT-TYPE
        arg EventStatusOld: type=Dem_EventStatusExtendedType, direction=IN, server-argument-impl-policy=USE-ARGUMENT-TYPE
        arg EventStatusNew: type=Dem_EventStatusExtendedType, direction=IN, server-argument-impl-policy=USE-ARGUMENT-TYPE
      error E_NOT_OK: error-code=1
    GeneralDiagnosticInfo
      9 x operation:
        GetDebouncingOfEvent: possible-error=GeneralDiagnosticInfo/E_NOT_OK
          arg EventId: type=Dem_EventIdType, direction=IN, server-argument-impl-policy=USE-ARGUMENT-TYPE
          arg DebouncingState: type=Dem_DebouncingStateType, direction=OUT, server-argument-impl-policy=USE-ARGUMENT-TYPE
        GetDTCOfEvent: possible-error=[GeneralDiagnosticInfo/E_NOT_OK, GeneralDiagnosticInfo/DEM_E_NO_DTC_AVAILABLE]
          arg EventId: type=Dem_EventIdType, direction=IN, server-argument-impl-policy=USE-ARGUMENT-TYPE
          arg DTCFormat: type=Dem_DTCFormatType, direction=IN, server-argument-impl-policy=USE-ARGUMENT-TYPE
          arg DTCOfEvent: type=uint32, direction=OUT, server-argument-impl-policy=USE-ARGUMENT-TYPE
        GetEventEnableCondition: possible-error=GeneralDiagnosticInfo/E_NOT_OK
          arg EventId: type=Dem_EventIdType, direction=IN, server-argument-impl-policy=USE-ARGUMENT-TYPE
          arg ConditionFullfilled: type=boolean, direction=OUT, server-argument-impl-policy=USE-ARGUMENT-TYPE
        GetEventExtendedDataRecord: possible-error=[GeneralDiagnosticInfo/E_NOT_OK, GeneralDiagnosticInfo/DEM_E_NODATAAVAILABLE, GeneralDiagnosticInfo/DEM_E_WRONG_RECORDNUMBER]
          arg EventId: type=Dem_EventIdType, direction=IN, server-argument-impl-policy=USE-ARGUMENT-TYPE
          arg RecordNumber: type=uint8, direction=IN, server-argument-impl-policy=USE-ARGUMENT-TYPE
          arg DestBuffer: type=Dem_MaxDataValueType, direction=OUT, server-argument-impl-policy=USE-ARGUMENT-TYPE
        GetEventFailed: possible-error=GeneralDiagnosticInfo/E_NOT_OK
          arg EventId: type=Dem_EventIdType, direction=IN, server-argument-impl-policy=USE-ARGUMENT-TYPE
          arg EventFailed: type=boolean, direction=OUT, server-argument-impl-policy=USE-ARGUMENT-TYPE
        GetEventFreezeFrameData: possible-error=[GeneralDiagnosticInfo/E_NOT_OK, GeneralDiagnosticInfo/DEM_E_NODATAAVAILABLE, GeneralDiagnosticInfo/DEM_E_WRONG_RECORDNUMBER, GeneralDiagnosticInfo/DEM_E_WRONG_DIDNUMBER]
          5 x arg, all with server-argument-impl-policy=USE-ARGUMENT-TYPE:
            EventId: type=Dem_EventIdType, direction=IN
            RecordNumber: type=uint8, direction=IN
            ReportTotalRecord: type=boolean, direction=IN
            DataId: type=uint16, direction=IN
            DestBuffer: type=Dem_MaxDataValueType, direction=OUT
        GetEventStatus: possible-error=GeneralDiagnosticInfo/E_NOT_OK
          arg EventId: type=Dem_EventIdType, direction=IN, server-argument-impl-policy=USE-ARGUMENT-TYPE
          arg EventStatusExtended: type=Dem_EventStatusExtendedType, direction=OUT, server-argument-impl-policy=USE-ARGUMENT-TYPE
        GetEventTested: possible-error=GeneralDiagnosticInfo/E_NOT_OK
          arg EventId: type=Dem_EventIdType, direction=IN, server-argument-impl-policy=USE-ARGUMENT-TYPE
          arg EventTested: type=boolean, direction=OUT, server-argument-impl-policy=USE-ARGUMENT-TYPE
        GetFaultDetectionCounter: possible-error=[GeneralDiagnosticInfo/E_NOT_OK, GeneralDiagnosticInfo/DEM_E_NO_FDC_AVAILABLE]
          arg EventId: type=Dem_EventIdType, direction=IN, server-argument-impl-policy=USE-ARGUMENT-TYPE
          arg FaultDetectionCounter: type=sint8, direction=OUT, server-argument-impl-policy=USE-ARGUMENT-TYPE
      6 x error:
        DEM_E_NO_DTC_AVAILABLE: error-code=2
        DEM_E_NO_FDC_AVAILABLE: error-code=3
        DEM_E_NODATAAVAILABLE: error-code=48
        DEM_E_WRONG_DIDNUMBER: error-code=50
        DEM_E_WRONG_RECORDNUMBER: error-code=49
        E_NOT_OK: error-code=1
    IndicatorStatus
      operation GetIndicatorStatus: possible-error=IndicatorStatus/E_NOT_OK
        arg IndicatorStatus: type=Dem_IndicatorStatusType, direction=OUT, server-argument-impl-policy=USE-ARGUMENT-TYPE
      error E_NOT_OK: error-code=1
    OperationCycle
      operation SetOperationCycleState: possible-error=OperationCycle/E_NOT_OK
        arg CycleState: type=Dem_OperationCycleStateType, direction=IN, server-argument-impl-policy=USE-ARGUMENT-TYPE
      error E_NOT_OK: error-code=1
package /MICROSAR_SWCS_DEV/Det_swc/Interfaces
  client server interface DETService: is-service=true, service-kind=DEVELOPMENT-ERROR-TRACER
    operation ReportError: possible-error=E_OK
      arg InstanceId: type=uint8, direction=IN, server-argument-impl-policy=USE-ARGUMENT-TYPE
      arg ApiId: type=uint8, direction=IN, server-argument-impl-policy=USE-ARGUMENT-TYPE
      arg ErrorId: type=uint8, direction=IN, server-argument-impl-policy=USE-ARGUMENT-TYPE
    error E_OK: error-code=0
package /MICROSAR_SWCS_DEV/IoHwAb_swc/Interfaces
  4 x client server interface:
    GetGpio_PortIf1
      operation Oper: possible-error=GetGpio_PortIf1/E_NOT_OK
        arg PinSt_Arg: type=IOHWAB_BOOL, direction=OUT, server-argument-impl-policy=USE-ARGUMENT-TYPE
      error E_NOT_OK: error-code=1
    SetFctGpio_PortIf1
      operation Oper: possible-error=SetFctGpio_PortIf1/E_NOT_OK
      error E_NOT_OK: error-code=1
    SetFctPeriph_PortIf1
      operation Oper: possible-error=SetFctPeriph_PortIf1/E_NOT_OK
      error E_NOT_OK: error-code=1
    SetGpio_PortIf1
      operation Oper: possible-error=SetGpio_PortIf1/E_NOT_OK
        arg PinSt_Arg: type=IOHWAB_BOOL, direction=IN, server-argument-impl-policy=USE-ARGUMENT-TYPE
      error E_NOT_OK: error-code=1
package /MICROSAR_SWCS_DEV/NvM_swc/Interfaces
  client server interface NvMAdministration: is-service=true, service-kind=NON-VOLATILE-RAM-MANAGER
    operation SetBlockProtection: possible-error=NvMAdministration/E_NOT_OK
      arg ProtectionEnabled: type=boolean, direction=IN, server-argument-impl-policy=USE-ARGUMENT-TYPE
    error E_NOT_OK: error-code=1
  client server interface NvMService_AC3_SRBS: is-service=true, service-kind=NON-VOLATILE-RAM-MANAGER
    6 x operation, all with possible-error=NvMService_AC3_SRBS/E_NOT_OK:
      EraseBlock
      GetErrorStatus
        arg ErrorStatus: type=NvM_RequestResultType, direction=OUT, server-argument-impl-policy=USE-ARGUMENT-TYPE
      InvalidateNvBlock
      ReadBlock
        arg DstPtr: type=dtRef_VOID, direction=IN, server-argument-impl-policy=USE-ARGUMENT-TYPE
      SetRamBlockStatus
        arg RamBlockStatus: type=boolean, direction=IN, server-argument-impl-policy=USE-ARGUMENT-TYPE
      WriteBlock
        arg SrcPtr: type=dtRef_const_VOID, direction=IN, server-argument-impl-policy=USE-ARGUMENT-TYPE
    error E_NOT_OK: error-code=1
  client server interface NvMService_AC3_SRBS_Defs: is-service=true, service-kind=NON-VOLATILE-RAM-MANAGER
    7 x operation, all with possible-error=NvMService_AC3_SRBS_Defs/E_NOT_OK:
      EraseBlock
      GetErrorStatus
        arg ErrorStatus: type=NvM_RequestResultType, direction=OUT, server-argument-impl-policy=USE-ARGUMENT-TYPE
      InvalidateNvBlock
      ReadBlock
        arg DstPtr: type=dtRef_VOID, direction=IN, server-argument-impl-policy=USE-ARGUMENT-TYPE
      RestoreBlockDefaults
        arg DstPtr: type=dtRef_VOID, direction=IN, server-argument-impl-policy=USE-ARGUMENT-TYPE
      SetRamBlockStatus
        arg RamBlockStatus: type=boolean, direction=IN, server-argument-impl-policy=USE-ARGUMENT-TYPE
      WriteBlock
        arg SrcPtr: type=dtRef_const_VOID, direction=IN, server-argument-impl-policy=USE-ARGUMENT-TYPE
    error E_NOT_OK: error-code=1
package /Nexteer/Calibrations
  301 x parameter interface:
    A1
      parameter data prototype Val: sw-calibration-access=READ-WRITE, type=A1
    A2
      parameter data prototype Val: sw-calibration-access=READ-WRITE, type=A3
    A3
      parameter data prototype Val: sw-calibration-access=READ-WRITE, type=A4
    A4
      parameter data prototype Val: sw-calibration-access=READ-WRITE, type=A5
    Ag1
      parameter data prototype Val: sw-calibration-access=READ-WRITE, type=Ag1
    Ag2
      parameter data prototype Val: sw-calibration-access=READ-WRITE, type=Ag6
    Ag3
      parameter data prototype Val: sw-calibration-access=READ-WRITE, type=Ag11
    Ag4
      parameter data prototype Val: sw-calibration-access=READ-WRITE, type=Ag13
    Ag5
      parameter data prototype Val: sw-calibration-access=READ-WRITE, type=Ag16
    AgAry1D2
      parameter data prototype Ary1D: sw-calibration-access=READ-WRITE, type=AgAry1D4
    AgAry2D1
      parameter data prototype Ary2D: sw-calibration-access=READ-WRITE, type=AgAry2D1
    Ar1D_u2p14_5_calPortIf1
      parameter data prototype Ary1D: sw-calibration-access=READ-WRITE, type=Ary1D_u2p14_5
    Ary1D_boolean_4_CalPortIf1
      parameter data prototype Ary1D: sw-calibration-access=READ-WRITE, type=Ary1D_boolean_4
    Ary1D_f32_4_CalPortIf1
      parameter data prototype Ary1D: sw-calibration-access=READ-WRITE, type=Ary1D_f32_4
    Ary1D_f32_5_CalPortIf1
      parameter data prototype Ary1D: sw-calibration-access=READ-WRITE, type=Ary1D_f32_5
    Ary1D_f32_8_CalPortIf1
      parameter data prototype Ary1D: sw-calibration-access=READ-WRITE, type=Ary1D_f32_8
    Ary1D_s10p5_8_CalPortIf1
      parameter data prototype Ary1D: sw-calibration-access=READ-WRITE, type=Ary1D_s10p5_8
    Ary1D_s11p4_11_CalPortIf1
      parameter data prototype Ary1D: sw-calibration-access=READ-WRITE, type=Ary1D_s11p4_11
    Ary1D_s11p4_14_CalPortIf1
      parameter data prototype Ary1D: sw-calibration-access=READ-WRITE, type=Ary1D_s11p4_14
    Ary1D_s11p4_5_CalPortIf1
      parameter data prototype Ary1D: sw-calibration-access=READ-WRITE, type=Ary1D_s11p4_5
    Ary1D_s14p1_8_CalPortIf1
      parameter data prototype Ary1D: sw-calibration-access=READ-WRITE, type=Ary1D_s14p1_8
    Ary1D_s15p0_4_CalPortIf1
      parameter data prototype Ary1D: sw-calibration-access=READ-WRITE, type=Ary1D_s15p0_4
    Ary1D_s15p0_5_CalPortIf1
      parameter data prototype Ary1D: sw-calibration-access=READ-WRITE, type=Ary1D_s15p0_5
    Ary1D_s4p11_20_CalPortIf1
      parameter data prototype Ary1D: sw-calibration-access=READ-WRITE, type=Ary1D_s4p11_20
    Ary1D_s4p11_5_CalPortIf1
      parameter data prototype Ary1D: sw-calibration-access=READ-WRITE, type=Ary1D_s4p11_5
    Ary1D_s7p8_20_CalPortIf1
      parameter data prototype Ary1D: sw-calibration-access=READ-WRITE, type=Ary1D_s7p8_20
    Ary1D_s8p7_3_CalPortIf1
      parameter data prototype Ary1D: sw-calibration-access=READ-WRITE, type=Ary1D_s8p7_3
    Ary1D_u0p16_10_CalPortIf1
      parameter data prototype Ary1D: sw-calibration-access=READ-WRITE, type=Ary1D_u0p16_10
    Ary1D_u0p16_3_CalPortIf1
      parameter data prototype Ary1D: sw-calibration-access=READ-WRITE, type=Ary1D_u0p16_3
    Ary1D_u10p6_13_CalPortIf1
      parameter data prototype Ary1D: sw-calibration-access=READ-WRITE, type=Ary1D_u10p6_13
    Ary1D_u10p6_3_CalPortIf1
      parameter data prototype Ary1D: sw-calibration-access=READ-WRITE, type=Ary1D_u10p6_3
    Ary1D_u10p6_4_CalPortIf1
      parameter data prototype Ary1D: sw-calibration-access=READ-WRITE, type=Ary1D_u10p6_4
    Ary1D_u10p6_5_CalPortIf1
      parameter data prototype Ary1D: sw-calibration-access=READ-WRITE, type=Ary1D_u10p6_5
    Ary1D_u10p6_7_CalPortIf1
      parameter data prototype Ary1D: sw-calibration-access=READ-WRITE, type=Ary1D_u10p6_7
    Ary1D_u10p6_8_CalPortIf1
      parameter data prototype Ary1D: sw-calibration-access=READ-WRITE, type=Ary1D_u10p6_8
    Ary1D_u11p5_10_CalPortIf1
      parameter data prototype Ary1D: sw-calibration-access=READ-WRITE, type=Ary1D_u11p5_10
    Ary1D_u11p5_11_CalPortIf1
      parameter data prototype Ary1D: sw-calibration-access=READ-WRITE, type=Ary1D_u11p5_11
    Ary1D_u11p5_13_CalPortIf1
      parameter data prototype Ary1D: sw-calibration-access=READ-WRITE, type=Ary1D_u11p5_13
    Ary1D_u11p5_4_CalPortIf1
      parameter data prototype Ary1D: sw-calibration-access=READ-WRITE, type=Ary1D_u11p5_4
    Ary1D_u11p5_6_CalPortIf1
      parameter data prototype Ary1D: sw-calibration-access=READ-WRITE, type=Ary1D_u11p5_6
    Ary1D_u11p5_8_CalPortIf1
      parameter data prototype Ary1D: sw-calibration-access=READ-WRITE, type=Ary1D_u11p5_8
    Ary1D_u12p4_2_CalPortIf1
      parameter data prototype Ary1D: sw-calibration-access=READ-WRITE, type=Ary1D_u12p4_2
    Ary1D_u12p4_7_CalPortIf1
      parameter data prototype Ary1D: sw-calibration-access=READ-WRITE, type=Ary1D_u12p4_7
    Ary1D_u12p4_9_CalPortIf1
      parameter data prototype Ary1D: sw-calibration-access=READ-WRITE, type=Ary1D_u12p4_9
    Ary1D_u13p3_2_CalPortIf1
      parameter data prototype Ary1D: sw-calibration-access=READ-WRITE, type=Ary1D_u13p3_2
    Ary1D_u13p3_6_CalPortIf1
      parameter data prototype Ary1D: sw-calibration-access=READ-WRITE, type=Ary1D_u13p3_6
    Ary1D_u16p0_20_CalPortIf1
      parameter data prototype Ary1D: sw-calibration-access=READ-WRITE, type=Ary1D_u16p0_20
    Ary1D_u16p0_8_CalPortIf1
      parameter data prototype Ary1D: sw-calibration-access=READ-WRITE, type=Ary1D_u16p0_8
    Ary1D_u1p15_10_CalPortIf1
      parameter data prototype Ary1D: sw-calibration-access=READ-WRITE, type=Ary1D_u1p15_10
    Ary1D_u1p15_11_CalPortIf1
      parameter data prototype Ary1D: sw-calibration-access=READ-WRITE, type=Ary1D_u1p15_11
    Ary1D_u1p15_12_CalPortIf1
      parameter data prototype Ary1D: sw-calibration-access=READ-WRITE, type=Ary1D_u1p15_12
    Ary1D_u1p15_2_CalPortIf1
      parameter data prototype Ary1D: sw-calibration-access=READ-WRITE, type=Ary1D_u1p15_2
    Ary1D_u1p15_5_CalPortIf1
      parameter data prototype Ary1D: sw-calibration-access=READ-WRITE, type=Ary1D_u1p15_5
    Ary1D_u1p15_6_CalPortIf1
      parameter data prototype Ary1D: sw-calibration-access=READ-WRITE, type=Ary1D_u1p15_6
    Ary1D_u2p14_12_CalPortIf1
      parameter data prototype Ary1D: sw-calibration-access=READ-WRITE, type=Ary1D_u2p14_12
    Ary1D_u2p14_2_CalPortIf1
      parameter data prototype Ary1D: sw-calibration-access=READ-WRITE, type=Ary1D_u2p14_2
    Ary1D_u2p14_3_CalPortIf1
      parameter data prototype Ary1D: sw-calibration-access=READ-WRITE, type=Ary1D_u2p14_3
    Ary1D_u2p14_4_CalPortIf1
      parameter data prototype Ary1D: sw-calibration-access=READ-WRITE, type=Ary1D_u2p14_4
    Ary1D_u2p14_5_CalPortIf1
      parameter data prototype Ary1D: sw-calibration-access=READ-WRITE, type=Ary1D_u2p14_5
    Ary1D_u2p14_6_CalPortIf1
      parameter data prototype Ary1D: sw-calibration-access=READ-WRITE, type=Ary1D_u2p14_6
    Ary1D_u2p14_8_CalPortIf1
      parameter data prototype Ary1D: sw-calibration-access=READ-WRITE, type=Ary1D_u2p14_8
    Ary1D_u2p14_9_CalPortIf1
      parameter data prototype Ary1D: sw-calibration-access=READ-WRITE, type=Ary1D_u2p14_9
    Ary1D_u32_512
      parameter data prototype Ary1D: sw-calibration-access=READ-WRITE, type=Ary1D_u32_512
    Ary1D_u32_512_CalPortIf1
      parameter data prototype Ary1D: sw-calibration-access=READ-WRITE, type=Ary1D_u32_512
    Ary1D_u3p13_10_CalPortIf1
      parameter data prototype Ary1D: sw-calibration-access=READ-WRITE, type=Ary1D_u3p13_10
    Ary1D_u3p13_5_CalPortIf1
      parameter data prototype Ary1D: sw-calibration-access=READ-WRITE, type=Ary1D_u3p13_5
    Ary1D_u4p12_10_CalPortIf1
      parameter data prototype Ary1D: sw-calibration-access=READ-WRITE, type=Ary1D_u4p12_10
    Ary1D_u4p12_11_CalPortIf1
      parameter data prototype Ary1D: sw-calibration-access=READ-WRITE, type=Ary1D_u4p12_11
    Ary1D_u4p12_12_CalPortIf1
      parameter data prototype Ary1D: sw-calibration-access=READ-WRITE, type=Ary1D_u4p12_12
    Ary1D_u4p12_2_CalPortIf1
      parameter data prototype Ary1D: sw-calibration-access=READ-WRITE, type=Ary1D_u4p12_2
    Ary1D_u4p12_4_CalPortIf1
      parameter data prototype Ary1D: sw-calibration-access=READ-WRITE, type=Ary1D_u4p12_4
    Ary1D_u4p12_5_CalPortIf1
      parameter data prototype Ary1D: sw-calibration-access=READ-WRITE, type=Ary1D_u4p12_5
    Ary1D_u4p12_6_CalPortIf1
      parameter data prototype Ary1D: sw-calibration-access=READ-WRITE, type=Ary1D_u4p12_6
    Ary1D_u4p12_8_CalPortIf1
      parameter data prototype Ary1D: sw-calibration-access=READ-WRITE, type=Ary1D_u4p12_8
    Ary1D_u5p11_10_CalPortIf1
      parameter data prototype Ary1D: sw-calibration-access=READ-WRITE, type=Ary1D_u5p11_10
    Ary1D_u5p11_11_CalPortIf1
      parameter data prototype Ary1D: sw-calibration-access=READ-WRITE, type=Ary1D_u5p11_11
    Ary1D_u5p11_14_CalPortIf1
      parameter data prototype Ary1D: sw-calibration-access=READ-WRITE, type=Ary1D_u5p11_14
    Ary1D_u5p11_17_CalPortIf1
      parameter data prototype Ary1D: sw-calibration-access=READ-WRITE, type=Ary1D_u5p11_17
    Ary1D_u5p11_5_CalPortIf1
      parameter data prototype Ary1D: sw-calibration-access=READ-WRITE, type=Ary1D_u5p11_5
    Ary1D_u5p11_6_CalPortIf1
      parameter data prototype Ary1D: sw-calibration-access=READ-WRITE, type=Ary1D_u5p11_6
    Ary1D_u5p11_8_CalPortIf1
      parameter data prototype Ary1D: sw-calibration-access=READ-WRITE, type=Ary1D_u5p11_8
    Ary1D_u6p10_10_CalPortIf1
      parameter data prototype Ary1D: sw-calibration-access=READ-WRITE, type=Ary1D_u6p10_10
    Ary1D_u6p10_17_CalPortIf1
      parameter data prototype Ary1D: sw-calibration-access=READ-WRITE, type=Ary1D_u6p10_17
    Ary1D_u6p10_6_CalPortIf1
      parameter data prototype Ary1D: sw-calibration-access=READ-WRITE, type=Ary1D_u6p10_6
    Ary1D_u7p9_12_CalPortIf1
      parameter data prototype Ary1D: sw-calibration-access=READ-WRITE, type=Ary1D_u7p9_12
    Ary1D_u7p9_3_CalPortIf1
      parameter data prototype Ary1D: sw-calibration-access=READ-WRITE, type=Ary1D_u7p9_3
    Ary1D_u7p9_6_CalPortIf1
      parameter data prototype Ary1D: sw-calibration-access=READ-WRITE, type=Ary1D_u7p9_6
    Ary1D_u8_14_PortIf1
      parameter data prototype Ary1D: sw-calibration-access=READ-WRITE, type=Ary1D_u8_14
    Ary1D_u8_48_CalPortIf1
      parameter data prototype Ary1D: sw-calibration-access=READ-WRITE, type=Ary1D_u8_48
    Ary1D_u8_6_CalPortIf1
      parameter data prototype Ary1D: sw-calibration-access=READ-WRITE, type=Ary1D_u8_6
    Ary1D_u8p8_11_CalPortIf1
      parameter data prototype Ary1D: sw-calibration-access=READ-WRITE, type=Ary1D_u8p8_11
    Ary1D_u8p8_20_CalPortIf1
      parameter data prototype Ary1D: sw-calibration-access=READ-WRITE, type=Ary1D_u8p8_20
    Ary1D_u8p8_3_CalPortIf1
      parameter data prototype Ary1D: sw-calibration-access=READ-WRITE, type=Ary1D_u8p8_3
    Ary1D_u8p8_4_CalPortIf1
      parameter data prototype Ary1D: sw-calibration-access=READ-WRITE, type=Ary1D_u8p8_4
    Ary1D_u8p8_5_CalPortIf1
      parameter data prototype Ary1D: sw-calibration-access=READ-WRITE, type=Ary1D_u8p8_5
    Ary1D_u8p8_6_CalPortIf1
      parameter data prototype Ary1D: sw-calibration-access=READ-WRITE, type=Ary1D_u8p8_6
    Ary1D_u8p8_7_CalPortIf1
      parameter data prototype Ary1D: sw-calibration-access=READ-WRITE, type=Ary1D_u8p8_7
    Ary1D_u8p8_8_CalPortIf1
      parameter data prototype Ary1D: sw-calibration-access=READ-WRITE, type=Ary1D_u8p8_8
    Ary1D_u9p7_10_CalPortIf1
      parameter data prototype Ary1D: sw-calibration-access=READ-WRITE, type=Ary1D_u9p7_10
    Ary1D_u9p7_12_CalPortIf1
      parameter data prototype Ary1D: sw-calibration-access=READ-WRITE, type=Ary1D_u9p7_12
    Ary1D_u9p7_2_CalPortIf1
      parameter data prototype Ary1D: sw-calibration-access=READ-WRITE, type=Ary1D_u9p7_2
    Ary1D_u9p7_3_CalPortIf1
      parameter data prototype Ary1D: sw-calibration-access=READ-WRITE, type=Ary1D_u9p7_3
    Ary1D_u9p7_4_CalPortIf1
      parameter data prototype Ary1D: sw-calibration-access=READ-WRITE, type=Ary1D_u9p7_4
    Ary1D_u9p7_5_CalPortIf1
      parameter data prototype Ary1D: sw-calibration-access=READ-WRITE, type=Ary1D_u9p7_5
    Ary1D_u9p7_6_CalPortIf1
      parameter data prototype Ary1D: sw-calibration-access=READ-WRITE, type=Ary1D_u9p7_6
    Ary1D_u9p7_8_CalPortIf1
      parameter data prototype Ary1D: sw-calibration-access=READ-WRITE, type=Ary1D_u9p7_8
    Ary1D_u9p7_9_CalPortIf1
      parameter data prototype Ary1D: sw-calibration-access=READ-WRITE, type=Ary1D_u9p7_9
    Ary2D_f32_4_2_CalPortIf1
      parameter data prototype Ary2D: sw-calibration-access=READ-WRITE, type=Ary2D_f32_4_2
    Ary2D_f32_4_5_CalPortIf1
      parameter data prototype Ary2D: sw-calibration-access=READ-WRITE, type=Ary2D_f32_4_5
    Ary2D_f32_5_4_CalPortIf1
      parameter data prototype Ary2D: sw-calibration-access=READ-WRITE, type=Ary2D_f32_5_4
    Ary2D_f32_5_5_CalPortIf1
      parameter data prototype Ary2D: sw-calibration-access=READ-WRITE, type=Ary2D_f32_5_5
    Ary2D_f32_8_4_CalPortIf1
      parameter data prototype Ary2D: sw-calibration-access=READ-WRITE, type=Ary2D_f32_8_4
    Ary2D_s1p14_10_12_CalPortIf1
      parameter data prototype Ary2D: sw-calibration-access=READ-WRITE, type=Ary2D_s1p14_10_12
    Ary2D_s4p11_11_8_CalPortIf1
      parameter data prototype Ary2D: sw-calibration-access=READ-WRITE, type=Ary2D_s4p11_11_8
    Ary2D_s4p11_12_11_CalPortIf1
      parameter data prototype Ary2D: sw-calibration-access=READ-WRITE, type=Ary2D_s4p11_12_11
    Ary2D_s4p11_8_11_CalPortIf1
      parameter data prototype Ary2D: sw-calibration-access=READ-WRITE, type=Ary2D_s4p11_8_11
    Ary2D_s7p8_11_12_CalPortIf1
      parameter data prototype Ary2D: sw-calibration-access=READ-WRITE, type=Ary2D_s7p8_11_12
    Ary2D_s7p8_12_11_CalPortIf1
      parameter data prototype Ary2D: sw-calibration-access=READ-WRITE, type=Ary2D_s7p8_12_11
    Ary2D_s7p8_3_5_CalPortIf1
      parameter data prototype Ary2D: sw-calibration-access=READ-WRITE, type=Ary2D_s7p8_3_5
    Ary2D_s7p8_3_6_CalPortIf1
      parameter data prototype Ary2D: sw-calibration-access=READ-WRITE, type=Ary2D_s7p8_3_6
    Ary2D_s7p8_4_5_CalPortIf1
      parameter data prototype Ary2D: sw-calibration-access=READ-WRITE, type=Ary2D_s7p8_4_5
    Ary2D_s7p8_9_5_CalPortIf1
      parameter data prototype Ary2D: sw-calibration-access=READ-WRITE, type=Ary2D_s7p8_9_5
    Ary2D_s7p8_9_6_CalPortIf1
      parameter data prototype Ary2D: sw-calibration-access=READ-WRITE, type=Ary2D_s7p8_9_6
    Ary2D_u0p16_20_8_CalPortIf1
      parameter data prototype Ary2D: sw-calibration-access=READ-WRITE, type=Ary2D_u0p16_20_8
    Ary2D_u0p16_4_2_CalPortIf1
      parameter data prototype Ary2D: sw-calibration-access=READ-WRITE, type=Ary2D_u0p16_4_2
    Ary2D_u10p6_3_7_CalPortIf1
      parameter data prototype Ary2D: sw-calibration-access=READ-WRITE, type=Ary2D_u10p6_3_7
    Ary2D_u10p6_8_12_CalPortIf1
      parameter data prototype Ary2D: sw-calibration-access=READ-WRITE, type=Ary2D_u10p6_8_12
    Ary2D_u10p6_8_9_CalPortIf1
      parameter data prototype Ary2D: sw-calibration-access=READ-WRITE, type=Ary2D_u10p6_8_9
    Ary2D_u12p4_4_2_CalPortIf1
      parameter data prototype Ary2D: sw-calibration-access=READ-WRITE, type=Ary2D_u12p4_4_2
    Ary2D_u12p4_5_4_CalPortIf1
      parameter data prototype Ary2D: sw-calibration-access=READ-WRITE, type=Ary2D_u12p4_5_4
    Ary2D_u12p4_8_12_CalPortIf1
      parameter data prototype Ary2D: sw-calibration-access=READ-WRITE, type=Ary2D_u12p4_8_12
    Ary2D_u16_8_3_CalPortIf1
      parameter data prototype Ary2D: sw-calibration-access=READ-WRITE, type=Ary2D_u16_8_3
    Ary2D_u1p15_12_5_CalPortIf1
      parameter data prototype Ary2D: sw-calibration-access=READ-WRITE, type=Ary2D_u1p15_12_5
    Ary2D_u1p15_5_4_CalPortIf1
      parameter data prototype Ary2D: sw-calibration-access=READ-WRITE, type=Ary2D_u1p15_5_4
    Ary2D_u1p15_8_4_CalPortIf1
      parameter data prototype Ary2D: sw-calibration-access=READ-WRITE, type=Ary2D_u1p15_8_4
    Ary2D_u2p14_5_10_CalPortIf1
      parameter data prototype Ary2D: sw-calibration-access=READ-WRITE, type=Ary2D_u2p14_5_10
    Ary2D_u2p14_5_8_CalPortIf1
      parameter data prototype Ary2D: sw-calibration-access=READ-WRITE, type=Ary2D_u2p14_5_8
    Ary2D_u2p14_6_5_CalPortIf1
      parameter data prototype Ary2D: sw-calibration-access=READ-WRITE, type=Ary2D_u2p14_6_5
    Ary2D_u2p14_6_7_PortIf1
      parameter data prototype Ary2D: sw-calibration-access=READ-WRITE, type=Ary2D_u2p14_6_7
    Ary2D_u2p14_7_8_CalPortIf1
      parameter data prototype Ary2D: sw-calibration-access=READ-WRITE, type=Ary2D_u2p14_7_8
    Ary2D_u3p13_12_13_CalPortIf1
      parameter data prototype Ary2D: sw-calibration-access=READ-WRITE, type=Ary2D_u3p13_12_13
    Ary2D_u3p13_20_8_CalPortIf1
      parameter data prototype Ary2D: sw-calibration-access=READ-WRITE, type=Ary2D_u3p13_20_8
    Ary2D_u4p12_12_20_CalPortIf1
      parameter data prototype Ary2D: sw-calibration-access=READ-WRITE, type=Ary2D_u4p12_12_20
    Ary2D_u4p12_12_5_CalPortIf1
      parameter data prototype Ary2D: sw-calibration-access=READ-WRITE, type=Ary2D_u4p12_12_5
    Ary2D_u4p12_12_8_CalPortIf1
      parameter data prototype Ary2D: sw-calibration-access=READ-WRITE, type=Ary2D_u4p12_12_8
    Ary2D_u4p12_13_3_CalPortIf1
      parameter data prototype Ary2D: sw-calibration-access=READ-WRITE, type=Ary2D_u4p12_13_3
    Ary2D_u4p12_3_13_CalPortIf1
      parameter data prototype Ary2D: sw-calibration-access=READ-WRITE, type=Ary2D_u4p12_3_13
    Ary2D_u5p11_12_13_CalPortIf1
      parameter data prototype Ary2D: sw-calibration-access=READ-WRITE, type=Ary2D_u5p11_12_13
    Ary2D_u6p10_5_9_CalPortIf1
      parameter data prototype Ary2D: sw-calibration-access=READ-WRITE, type=Ary2D_u6p10_5_9
    Ary2D_u6p10_8_9_CalPortIf1
      parameter data prototype Ary2D: sw-calibration-access=READ-WRITE, type=Ary2D_u6p10_8_9
    Ary2D_u8p8_3_5_CalPortIf1
      parameter data prototype Ary2D: sw-calibration-access=READ-WRITE, type=Ary2D_u8p8_3_5
    Ary2D_u8p8_3_6_CalPortIf1
      parameter data prototype Ary2D: sw-calibration-access=READ-WRITE, type=Ary2D_u8p8_3_6
    Ary2D_u8p8_5_10_CalPortIf1
      parameter data prototype Ary2D: sw-calibration-access=READ-WRITE, type=Ary2D_u8p8_5_10
    Ary2D_u8p8_5_8_CalPortIf1
      parameter data prototype Ary2D: sw-calibration-access=READ-WRITE, type=Ary2D_u8p8_5_8
    Ary2D_u8p8_6_5_CalPortIf1
      parameter data prototype Ary2D: sw-calibration-access=READ-WRITE, type=Ary2D_u8p8_6_5
    Ary2D_u8p8_9_5_CalPortIf1
      parameter data prototype Ary2D: sw-calibration-access=READ-WRITE, type=Ary2D_u8p8_9_5
    Ary2D_u8p8_9_6_CalPortIf1
      parameter data prototype Ary2D: sw-calibration-access=READ-WRITE, type=Ary2D_u8p8_9_6
    boolean_CalPortIf1
      parameter data prototype Logl: sw-calibration-access=READ-WRITE, type=boolean
    Cnt1
      parameter data prototype Val: sw-calibration-access=READ-WRITE, type=Cnt5
    Cnt10
      parameter data prototype Val: sw-calibration-access=READ-WRITE, type=Cnt16
    Cnt11
      parameter data prototype Val: sw-calibration-access=READ-WRITE, type=Cnt30
    Cnt2
      parameter data prototype Val: sw-calibration-access=READ-WRITE, type=uint16
    Cnt3
      parameter data prototype Val: sw-calibration-access=READ-WRITE, type=uint8
    Cnt4
      parameter data prototype Val: sw-calibration-access=READ-WRITE, type=Cnt9
    Cnt5
      parameter data prototype Val: sw-calibration-access=READ-WRITE, type=Cnt10
    Cnt6
      parameter data prototype Val: sw-calibration-access=READ-WRITE, type=Cnt14
    Cnt7
      parameter data prototype Val: sw-calibration-access=READ-WRITE, type=Cnt28
    Cnt8
      parameter data prototype Val: sw-calibration-access=READ-WRITE, type=Cnt29
    Cnt9
      parameter data prototype Val: sw-calibration-access=READ-WRITE, type=Cnt15
    CntAry1D1
      parameter data prototype Ary1D: sw-calibration-access=READ-WRITE, type=CntAry1D1
    CntAry1D2
      parameter data prototype Ary1D: sw-calibration-access=READ-WRITE, type=CntAry1D4
    CntAry1D3
      parameter data prototype Ary1D: sw-calibration-access=READ-WRITE, type=CntAry1D5
    CntAry1D4
      parameter data prototype Ary1D: sw-calibration-access=READ-WRITE, type=CntAry1D6
    Curr1
      parameter data prototype Val: sw-calibration-access=READ-WRITE, type=Curr2
    Curr2
      parameter data prototype Val: sw-calibration-access=READ-WRITE, type=Curr3
    Curr3
      parameter data prototype Val: sw-calibration-access=READ-WRITE, type=Curr9
    CurrAry1D1
      parameter data prototype Ary1D: sw-calibration-access=READ-WRITE, type=CurrAry1D1
    CurrAry1D2
      parameter data prototype Ary1D: sw-calibration-access=READ-WRITE, type=CurrAry1D2
    CurrAry1D3
      parameter data prototype Ary1D: sw-calibration-access=READ-WRITE, type=CurrAry1D3
    FilNotchGainRec1_CalPortIf1
      parameter data prototype Rec: sw-calibration-access=READ-WRITE, type=FilNotchGainRec1
    float32_CalPortIf1
      parameter data prototype Val: sw-calibration-access=READ-WRITE, type=float32
    Frq1
      parameter data prototype Val: sw-calibration-access=READ-WRITE, type=Frq1
    Frq2
      parameter data prototype Val: sw-calibration-access=READ-WRITE, type=Frq2
    Frq3
      parameter data prototype Val: sw-calibration-access=READ-WRITE, type=Frq7
    Frq4
      parameter data prototype Val: sw-calibration-access=READ-WRITE, type=Frq8
    Frq5
      parameter data prototype Val: sw-calibration-access=READ-WRITE, type=Frq9
    Frq6
      parameter data prototype Val: sw-calibration-access=READ-WRITE, type=Frq10
    FrqAry1D1
      parameter data prototype Ary1D: sw-calibration-access=READ-WRITE, type=FrqAry1D1
    FrqAry1D2
      parameter data prototype Ary1D: sw-calibration-access=READ-WRITE, type=FrqAry1D2
    FrqAry1D3
      parameter data prototype Ary1D: sw-calibration-access=READ-WRITE, type=FrqAry1D3
    FrqAry1D4
      parameter data prototype Ary1D: sw-calibration-access=READ-WRITE, type=FrqAry1D4
    Gain1
      parameter data prototype Val: sw-calibration-access=READ-WRITE, type=Gain1
    Gain2
      parameter data prototype Val: sw-calibration-access=READ-WRITE, type=Gain2
    Gain3
      parameter data prototype Val: sw-calibration-access=READ-WRITE, type=Gain3
    Gain4
      parameter data prototype Val: sw-calibration-access=READ-WRITE, type=Gain5
    Gain5
      parameter data prototype Val: sw-calibration-access=READ-WRITE, type=Gain6
    Gain6
      parameter data prototype Val: sw-calibration-access=READ-WRITE, type=Gain7
    Gain7
      parameter data prototype Val: sw-calibration-access=READ-WRITE, type=Gain8
    Indu1
      parameter data prototype Val: sw-calibration-access=READ-WRITE, type=Indu1
    Logl1
      parameter data prototype Logl: sw-calibration-access=READ-WRITE, type=Logl1
    MotCon1
      parameter data prototype Val: sw-calibration-access=READ-WRITE, type=MotCon1
    R1
      parameter data prototype Val: sw-calibration-access=READ-WRITE, type=R1
    R2
      parameter data prototype Val: sw-calibration-access=READ-WRITE, type=R6
    R3
      parameter data prototype Val: sw-calibration-access=READ-WRITE, type=R8
    Rate1
      parameter data prototype Val: sw-calibration-access=READ-WRITE, type=Rate3
    Rate2
      parameter data prototype Val: sw-calibration-access=READ-WRITE, type=Rate4
    Rate3
      parameter data prototype Val: sw-calibration-access=READ-WRITE, type=Rate5
    Rate4
      parameter data prototype Val: sw-calibration-access=READ-WRITE, type=Rate6
    Rate5
      parameter data prototype Val: sw-calibration-access=READ-WRITE, type=Rate7
    Rate6
      parameter data prototype Val: sw-calibration-access=READ-WRITE, type=Rate8
    Rate7
      parameter data prototype Val: sw-calibration-access=READ-WRITE, type=Rate9
    Rate8
      parameter data prototype Val: sw-calibration-access=READ-WRITE, type=Rate10
    sint16_CalPortIf1
      parameter data prototype Val: sw-calibration-access=READ-WRITE, type=sint16
    Spd1  # OBSOLETE
      parameter data prototype Element: sw-calibration-access=READ-WRITE, type=Spd1
    Spd2
      parameter data prototype Val: sw-calibration-access=READ-WRITE, type=Spd3
    Spd3
      parameter data prototype Val: sw-calibration-access=READ-WRITE, type=Spd4
    Spd4
      parameter data prototype Val: sw-calibration-access=READ-WRITE, type=Spd1
    SpdAry1D1
      parameter data prototype Ary1D: sw-calibration-access=READ-WRITE, type=SpdAry1D1
    SpdAry1D2
      parameter data prototype Ary1D: sw-calibration-access=READ-WRITE, type=SpdAry1D2
    T1
      parameter data prototype Val: sw-calibration-access=READ-WRITE, type=T1
    T2
      parameter data prototype Val: sw-calibration-access=READ-WRITE, type=T2
    T3
      parameter data prototype Val: sw-calibration-access=READ-WRITE, type=T4
    T4
      parameter data prototype Val: sw-calibration-access=READ-WRITE, type=T5
    TAry1D1  # OBSOLETE
      parameter data prototype Ary1D1: sw-calibration-access=READ-WRITE, type=TAry1D1
    TAry1D2
      parameter data prototype Ary1D: sw-calibration-access=READ-WRITE, type=TAry1D2
    TAry1D3
      parameter data prototype Ary1D: sw-calibration-access=READ-WRITE, type=TAry1D1
    Ti1
      parameter data prototype Val: sw-calibration-access=READ-WRITE, type=Ti1
    Ti2
      parameter data prototype Val: sw-calibration-access=READ-WRITE, type=Ti2
    Ti3
      parameter data prototype Val: sw-calibration-access=READ-WRITE, type=Ti3
    Ti4
      parameter data prototype Val: sw-calibration-access=READ-WRITE, type=Ti4
    Ti5
      parameter data prototype Val: sw-calibration-access=READ-WRITE, type=Ti5
    Ti6
      parameter data prototype Val: sw-calibration-access=READ-WRITE, type=Ti6
    Ti7
      parameter data prototype Val: sw-calibration-access=READ-WRITE, type=Ti10
    Ti8
      parameter data prototype Val: sw-calibration-access=READ-WRITE, type=Ti11
    Ti9
      parameter data prototype Val: sw-calibration-access=READ-WRITE, type=Ti12
    Tq1
      parameter data prototype Val: sw-calibration-access=READ-WRITE, type=Tq3
    Tq2
      parameter data prototype Val: sw-calibration-access=READ-WRITE, type=Tq10
    Tq3
      parameter data prototype Val: sw-calibration-access=READ-WRITE, type=Tq15
    Tq4
      parameter data prototype Val: sw-calibration-access=READ-WRITE, type=Tq1
    Tq5
      parameter data prototype Val: sw-calibration-access=READ-WRITE, type=Tq16
    Tq6
      parameter data prototype Val: sw-calibration-access=READ-WRITE, type=Tq18
    TqAry1D1
      parameter data prototype Ary1D: sw-calibration-access=READ-WRITE, type=TqAry1D6
    TqAry1D2
      parameter data prototype Ary1D: sw-calibration-access=READ-WRITE, type=TqAry1D9
    TqAry1D3
      parameter data prototype Ary1D: sw-calibration-access=READ-WRITE, type=TqAry1D10
    TqAry2D1
      parameter data prototype Ary2D: sw-calibration-access=READ-WRITE, type=TqAry2D1
    TqAry2D2
      parameter data prototype Ary2D: sw-calibration-access=READ-WRITE, type=TqAry2D2
    TqAry2D3
      parameter data prototype Ary2D: sw-calibration-access=READ-WRITE, type=TqAry2D3
    TqAry2D4
      parameter data prototype Ary2D: sw-calibration-access=READ-WRITE, type=TqAry2D4
    TqAry2D5
      parameter data prototype Ary2D: sw-calibration-access=READ-WRITE, type=TqAry2D5
    TqAry2D6
      parameter data prototype Ary2D: sw-calibration-access=READ-WRITE, type=TqAry2D6
    TqAry2D7
      parameter data prototype Ary2D: sw-calibration-access=READ-WRITE, type=TqAry2D7
    TqAry2D8
      parameter data prototype Ary2D: sw-calibration-access=READ-WRITE, type=TqAry2D8
    u0p16_CalPortIf1
      parameter data prototype Val: sw-calibration-access=READ-WRITE, type=u0p16
    u16p0_CalPortIf1
      parameter data prototype Val: sw-calibration-access=READ-WRITE, type=u16p0
    u2p14_CalPortIf1
      parameter data prototype Val: sw-calibration-access=READ-WRITE, type=u2p14
    u9p7_CalPortIf1
      parameter data prototype Val: sw-calibration-access=READ-WRITE, type=u9p7
    uint16_CalPortIf1
      parameter data prototype Val: sw-calibration-access=READ-WRITE, type=uint16
    uint32_CalPortIf1
      parameter data prototype Val: sw-calibration-access=READ-WRITE, type=uint32
    uint8_CalPortIf1
      parameter data prototype Val: sw-calibration-access=READ-WRITE, type=uint8
    Uls1
      parameter data prototype Val: sw-calibration-access=READ-WRITE, type=Uls1
    Uls2
      parameter data prototype Val: sw-calibration-access=READ-WRITE, type=Uls7
    Uls3
      parameter data prototype Val: sw-calibration-access=READ-WRITE, type=Uls9
    Uls4
      parameter data prototype Val: sw-calibration-access=READ-WRITE, type=Uls2
    Uls5
      parameter data prototype Val: sw-calibration-access=READ-WRITE, type=Uls10
    Uls6
      parameter data prototype Val: sw-calibration-access=READ-WRITE, type=Uls14
    Uls7
      parameter data prototype Val: sw-calibration-access=READ-WRITE, type=Uls21
    UlsAry1D1
      parameter data prototype Ary1D: sw-calibration-access=READ-WRITE, type=UlsAry1D2
    UlsAry1D10
      parameter data prototype Ary1D: sw-calibration-access=READ-WRITE, type=UlsAry1D15
    UlsAry1D2
      parameter data prototype Ary1D: sw-calibration-access=READ-WRITE, type=UlsAry1D3
    UlsAry1D3
      parameter data prototype Ary1D: sw-calibration-access=READ-WRITE, type=UlsAry1D5
    UlsAry1D4
      parameter data prototype Ary1D: sw-calibration-access=READ-WRITE, type=UlsAry1D7
    UlsAry1D5
      parameter data prototype Ary1D: sw-calibration-access=READ-WRITE, type=UlsAry1D8
    UlsAry1D6
      parameter data prototype Ary1D: sw-calibration-access=READ-WRITE, type=UlsAry1D11
    UlsAry1D7
      parameter data prototype Ary1D: sw-calibration-access=READ-WRITE, type=UlsAry1D12
    UlsAry1D8
      parameter data prototype Ary1D: sw-calibration-access=READ-WRITE, type=UlsAry1D13
    UlsAry1D9
      parameter data prototype Ary1D: sw-calibration-access=READ-WRITE, type=UlsAry1D14
    UlsAry2D1
      parameter data prototype Ary2D: sw-calibration-access=READ-WRITE, type=UlsAry2D1
    UlsAry2D2
      parameter data prototype Ary2D: sw-calibration-access=READ-WRITE, type=UlsAry2D2
    UlsAry2D3
      parameter data prototype Ary2D: sw-calibration-access=READ-WRITE, type=UlsAry2D3
    UlsAry2D4
      parameter data prototype Ary2D: sw-calibration-access=READ-WRITE, type=UlsAry2D4
    Vel1
      parameter data prototype Val: sw-calibration-access=READ-WRITE, type=Vel2
    Vel2
      parameter data prototype Val: sw-calibration-access=READ-WRITE, type=Vel5
    Vel3
      parameter data prototype Val: sw-calibration-access=READ-WRITE, type=Vel8
    VelAry1D1
      parameter data prototype Ary1D: sw-calibration-access=READ-WRITE, type=VelAry1D1
    VelAry1D2
      parameter data prototype Ary1D: sw-calibration-access=READ-WRITE, type=VelAry1D2
    VelAry1D3
      parameter data prototype Ary1D: sw-calibration-access=READ-WRITE, type=VelAry1D3
    VelAry2D1
      parameter data prototype Ary2D: sw-calibration-access=READ-WRITE, type=VelAry2D1
    VelAry2D2
      parameter data prototype Ary2D: sw-calibration-access=READ-WRITE, type=VelAry2D2
    VelAry2D3
      parameter data prototype Ary2D: sw-calibration-access=READ-WRITE, type=VelAry2D3
    Volt1
      parameter data prototype Val: sw-calibration-access=READ-WRITE, type=Volt1
    Volt10
      parameter data prototype Val: sw-calibration-access=READ-WRITE, type=Volt16
    Volt2
      parameter data prototype Val: sw-calibration-access=READ-WRITE, type=Volt3
    Volt3
      parameter data prototype Val: sw-calibration-access=READ-WRITE, type=Volt4
    Volt4
      parameter data prototype Val: sw-calibration-access=READ-WRITE, type=Volt8
    Volt5
      parameter data prototype Val: sw-calibration-access=READ-WRITE, type=Volt10
    Volt6
      parameter data prototype Val: sw-calibration-access=READ-WRITE, type=Volt9
    Volt7
      parameter data prototype Val: sw-calibration-access=READ-WRITE, type=Volt11
    Volt8
      parameter data prototype Val: sw-calibration-access=READ-WRITE, type=Volt12
    Volt9
      parameter data prototype Val: sw-calibration-access=READ-WRITE, type=Volt13
    VoltAry1D1
      parameter data prototype Ary1D: sw-calibration-access=READ-WRITE, type=VoltAry1D1
    VoltTi1
      parameter data prototype Val: sw-calibration-access=READ-WRITE, type=VoltTi2
package /Nexteer/CDD_NvMProxy_swc/Interfaces
  5 x client server interface, all with is-service=true:
    NvMAdministration
      operation SetBlockProtection: possible-error=NvMAdministration/E_NOT_OK
        arg ProtectionEnabled_Arg: type=Boolean, direction=IN, server-argument-impl-policy=USE-ARGUMENT-TYPE
      error E_NOT_OK: error-code=1
    NvMService_AC3_SRBS
      6 x operation, all with possible-error=NvMService_AC3_SRBS/E_NOT_OK:
        EraseBlock
        GetErrorStatus
          arg ErrorStatus_Arg: type=NvM_RequestResultType, direction=OUT, server-argument-impl-policy=USE-ARGUMENT-TYPE
        InvalidateNvBlock
        ReadBlock
          arg DstPtr_Arg: type=dtRef_VOID, direction=IN, server-argument-impl-policy=USE-ARGUMENT-TYPE
        SetRamBlockStatus
          arg RamBlockStatus_Arg: type=Boolean, direction=IN, server-argument-impl-policy=USE-ARGUMENT-TYPE
        WriteBlock
          arg SrcPtr_Arg: type=dtRef_const_VOID, direction=IN, server-argument-impl-policy=USE-ARGUMENT-TYPE
      error E_NOT_OK: error-code=1
    NvMService_AC3_SRBS_Defs
      7 x operation, all with possible-error=NvMService_AC3_SRBS_Defs/E_NOT_OK:
        EraseBlock
        GetErrorStatus
          arg ErrorStatus_Arg: type=NvM_RequestResultType, direction=OUT, server-argument-impl-policy=USE-ARGUMENT-TYPE
        InvalidateNvBlock
        ReadBlock
          arg DstPtr_Arg: type=dtRef_VOID, direction=IN, server-argument-impl-policy=USE-ARGUMENT-TYPE
        RestoreBlockDefaults
          arg DstPtr_Arg: type=dtRef_VOID, direction=IN, server-argument-impl-policy=USE-ARGUMENT-TYPE
        SetRamBlockStatus
          arg RamBlockStatus_Arg: type=Boolean, direction=IN, server-argument-impl-policy=USE-ARGUMENT-TYPE
        WriteBlock
          arg SrcPtr_Arg: type=dtRef_const_VOID, direction=IN, server-argument-impl-policy=USE-ARGUMENT-TYPE
      error E_NOT_OK: error-code=1
    NvMService_AC3_SRBS_DS
      8 x operation, all with possible-error=NvMService_AC3_SRBS_DS/E_NOT_OK:
        EraseBlock
        GetDataIndex
          arg DataIndex_Arg: type=UInt8, direction=OUT, server-argument-impl-policy=USE-ARGUMENT-TYPE
        GetErrorStatus
          arg ErrorStatus_Arg: type=NvM_RequestResultType, direction=OUT, server-argument-impl-policy=USE-ARGUMENT-TYPE
        InvalidateNvBlock
        ReadBlock
          arg DstPtr_Arg: type=dtRef_VOID, direction=IN, server-argument-impl-policy=USE-ARGUMENT-TYPE
        SetDataIndex
          arg DataIndex_Arg: type=UInt8, direction=IN, server-argument-impl-policy=USE-ARGUMENT-TYPE
        SetRamBlockStatus
          arg RamBlockStatus_Arg: type=Boolean, direction=IN, server-argument-impl-policy=USE-ARGUMENT-TYPE
        WriteBlock
          arg SrcPtr_Arg: type=dtRef_const_VOID, direction=IN, server-argument-impl-policy=USE-ARGUMENT-TYPE
      error E_NOT_OK: error-code=1
    NvMService_AC3_SRBS_DS_Defs
      9 x operation, all with possible-error=NvMService_AC3_SRBS_DS_Defs/E_NOT_OK:
        EraseBlock
        GetDataIndex
          arg DataIndex_Arg: type=UInt8, direction=OUT, server-argument-impl-policy=USE-ARGUMENT-TYPE
        GetErrorStatus
          arg ErrorStatus_Arg: type=NvM_RequestResultType, direction=OUT, server-argument-impl-policy=USE-ARGUMENT-TYPE
        InvalidateNvBlock
        ReadBlock
          arg DstPtr_Arg: type=dtRef_VOID, direction=IN, server-argument-impl-policy=USE-ARGUMENT-TYPE
        RestoreBlockDefaults
          arg DstPtr_Arg: type=dtRef_VOID, direction=IN, server-argument-impl-policy=USE-ARGUMENT-TYPE
        SetDataIndex
          arg DataIndex_Arg: type=UInt8, direction=IN, server-argument-impl-policy=USE-ARGUMENT-TYPE
        SetRamBlockStatus
          arg RamBlockStatus_Arg: type=Boolean, direction=IN, server-argument-impl-policy=USE-ARGUMENT-TYPE
        WriteBlock
          arg SrcPtr_Arg: type=dtRef_const_VOID, direction=IN, server-argument-impl-policy=USE-ARGUMENT-TYPE
      error E_NOT_OK: error-code=1
