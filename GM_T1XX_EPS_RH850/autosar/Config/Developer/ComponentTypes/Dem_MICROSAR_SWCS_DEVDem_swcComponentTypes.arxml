[part 3 of 3: package /MICROSAR_SWCS_DEV/Dem_swc/ComponentTypes]
AUTOSAR XML (schema 4-0-3)
package /MICROSAR_SWCS_DEV/Dem_swc/ComponentTypes  (continued)
  service sw component type Dem  (continued)
    behavior DemInternalBehavior: included-data-type-set=data-type=[Dem_DebounceResetStatusType, Dem_DebouncingStateType, Dem_DTCFormatType, Dem_DTCGroupType, Dem_DTCKindType, Dem_DTCStatusMaskType, Dem_EventIdType, Dem_EventStatusExtendedType, Dem_EventStatusType, Dem_IndicatorStatusType, Dem_InitMonitorReasonType, Dem_IumprDenomCondIdType, Dem_IumprDenomCondStatusType, Dem_MaxDataValueType, Dem_OperationCycleStateType, Dem_RatioIdType]  (continued)
      port-api-options:
        enable-take-address=true, indirect-api=false, port=CBReadData_BattVltgEcu
        enable-take-address=true, indirect-api=false, port=CBReadData_EcuIntT
        enable-take-address=true, indirect-api=false, port=CBReadData_EngSpd
        enable-take-address=true, indirect-api=false, port=CBReadData_EpdMotOvldProtnCntr
        enable-take-address=true, indirect-api=false, port=CBReadData_EpsAgOvrlSts
        enable-take-address=true, indirect-api=false, port=CBReadData_EpsApaAgOvrlReq
        enable-take-address=true, indirect-api=false, port=CBReadData_EpsMotCurr
        enable-take-address=true, indirect-api=false, port=CBReadData_EpsMotCurrFb
        enable-take-address=true, indirect-api=false, port=CBReadData_EpsStopStrtSts
        enable-take-address=true, indirect-api=false, port=CBReadData_EpsTqOvrlReq
        enable-take-address=true, indirect-api=false, port=CBReadData_EpsTqOvrlSts
        enable-take-address=true, indirect-api=false, port=CBReadData_IgnCycCntr
        enable-take-address=true, indirect-api=false, port=CBReadData_SplrIntDtcInfo
        enable-take-address=true, indirect-api=false, port=CBReadData_SteerInpTq
        enable-take-address=true, indirect-api=false, port=CBReadData_SteerOutpTq
        enable-take-address=true, indirect-api=false, port=CBReadData_SteerWhlAg
        enable-take-address=true, indirect-api=false, port=CBReadData_SysPwrMod
        enable-take-address=true, indirect-api=false, port=CBReadData_TiIgnOn
        enable-take-address=true, indirect-api=false, port=CBReadData_VehSpd
        enable-take-address=true, indirect-api=false, port=CBStatusDTC_1
        enable-take-address=true, indirect-api=false, port=Cdd
        enable-take-address=true, indirect-api=false, port=Dcm
        enable-take-address=true, indirect-api=false, port=DemServices
        {enable-take-address=true, indirect-api=false, port-defined-argument-value{value=EnableCond_DemEnableConditionA_0:2, value-type=uint8}, port=EnableCond_DemEnableConditionA}
        {enable-take-address=true, indirect-api=false, port-defined-argument-value{value=EnableCond_DemEnableConditionB_0:3, value-type=uint8}, port=EnableCond_DemEnableConditionB}
        {enable-take-address=true, indirect-api=false, port-defined-argument-value{value=EnableCond_DemEnableConditionC_0:4, value-type=uint8}, port=EnableCond_DemEnableConditionC}
        {enable-take-address=true, indirect-api=false, port-defined-argument-value{value=EnableCond_DemEnableConditionD_0:5, value-type=uint8}, port=EnableCond_DemEnableConditionD}
        {enable-take-address=true, indirect-api=false, port-defined-argument-value{value=EnableCond_DemEnableConditionE_0:6, value-type=uint8}, port=EnableCond_DemEnableConditionE}
        {enable-take-address=true, indirect-api=false, port-defined-argument-value{value=EnableCond_DemEnableConditionF_0:7, value-type=uint8}, port=EnableCond_DemEnableConditionF}
        {enable-take-address=true, indirect-api=false, port-defined-argument-value{value=EnableCond_DemEnableConditionG_0:8, value-type=uint8}, port=EnableCond_DemEnableConditionG}
        {enable-take-address=true, indirect-api=false, port-defined-argument-value{value=EnableCond_DemEnableConditionH_0:9, value-type=uint8}, port=EnableCond_DemEnableConditionH}
        {enable-take-address=true, indirect-api=false, port-defined-argument-value{value=EnableCond_DemEnableConditionI_0:10, value-type=uint8}, port=EnableCond_DemEnableConditionI}
        {enable-take-address=true, indirect-api=false, port-defined-argument-value{value=EnableCond_DemEnableConditionJ_0:11, value-type=uint8}, port=EnableCond_DemEnableConditionJ}
        {enable-take-address=true, indirect-api=false, port-defined-argument-value{value=EnableCond_DemEnableConditionK_0:1, value-type=uint8}, port=EnableCond_DemEnableConditionK}
        {enable-take-address=true, indirect-api=false, port-defined-argument-value{value=Event_CtrlrComChassisExpBusOff_0:3, value-type=Dem_EventIdType}, port=Event_CtrlrComChassisExpBusOff}
        {enable-take-address=true, indirect-api=false, port-defined-argument-value{value=Event_CtrlrComHiSpdBusOff_0:4, value-type=Dem_EventIdType}, port=Event_CtrlrComHiSpdBusOff}
        {enable-take-address=true, indirect-api=false, port-defined-argument-value{value=Event_DevPwrVltgOverMaxThd_0:5, value-type=Dem_EventIdType}, port=Event_DevPwrVltgOverMaxThd}
        {enable-take-address=true, indirect-api=false, port-defined-argument-value{value=Event_DevPwrVltgUnderMinThd_0:32, value-type=Dem_EventIdType}, port=Event_DevPwrVltgUnderMinThd}
        {enable-take-address=true, indirect-api=false, port-defined-argument-value{value=Event_DevPwrVltgUnderThd_0:6, value-type=Dem_EventIdType}, port=Event_DevPwrVltgUnderThd}
        {enable-take-address=true, indirect-api=false, port-defined-argument-value{value=Event_EcuHwPrfmc_0:7, value-type=Dem_EventIdType}, port=Event_EcuHwPrfmc}
        {enable-take-address=true, indirect-api=false, port-defined-argument-value{value=Event_EcuSwPrfmcCalDataSetNotProgd_0:8, value-type=Dem_EventIdType}, port=Event_EcuSwPrfmcCalDataSetNotProgd}
        {enable-take-address=true, indirect-api=false, port-defined-argument-value{value=Event_ElecSteerMotCirc_0:9, value-type=Dem_EventIdType}, port=Event_ElecSteerMotCirc}
        {enable-take-address=true, indirect-api=false, port-defined-argument-value{value=Event_ElecSteerMotPosSnsrCir_0:10, value-type=Dem_EventIdType}, port=Event_ElecSteerMotPosSnsrCir}
        {enable-take-address=true, indirect-api=false, port-defined-argument-value{value=Event_InvldDataRxdFromBodtCtrlMod_0:11, value-type=Dem_EventIdType}, port=Event_InvldDataRxdFromBodtCtrlMod}
        {enable-take-address=true, indirect-api=false, port-defined-argument-value{value=Event_InvldDataRxdFromElecBrkCtrlMod_0:12, value-type=Dem_EventIdType}, port=Event_InvldDataRxdFromElecBrkCtrlMod}
        {enable-take-address=true, indirect-api=false, port-defined-argument-value{value=Event_InvldDataRxdFromElecBrkCtrlModChassisExp_0:13, value-type=Dem_EventIdType}, port=Event_InvldDataRxdFromElecBrkCtrlModChassisExp}
        {enable-take-address=true, indirect-api=false, port-defined-argument-value{value=Event_InvldDataRxdFromEngCtrlMod_0:14, value-type=Dem_EventIdType}, port=Event_InvldDataRxdFromEngCtrlMod}
        {enable-take-address=true, indirect-api=false, port-defined-argument-value{value=Event_InvldDataRxdFromFrntCameraMod_0:15, value-type=Dem_EventIdType}, port=Event_InvldDataRxdFromFrntCameraMod}
        {enable-take-address=true, indirect-api=false, port-defined-argument-value{value=Event_InvldDataRxdFromParkAssiCtrlMod_0:16, value-type=Dem_EventIdType}, port=Event_InvldDataRxdFromParkAssiCtrlMod}
        {enable-take-address=true, indirect-api=false, port-defined-argument-value{value=Event_InvldDataRxdFromTrsmCtrlMod_0:17, value-type=Dem_EventIdType}, port=Event_InvldDataRxdFromTrsmCtrlMod}
        {enable-take-address=true, indirect-api=false, port-defined-argument-value{value=Event_LostComWithBodyCtrlMod_0:18, value-type=Dem_EventIdType}, port=Event_LostComWithBodyCtrlMod}
        {enable-take-address=true, indirect-api=false, port-defined-argument-value{value=Event_LostComWithElecBrkCtrlMod_0:19, value-type=Dem_EventIdType}, port=Event_LostComWithElecBrkCtrlMod}
        {enable-take-address=true, indirect-api=false, port-defined-argument-value{value=Event_LostComWithElecBrkCtrlModChassisExp_0:20, value-type=Dem_EventIdType}, port=Event_LostComWithElecBrkCtrlModChassisExp}
        {enable-take-address=true, indirect-api=false, port-defined-argument-value{value=Event_LostComWithEngCtrlMod_0:21, value-type=Dem_EventIdType}, port=Event_LostComWithEngCtrlMod}
        {enable-take-address=true, indirect-api=false, port-defined-argument-value{value=Event_LostComWithFrntCameraCtrlMod_0:22, value-type=Dem_EventIdType}, port=Event_LostComWithFrntCameraCtrlMod}
        {enable-take-address=true, indirect-api=false, port-defined-argument-value{value=Event_LostComWithParkAssiCtrlMod_0:23, value-type=Dem_EventIdType}, port=Event_LostComWithParkAssiCtrlMod}
        {enable-take-address=true, indirect-api=false, port-defined-argument-value{value=Event_LostComWithTrsmCtrlMod_0:24, value-type=Dem_EventIdType}, port=Event_LostComWithTrsmCtrlMod}
        {enable-take-address=true, indirect-api=false, port-defined-argument-value{value=Event_SteerFailrMtgtnLvl1LimpHomeMod_0:25, value-type=Dem_EventIdType}, port=Event_SteerFailrMtgtnLvl1LimpHomeMod}
        {enable-take-address=true, indirect-api=false, port-defined-argument-value{value=Event_SteerFailrMtgtnLvl2LimpOver_0:26, value-type=Dem_EventIdType}, port=Event_SteerFailrMtgtnLvl2LimpOver}
        {enable-take-address=true, indirect-api=false, port-defined-argument-value{value=Event_SteerFailrMtgtnLvl3FadeOut_0:27, value-type=Dem_EventIdType}, port=Event_SteerFailrMtgtnLvl3FadeOut}
        {enable-take-address=true, indirect-api=false, port-defined-argument-value{value=Event_SteerWheelAgSnsrCalNorPrfmd_0:1, value-type=Dem_EventIdType}, port=Event_SteerWheelAgSnsrCalNorPrfmd}
        {enable-take-address=true, indirect-api=false, port-defined-argument-value{value=Event_SteerWheelAgSnsrHwFlt_0:28, value-type=Dem_EventIdType}, port=Event_SteerWheelAgSnsrHwFlt}
        {enable-take-address=true, indirect-api=false, port-defined-argument-value{value=Event_SteerWheelAgSnsrPlausly_0:29, value-type=Dem_EventIdType}, port=Event_SteerWheelAgSnsrPlausly}
        {enable-take-address=true, indirect-api=false, port-defined-argument-value{value=Event_SteerWhlTqInpSnsr_0:30, value-type=Dem_EventIdType}, port=Event_SteerWhlTqInpSnsr}
        {enable-take-address=true, indirect-api=false, port-defined-argument-value{value=Event_SteerWhlTqInpSnsrCalNoLrnd_0:31, value-type=Dem_EventIdType}, port=Event_SteerWhlTqInpSnsrCalNoLrnd}
        {enable-take-address=true, indirect-api=false, port-defined-argument-value{value=Event_SysThermErrTHi_0:2, value-type=Dem_EventIdType}, port=Event_SysThermErrTHi}
        {enable-take-address=true, indirect-api=false, port-defined-argument-value{value=EvtInfo_CtrlrComChassisExpBusOff_0:3, value-type=Dem_EventIdType}, port=EvtInfo_CtrlrComChassisExpBusOff}
        {enable-take-address=true, indirect-api=false, port-defined-argument-value{value=EvtInfo_CtrlrComHiSpdBusOff_0:4, value-type=Dem_EventIdType}, port=EvtInfo_CtrlrComHiSpdBusOff}
        {enable-take-address=true, indirect-api=false, port-defined-argument-value{value=EvtInfo_DevPwrVltgOverMaxThd_0:5, value-type=Dem_EventIdType}, port=EvtInfo_DevPwrVltgOverMaxThd}
        {enable-take-address=true, indirect-api=false, port-defined-argument-value{value=EvtInfo_DevPwrVltgUnderMinThd_0:32, value-type=Dem_EventIdType}, port=EvtInfo_DevPwrVltgUnderMinThd}
        {enable-take-address=true, indirect-api=false, port-defined-argument-value{value=EvtInfo_DevPwrVltgUnderThd_0:6, value-type=Dem_EventIdType}, port=EvtInfo_DevPwrVltgUnderThd}
        {enable-take-address=true, indirect-api=false, port-defined-argument-value{value=EvtInfo_DIO_E_REG_WRITE_VERIFY_0:58, value-type=Dem_EventIdType}, port=EvtInfo_DIO_E_REG_WRITE_VERIFY}
        {enable-take-address=true, indirect-api=false, port-defined-argument-value{value=EvtInfo_EcuHwPrfmc_0:7, value-type=Dem_EventIdType}, port=EvtInfo_EcuHwPrfmc}
        {enable-take-address=true, indirect-api=false, port-defined-argument-value{value=EvtInfo_EcuSwPrfmcCalDataSetNotProgd_0:8, value-type=Dem_EventIdType}, port=EvtInfo_EcuSwPrfmcCalDataSetNotProgd}
        {enable-take-address=true, indirect-api=false, port-defined-argument-value{value=EvtInfo_ElecSteerMotCirc_0:9, value-type=Dem_EventIdType}, port=EvtInfo_ElecSteerMotCirc}
        {enable-take-address=true, indirect-api=false, port-defined-argument-value{value=EvtInfo_ElecSteerMotPosSnsrCir_0:10, value-type=Dem_EventIdType}, port=EvtInfo_ElecSteerMotPosSnsrCir}
        {enable-take-address=true, indirect-api=false, port-defined-argument-value{value=EvtInfo_FLS_E_COMPARE_FAILED_0:33, value-type=Dem_EventIdType}, port=EvtInfo_FLS_E_COMPARE_FAILED}
        {enable-take-address=true, indirect-api=false, port-defined-argument-value{value=EvtInfo_FLS_E_ERASE_FAILED_0:34, value-type=Dem_EventIdType}, port=EvtInfo_FLS_E_ERASE_FAILED}
        {enable-take-address=true, indirect-api=false, port-defined-argument-value{value=EvtInfo_FLS_E_READ_FAILED_0:35, value-type=Dem_EventIdType}, port=EvtInfo_FLS_E_READ_FAILED}
        {enable-take-address=true, indirect-api=false, port-defined-argument-value{value=EvtInfo_FLS_E_READ_FAILED_DED_0:36, value-type=Dem_EventIdType}, port=EvtInfo_FLS_E_READ_FAILED_DED}
        {enable-take-address=true, indirect-api=false, port-defined-argument-value{value=EvtInfo_FLS_E_WRITE_FAILED_0:37, value-type=Dem_EventIdType}, port=EvtInfo_FLS_E_WRITE_FAILED}
        {enable-take-address=true, indirect-api=false, port-defined-argument-value{value=EvtInfo_InvldDataRxdFromBodtCtrlMod_0:11, value-type=Dem_EventIdType}, port=EvtInfo_InvldDataRxdFromBodtCtrlMod}
        {enable-take-address=true, indirect-api=false, port-defined-argument-value{value=EvtInfo_InvldDataRxdFromElecBrkCtrlMod_0:12, value-type=Dem_EventIdType}, port=EvtInfo_InvldDataRxdFromElecBrkCtrlMod}
        {enable-take-address=true, indirect-api=false, port-defined-argument-value{value=EvtInfo_InvldDataRxdFromElecBrkCtrlModChassisExp_0:13, value-type=Dem_EventIdType}, port=EvtInfo_InvldDataRxdFromElecBrkCtrlModChassisExp}
        {enable-take-address=true, indirect-api=false, port-defined-argument-value{value=EvtInfo_InvldDataRxdFromEngCtrlMod_0:14, value-type=Dem_EventIdType}, port=EvtInfo_InvldDataRxdFromEngCtrlMod}
        {enable-take-address=true, indirect-api=false, port-defined-argument-value{value=EvtInfo_InvldDataRxdFromFrntCameraMod_0:15, value-type=Dem_EventIdType}, port=EvtInfo_InvldDataRxdFromFrntCameraMod}
        {enable-take-address=true, indirect-api=false, port-defined-argument-value{value=EvtInfo_InvldDataRxdFromParkAssiCtrlMod_0:16, value-type=Dem_EventIdType}, port=EvtInfo_InvldDataRxdFromParkAssiCtrlMod}
        {enable-take-address=true, indirect-api=false, port-defined-argument-value{value=EvtInfo_InvldDataRxdFromTrsmCtrlMod_0:17, value-type=Dem_EventIdType}, port=EvtInfo_InvldDataRxdFromTrsmCtrlMod}
        {enable-take-address=true, indirect-api=false, port-defined-argument-value{value=EvtInfo_LostComWithBodyCtrlMod_0:18, value-type=Dem_EventIdType}, port=EvtInfo_LostComWithBodyCtrlMod}
        {enable-take-address=true, indirect-api=false, port-defined-argument-value{value=EvtInfo_LostComWithElecBrkCtrlMod_0:19, value-type=Dem_EventIdType}, port=EvtInfo_LostComWithElecBrkCtrlMod}
        {enable-take-address=true, indirect-api=false, port-defined-argument-value{value=EvtInfo_LostComWithElecBrkCtrlModChassisExp_0:20, value-type=Dem_EventIdType}, port=EvtInfo_LostComWithElecBrkCtrlModChassisExp}
        {enable-take-address=true, indirect-api=false, port-defined-argument-value{value=EvtInfo_LostComWithEngCtrlMod_0:21, value-type=Dem_EventIdType}, port=EvtInfo_LostComWithEngCtrlMod}
        {enable-take-address=true, indirect-api=false, port-defined-argument-value{value=EvtInfo_LostComWithFrntCameraCtrlMod_0:22, value-type=Dem_EventIdType}, port=EvtInfo_LostComWithFrntCameraCtrlMod}
        {enable-take-address=true, indirect-api=false, port-defined-argument-value{value=EvtInfo_LostComWithParkAssiCtrlMod_0:23, value-type=Dem_EventIdType}, port=EvtInfo_LostComWithParkAssiCtrlMod}
        {enable-take-address=true, indirect-api=false, port-defined-argument-value{value=EvtInfo_LostComWithTrsmCtrlMod_0:24, value-type=Dem_EventIdType}, port=EvtInfo_LostComWithTrsmCtrlMod}
        {enable-take-address=true, indirect-api=false, port-defined-argument-value{value=EvtInfo_MCU_E_CLM_SELFDIAG_FAILURE_0:38, value-type=Dem_EventIdType}, port=EvtInfo_MCU_E_CLM_SELFDIAG_FAILURE}
        {enable-take-address=true, indirect-api=false, port-defined-argument-value{value=EvtInfo_MCU_E_CLOCK_FAILURE_0:39, value-type=Dem_EventIdType}, port=EvtInfo_MCU_E_CLOCK_FAILURE}
        {enable-take-address=true, indirect-api=false, port-defined-argument-value{value=EvtInfo_MCU_E_CVM_SELFDIAG_FAILURE_0:40, value-type=Dem_EventIdType}, port=EvtInfo_MCU_E_CVM_SELFDIAG_FAILURE}
        {enable-take-address=true, indirect-api=false, port-defined-argument-value{value=EvtInfo_MCU_E_ECM_SELFDIAG_FAILURE_0:56, value-type=Dem_EventIdType}, port=EvtInfo_MCU_E_ECM_SELFDIAG_FAILURE}
        {enable-take-address=true, indirect-api=false, port-defined-argument-value{value=EvtInfo_MCU_E_INT_INCONSISTENT_0:59, value-type=Dem_EventIdType}, port=EvtInfo_MCU_E_INT_INCONSISTENT}
        {enable-take-address=true, indirect-api=false, port-defined-argument-value{value=EvtInfo_MCU_E_LOCKSTEP_SELFDIAG_FAILURE_0:57, value-type=Dem_EventIdType}, port=EvtInfo_MCU_E_LOCKSTEP_SELFDIAG_FAILURE}
        {enable-take-address=true, indirect-api=false, port-defined-argument-value{value=EvtInfo_MCU_E_REG_WRITE_VERIFY_0:60, value-type=Dem_EventIdType}, port=EvtInfo_MCU_E_REG_WRITE_VERIFY}
        {enable-take-address=true, indirect-api=false, port-defined-argument-value{value=EvtInfo_MCU_E_WRITE_TIMEOUT_FAILURE_0:41, value-type=Dem_EventIdType}, port=EvtInfo_MCU_E_WRITE_TIMEOUT_FAILURE}
        {enable-take-address=true, indirect-api=false, port-defined-argument-value{value=EvtInfo_NVM_E_INTEGRITY_FAILED_0:42, value-type=Dem_EventIdType}, port=EvtInfo_NVM_E_INTEGRITY_FAILED}
        {enable-take-address=true, indirect-api=false, port-defined-argument-value{value=EvtInfo_NVM_E_LOSS_OF_REDUNDANCY_0:43, value-type=Dem_EventIdType}, port=EvtInfo_NVM_E_LOSS_OF_REDUNDANCY}
        {enable-take-address=true, indirect-api=false, port-defined-argument-value{value=EvtInfo_NVM_E_QUEUE_OVERFLOW_0:44, value-type=Dem_EventIdType}, port=EvtInfo_NVM_E_QUEUE_OVERFLOW}
        {enable-take-address=true, indirect-api=false, port-defined-argument-value{value=EvtInfo_NVM_E_REQ_FAILED_0:45, value-type=Dem_EventIdType}, port=EvtInfo_NVM_E_REQ_FAILED}
        {enable-take-address=true, indirect-api=false, port-defined-argument-value{value=EvtInfo_NVM_E_VERIFY_FAILED_0:46, value-type=Dem_EventIdType}, port=EvtInfo_NVM_E_VERIFY_FAILED}
        {enable-take-address=true, indirect-api=false, port-defined-argument-value{value=EvtInfo_NVM_E_WRITE_PROTECTED_0:47, value-type=Dem_EventIdType}, port=EvtInfo_NVM_E_WRITE_PROTECTED}
        {enable-take-address=true, indirect-api=false, port-defined-argument-value{value=EvtInfo_NVM_E_WRONG_BLOCK_ID_0:48, value-type=Dem_EventIdType}, port=EvtInfo_NVM_E_WRONG_BLOCK_ID}
        {enable-take-address=true, indirect-api=false, port-defined-argument-value{value=EvtInfo_PORT_E_REG_WRITE_VERIFY_0:61, value-type=Dem_EventIdType}, port=EvtInfo_PORT_E_REG_WRITE_VERIFY}
        {enable-take-address=true, indirect-api=false, port-defined-argument-value{value=EvtInfo_PORT_E_WRITE_TIMEOUT_FAILURE_0:49, value-type=Dem_EventIdType}, port=EvtInfo_PORT_E_WRITE_TIMEOUT_FAILURE}
        {enable-take-address=true, indirect-api=false, port-defined-argument-value{value=EvtInfo_SPI_E_DATA_TX_TIMEOUT_FAILURE_0:50, value-type=Dem_EventIdType}, port=EvtInfo_SPI_E_DATA_TX_TIMEOUT_FAILURE}
        {enable-take-address=true, indirect-api=false, port-defined-argument-value{value=EvtInfo_SPI_E_HARDWARE_ERROR_0:51, value-type=Dem_EventIdType}, port=EvtInfo_SPI_E_HARDWARE_ERROR}
        {enable-take-address=true, indirect-api=false, port-defined-argument-value{value=EvtInfo_SteerFailrMtgtnLvl1LimpHomeMod_0:25, value-type=Dem_EventIdType}, port=EvtInfo_SteerFailrMtgtnLvl1LimpHomeMod}
        {enable-take-address=true, indirect-api=false, port-defined-argument-value{value=EvtInfo_SteerFailrMtgtnLvl2LimpOver_0:26, value-type=Dem_EventIdType}, port=EvtInfo_SteerFailrMtgtnLvl2LimpOver}
        {enable-take-address=true, indirect-api=false, port-defined-argument-value{value=EvtInfo_SteerFailrMtgtnLvl3FadeOut_0:27, value-type=Dem_EventIdType}, port=EvtInfo_SteerFailrMtgtnLvl3FadeOut}
        {enable-take-address=true, indirect-api=false, port-defined-argument-value{value=EvtInfo_SteerWheelAgSnsrCalNorPrfmd_0:1, value-type=Dem_EventIdType}, port=EvtInfo_SteerWheelAgSnsrCalNorPrfmd}
        {enable-take-address=true, indirect-api=false, port-defined-argument-value{value=EvtInfo_SteerWheelAgSnsrHwFlt_0:28, value-type=Dem_EventIdType}, port=EvtInfo_SteerWheelAgSnsrHwFlt}
        {enable-take-address=true, indirect-api=false, port-defined-argument-value{value=EvtInfo_SteerWheelAgSnsrPlausly_0:29, value-type=Dem_EventIdType}, port=EvtInfo_SteerWheelAgSnsrPlausly}
        {enable-take-address=true, indirect-api=false, port-defined-argument-value{value=EvtInfo_SteerWhlTqInpSnsr_0:30, value-type=Dem_EventIdType}, port=EvtInfo_SteerWhlTqInpSnsr}
        {enable-take-address=true, indirect-api=false, port-defined-argument-value{value=EvtInfo_SteerWhlTqInpSnsrCalNoLrnd_0:31, value-type=Dem_EventIdType}, port=EvtInfo_SteerWhlTqInpSnsrCalNoLrnd}
        {enable-take-address=true, indirect-api=false, port-defined-argument-value{value=EvtInfo_SysThermErrTHi_0:2, value-type=Dem_EventIdType}, port=EvtInfo_SysThermErrTHi}
        {enable-take-address=true, indirect-api=false, port-defined-argument-value{value=EvtInfo_WDG_59_DRIVERA_E_INT_INCONSISTENT_0:62, value-type=Dem_EventIdType}, port=EvtInfo_WDG_59_DRIVERA_E_INT_INCONSISTENT}
        {enable-take-address=true, indirect-api=false, port-defined-argument-value{value=EvtInfo_WDG_E_DISABLE_REJECTED_0:52, value-type=Dem_EventIdType}, port=EvtInfo_WDG_E_DISABLE_REJECTED}
        {enable-take-address=true, indirect-api=false, port-defined-argument-value{value=EvtInfo_WDG_E_MODE_FAILED_0:53, value-type=Dem_EventIdType}, port=EvtInfo_WDG_E_MODE_FAILED}
        {enable-take-address=true, indirect-api=false, port-defined-argument-value{value=EvtInfo_WDG_E_READBACK_FAILURE_0:54, value-type=Dem_EventIdType}, port=EvtInfo_WDG_E_READBACK_FAILURE}
        {enable-take-address=true, indirect-api=false, port-defined-argument-value{value=EvtInfo_Wdg_E_REG_WRITE_VERIFY_0:63, value-type=Dem_EventIdType}, port=EvtInfo_Wdg_E_REG_WRITE_VERIFY}
        {enable-take-address=true, indirect-api=false, port-defined-argument-value{value=EvtInfo_WDG_E_TRIGGER_TIMEOUT_0:55, value-type=Dem_EventIdType}, port=EvtInfo_WDG_E_TRIGGER_TIMEOUT}
        enable-take-address=true, indirect-api=false, port=GeneralEventInfo
        {enable-take-address=true, indirect-api=false, port-defined-argument-value{value=IndStatus_PwrSteerIndcr_0:1, value-type=uint8}, port=IndStatus_PwrSteerIndcr}
        {enable-take-address=true, indirect-api=false, port-defined-argument-value{value=IndStatus_SteerAssiLimd_0:2, value-type=uint8}, port=IndStatus_SteerAssiLimd}
        {enable-take-address=true, indirect-api=false, port-defined-argument-value{value=IndStatus_SteerAssiLimdLvl2_0:3, value-type=uint8}, port=IndStatus_SteerAssiLimdLvl2}
        {enable-take-address=true, indirect-api=false, port-defined-argument-value{value=IndStatus_SteerAssiLimdLvl3_0:0, value-type=uint8}, port=IndStatus_SteerAssiLimdLvl3}
        {enable-take-address=true, indirect-api=false, port-defined-argument-value{value=OpCycle_PowerCycle_0:0, value-type=Dem_OperationCycleIdType}, port=OpCycle_PowerCycle}
        {enable-take-address=true, indirect-api=false, port-defined-argument-value{value=OverflowIndPrimaryMemory_0:1, value-type=Dem_DTCOriginType}, port=OverflowIndPrimaryMemory}
      26 x runnable:
        ClearDTC: can-be-invoked-concurrently=true, symbol=Dem_ClearDTC
        DcmClearDTC: can-be-invoked-concurrently=true, symbol=Dem_DcmClearDTC
        DcmEnableDTCSetting: can-be-invoked-concurrently=true, symbol=Dem_DcmEnableDTCSetting
        DcmGetExtendedDataRecordByDTC: can-be-invoked-concurrently=true, symbol=Dem_DcmGetExtendedDataRecordByDTC
        DcmGetFreezeFrameDataByDTC: can-be-invoked-concurrently=true, symbol=Dem_DcmGetFreezeFrameDataByDTC
        DcmGetNextFilteredDTCAndFDC: can-be-invoked-concurrently=true, symbol=Dem_DcmGetNextFilteredDTCAndFDC
        Dem_MainFunction
          20 x sync call, all with timeout=0:
            OpServerCallDem_MainFunction_DTCStatusChanged_CBStatusDTC_1: operation=CBStatusDTC_1.DTCStatusChanged
            OpServerCallDem_MainFunction_ReadData_CBReadData_BattVltgEcu: operation=CBReadData_BattVltgEcu.ReadData
            OpServerCallDem_MainFunction_ReadData_CBReadData_EcuIntT: operation=CBReadData_EcuIntT.ReadData
            OpServerCallDem_MainFunction_ReadData_CBReadData_EngSpd: operation=CBReadData_EngSpd.ReadData
            OpServerCallDem_MainFunction_ReadData_CBReadData_EpdMotOvldProtnCntr: operation=CBReadData_EpdMotOvldProtnCntr.ReadData
            OpServerCallDem_MainFunction_ReadData_CBReadData_EpsAgOvrlSts: operation=CBReadData_EpsAgOvrlSts.ReadData
            OpServerCallDem_MainFunction_ReadData_CBReadData_EpsApaAgOvrlReq: operation=CBReadData_EpsApaAgOvrlReq.ReadData
            OpServerCallDem_MainFunction_ReadData_CBReadData_EpsMotCurr: operation=CBReadData_EpsMotCurr.ReadData
            OpServerCallDem_MainFunction_ReadData_CBReadData_EpsMotCurrFb: operation=CBReadData_EpsMotCurrFb.ReadData
            OpServerCallDem_MainFunction_ReadData_CBReadData_EpsStopStrtSts: operation=CBReadData_EpsStopStrtSts.ReadData
            OpServerCallDem_MainFunction_ReadData_CBReadData_EpsTqOvrlReq: operation=CBReadData_EpsTqOvrlReq.ReadData
            OpServerCallDem_MainFunction_ReadData_CBReadData_EpsTqOvrlSts: operation=CBReadData_EpsTqOvrlSts.ReadData
            OpServerCallDem_MainFunction_ReadData_CBReadData_IgnCycCntr: operation=CBReadData_IgnCycCntr.ReadData
            OpServerCallDem_MainFunction_ReadData_CBReadData_SplrIntDtcInfo: operation=CBReadData_SplrIntDtcInfo.ReadData
            OpServerCallDem_MainFunction_ReadData_CBReadData_SteerInpTq: operation=CBReadData_SteerInpTq.ReadData
            OpServerCallDem_MainFunction_ReadData_CBReadData_SteerOutpTq: operation=CBReadData_SteerOutpTq.ReadData
            OpServerCallDem_MainFunction_ReadData_CBReadData_SteerWhlAg: operation=CBReadData_SteerWhlAg.ReadData
            OpServerCallDem_MainFunction_ReadData_CBReadData_SysPwrMod: operation=CBReadData_SysPwrMod.ReadData
            OpServerCallDem_MainFunction_ReadData_CBReadData_TiIgnOn: operation=CBReadData_TiIgnOn.ReadData
            OpServerCallDem_MainFunction_ReadData_CBReadData_VehSpd: operation=CBReadData_VehSpd.ReadData
        GetDebouncingOfEvent: can-be-invoked-concurrently=true, symbol=Dem_GetDebouncingOfEvent
        GetDTCOfEvent: can-be-invoked-concurrently=true, symbol=Dem_GetDTCOfEvent
        GetDTCStatusAvailabilityMask: can-be-invoked-concurrently=true, symbol=Dem_DcmGetDTCStatusAvailabilityMask
        GetEventEnableCondition: can-be-invoked-concurrently=true, symbol=Dem_GetEventEnableCondition
        GetEventExtendedDataRecord: can-be-invoked-concurrently=true, symbol=Dem_GetEventExtendedDataRecord
        GetEventFailed: can-be-invoked-concurrently=true, symbol=Dem_GetEventFailed
        GetEventFreezeFrameData: can-be-invoked-concurrently=true, symbol=Dem_GetEventFreezeFrameData
        GetEventMemoryOverflow: can-be-invoked-concurrently=true, symbol=Dem_GetEventMemoryOverflow
        GetEventStatus: can-be-invoked-concurrently=true, symbol=Dem_GetEventStatus
        GetEventTested: can-be-invoked-concurrently=true, symbol=Dem_GetEventTested
        GetFaultDetectionCounter: can-be-invoked-concurrently=true, symbol=Dem_GetFaultDetectionCounter
        GetIndicatorStatus: can-be-invoked-concurrently=true, symbol=Dem_GetIndicatorStatus
        GetNumberOfEventMemoryEntries: can-be-invoked-concurrently=true, symbol=Dem_GetNumberOfEventMemoryEntries
        PostRunRequested: can-be-invoked-concurrently=true, symbol=Dem_PostRunRequested
        ResetEventDebounceStatus: can-be-invoked-concurrently=true, symbol=Dem_ResetEventDebounceStatus
        ResetEventStatus: can-be-invoked-concurrently=true, symbol=Dem_ResetEventStatus
          sync call OpServerCallResetEventStatus_DTCStatusChanged_CBStatusDTC_1: operation=CBStatusDTC_1.DTCStatusChanged, timeout=0
        SetEnableCondition: can-be-invoked-concurrently=true, symbol=Dem_SetEnableCondition
        SetEventStatus: can-be-invoked-concurrently=true, symbol=Dem_SetEventStatus
          sync call OpServerCallSetEventStatus_DTCStatusChanged_CBStatusDTC_1: operation=CBStatusDTC_1.DTCStatusChanged, timeout=0
        SetOperationCycleState: can-be-invoked-concurrently=true, symbol=Dem_SetOperationCycleState
  swc implementation DemImplementation: behavior=DemInternalBehavior
    code-descriptors:
      code Default: artifact-descriptors=autosar-engineering-object={short-label=Default, category=SWSRC}
