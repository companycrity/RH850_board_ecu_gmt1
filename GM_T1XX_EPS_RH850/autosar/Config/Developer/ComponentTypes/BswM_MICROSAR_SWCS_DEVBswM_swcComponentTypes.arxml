AUTOSAR XML (schema 4-0-3)
package /MICROSAR_SWCS_DEV/BswM_swc/ComponentTypes
  service sw component type BswM
    behavior BswMInternalBehavior: data-type-mapping=BswMMappingSet
      timing event Timer_BswM_MainFunction: start-on-event=BswM_MainFunction, period=0.01
      runnable BswM_MainFunction
  swc implementation BswMImplementation: behavior=BswMInternalBehavior
    code-descriptors:
      code Default: artifact-descriptors=autosar-engineering-object={short-label=Default, category=SWSRC}
