AUTOSAR XML (schema 4-0-3)
package /ComponentTypes
  parameter sw component type CalRegn02Inin00GroupA
    provide port GmOvrlStMgrLkaHwTqTiThd1: parameter-provide-com-spec{init-value=10000, parameter=Val}, provided-interface=uint32_CalPortIf1
