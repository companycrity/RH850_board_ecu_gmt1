[part 3 of 3: package /Nexteer/NvMProxy_swc/ComponentTypes]
AUTOSAR XML (schema 4-1-2)
package /Nexteer/NvMProxy_swc/ComponentTypes  (continued)
  service sw component type NvMProxy  (continued)
    behavior NvMProxyInternalBehavior  (continued)
      port-api-options:
        {enable-take-address=true, indirect-api=false, port-defined-argument-value{value=PAdminProxy_CurrMeasMotEol_Deprecated_0:2, value-type=NvM_BlockIdType}, port=PAdminProxy_CurrMeasMotEol_Deprecated}
        {enable-take-address=false, indirect-api=false, port-defined-argument-value{value=PSProxy_CurrMeasMotEol_Deprecated_0:2, value-type=NvM_BlockIdType}, port=PSProxy_CurrMeasMotEol_Deprecated}
        {enable-take-address=true, indirect-api=false, port-defined-argument-value{value=PAdminProxy_PolarityCfgSaved_0:117, value-type=NvM_BlockIdType}, port=PAdminProxy_PolarityCfgSaved}
        {enable-take-address=false, indirect-api=false, port-defined-argument-value{value=PSProxy_PolarityCfgSaved_0:117, value-type=NvM_BlockIdType}, port=PSProxy_PolarityCfgSaved}
        {enable-take-address=true, indirect-api=false, port-defined-argument-value{value=PAdminProxy_Rte_NvmBlock_CDD_MotAg0Meas_MotAg0CoeffTbl_0:116, value-type=NvM_BlockIdType}, port=PAdminProxy_Rte_NvmBlock_CDD_MotAg0Meas_MotAg0CoeffTbl}
        {enable-take-address=false, indirect-api=false, port-defined-argument-value{value=PSProxy_Rte_NvmBlock_CDD_MotAg0Meas_MotAg0CoeffTbl_0:116, value-type=NvM_BlockIdType}, port=PSProxy_Rte_NvmBlock_CDD_MotAg0Meas_MotAg0CoeffTbl}
        {enable-take-address=true, indirect-api=false, port-defined-argument-value{value=PAdminProxy_Rte_NvmBlock_CDD_MotAgCmp_MotAgCmpMotAgBackEmf_0:115, value-type=NvM_BlockIdType}, port=PAdminProxy_Rte_NvmBlock_CDD_MotAgCmp_MotAgCmpMotAgBackEmf}
        {enable-take-address=false, indirect-api=false, port-defined-argument-value{value=PSProxy_Rte_NvmBlock_CDD_MotAgCmp_MotAgCmpMotAgBackEmf_0:115, value-type=NvM_BlockIdType}, port=PSProxy_Rte_NvmBlock_CDD_MotAgCmp_MotAgCmpMotAgBackEmf}
        {enable-take-address=true, indirect-api=false, port-defined-argument-value{value=PAdminProxy_MotPrmNom_0:114, value-type=NvM_BlockIdType}, port=PAdminProxy_MotPrmNom}
        {enable-take-address=false, indirect-api=false, port-defined-argument-value{value=PSProxy_MotPrmNom_0:114, value-type=NvM_BlockIdType}, port=PSProxy_MotPrmNom}
        {enable-take-address=true, indirect-api=false, port-defined-argument-value{value=PAdminProxy_Rte_NvmBlock_CmnMfgSrv_NxtrMfgEnaCntr_0:112, value-type=NvM_BlockIdType}, port=PAdminProxy_Rte_NvmBlock_CmnMfgSrv_NxtrMfgEnaCntr}
        {enable-take-address=false, indirect-api=false, port-defined-argument-value{value=PSProxy_Rte_NvmBlock_CmnMfgSrv_NxtrMfgEnaCntr_0:112, value-type=NvM_BlockIdType}, port=PSProxy_Rte_NvmBlock_CmnMfgSrv_NxtrMfgEnaCntr}
        {enable-take-address=true, indirect-api=false, port-defined-argument-value{value=PAdminProxy_Rte_NvmBlock_CmnMfgSrv_IgnCntr_0:113, value-type=NvM_BlockIdType}, port=PAdminProxy_Rte_NvmBlock_CmnMfgSrv_IgnCntr}
        {enable-take-address=false, indirect-api=false, port-defined-argument-value{value=PSProxy_Rte_NvmBlock_CmnMfgSrv_IgnCntr_0:113, value-type=NvM_BlockIdType}, port=PSProxy_Rte_NvmBlock_CmnMfgSrv_IgnCntr}
        {enable-take-address=true, indirect-api=false, port-defined-argument-value{value=PAdminProxy_Rte_NvmBlock_CDD_MotAg1Meas_MotAg1CoeffTbl_0:111, value-type=NvM_BlockIdType}, port=PAdminProxy_Rte_NvmBlock_CDD_MotAg1Meas_MotAg1CoeffTbl}
        {enable-take-address=false, indirect-api=false, port-defined-argument-value{value=PSProxy_Rte_NvmBlock_CDD_MotAg1Meas_MotAg1CoeffTbl_0:111, value-type=NvM_BlockIdType}, port=PSProxy_Rte_NvmBlock_CDD_MotAg1Meas_MotAg1CoeffTbl}
        {enable-take-address=true, indirect-api=false, port-defined-argument-value{value=PAdminProxy_Rte_NvmBlock_HwAg0Meas_HwAg0Offs_0:110, value-type=NvM_BlockIdType}, port=PAdminProxy_Rte_NvmBlock_HwAg0Meas_HwAg0Offs}
        {enable-take-address=false, indirect-api=false, port-defined-argument-value{value=PSProxy_Rte_NvmBlock_HwAg0Meas_HwAg0Offs_0:110, value-type=NvM_BlockIdType}, port=PSProxy_Rte_NvmBlock_HwAg0Meas_HwAg0Offs}
        {enable-take-address=true, indirect-api=false, port-defined-argument-value{value=PAdminProxy_Rte_NvmBlock_NvMProxy_ShtdwnClsChk_0:109, value-type=NvM_BlockIdType}, port=PAdminProxy_Rte_NvmBlock_NvMProxy_ShtdwnClsChk}
        {enable-take-address=false, indirect-api=false, port-defined-argument-value{value=PSProxy_Rte_NvmBlock_NvMProxy_ShtdwnClsChk_0:109, value-type=NvM_BlockIdType}, port=PSProxy_Rte_NvmBlock_NvMProxy_ShtdwnClsChk}
        {enable-take-address=true, indirect-api=false, port-defined-argument-value{value=PAdminProxy_Rte_NvmBlock_HwAg1Meas_HwAg1Offs_0:108, value-type=NvM_BlockIdType}, port=PAdminProxy_Rte_NvmBlock_HwAg1Meas_HwAg1Offs}
        {enable-take-address=false, indirect-api=false, port-defined-argument-value{value=PSProxy_Rte_NvmBlock_HwAg1Meas_HwAg1Offs_0:108, value-type=NvM_BlockIdType}, port=PSProxy_Rte_NvmBlock_HwAg1Meas_HwAg1Offs}
        {enable-take-address=true, indirect-api=false, port-defined-argument-value{value=PAdminProxy_Rte_NvmBlock_HwTqCorrln_HwTqChACmnModCmpLpFilSt_0:106, value-type=NvM_BlockIdType}, port=PAdminProxy_Rte_NvmBlock_HwTqCorrln_HwTqChACmnModCmpLpFilSt}
        {enable-take-address=false, indirect-api=false, port-defined-argument-value{value=PSProxy_Rte_NvmBlock_HwTqCorrln_HwTqChACmnModCmpLpFilSt_0:106, value-type=NvM_BlockIdType}, port=PSProxy_Rte_NvmBlock_HwTqCorrln_HwTqChACmnModCmpLpFilSt}
        {enable-take-address=true, indirect-api=false, port-defined-argument-value{value=PAdminProxy_Rte_NvmBlock_HwTqCorrln_HwTqChBCmnModCmpLpFilSt_0:107, value-type=NvM_BlockIdType}, port=PAdminProxy_Rte_NvmBlock_HwTqCorrln_HwTqChBCmnModCmpLpFilSt}
        {enable-take-address=false, indirect-api=false, port-defined-argument-value{value=PSProxy_Rte_NvmBlock_HwTqCorrln_HwTqChBCmnModCmpLpFilSt_0:107, value-type=NvM_BlockIdType}, port=PSProxy_Rte_NvmBlock_HwTqCorrln_HwTqChBCmnModCmpLpFilSt}
        {enable-take-address=true, indirect-api=false, port-defined-argument-value{value=PAdminProxy_Rte_NvmBlock_CDD_HwTq1Meas_HwTq1Offs_0:103, value-type=NvM_BlockIdType}, port=PAdminProxy_Rte_NvmBlock_CDD_HwTq1Meas_HwTq1Offs}
        {enable-take-address=false, indirect-api=false, port-defined-argument-value{value=PSProxy_Rte_NvmBlock_CDD_HwTq1Meas_HwTq1Offs_0:103, value-type=NvM_BlockIdType}, port=PSProxy_Rte_NvmBlock_CDD_HwTq1Meas_HwTq1Offs}
        {enable-take-address=true, indirect-api=false, port-defined-argument-value{value=PAdminProxy_Rte_NvmBlock_CDD_HwTq3Meas_HwTq3Offs_0:104, value-type=NvM_BlockIdType}, port=PAdminProxy_Rte_NvmBlock_CDD_HwTq3Meas_HwTq3Offs}
        {enable-take-address=false, indirect-api=false, port-defined-argument-value{value=PSProxy_Rte_NvmBlock_CDD_HwTq3Meas_HwTq3Offs_0:104, value-type=NvM_BlockIdType}, port=PSProxy_Rte_NvmBlock_CDD_HwTq3Meas_HwTq3Offs}
        {enable-take-address=true, indirect-api=false, port-defined-argument-value{value=PAdminProxy_Rte_NvmBlock_CDD_HwTq2Meas_HwTq2Offs_0:105, value-type=NvM_BlockIdType}, port=PAdminProxy_Rte_NvmBlock_CDD_HwTq2Meas_HwTq2Offs}
        {enable-take-address=false, indirect-api=false, port-defined-argument-value{value=PSProxy_Rte_NvmBlock_CDD_HwTq2Meas_HwTq2Offs_0:105, value-type=NvM_BlockIdType}, port=PSProxy_Rte_NvmBlock_CDD_HwTq2Meas_HwTq2Offs}
        {enable-take-address=true, indirect-api=false, port-defined-argument-value{value=PAdminProxy_Rte_NvmBlock_CDD_HwTq0Meas_HwTq0Offs_0:102, value-type=NvM_BlockIdType}, port=PAdminProxy_Rte_NvmBlock_CDD_HwTq0Meas_HwTq0Offs}
        {enable-take-address=false, indirect-api=false, port-defined-argument-value{value=PSProxy_Rte_NvmBlock_CDD_HwTq0Meas_HwTq0Offs_0:102, value-type=NvM_BlockIdType}, port=PSProxy_Rte_NvmBlock_CDD_HwTq0Meas_HwTq0Offs}
        {enable-take-address=true, indirect-api=false, port-defined-argument-value{value=PAdminProxy_Rte_NvmBlock_MotAg2Meas_MotAg2EolPrm_0:101, value-type=NvM_BlockIdType}, port=PAdminProxy_Rte_NvmBlock_MotAg2Meas_MotAg2EolPrm}
        {enable-take-address=false, indirect-api=false, port-defined-argument-value{value=PSProxy_Rte_NvmBlock_MotAg2Meas_MotAg2EolPrm_0:101, value-type=NvM_BlockIdType}, port=PSProxy_Rte_NvmBlock_MotAg2Meas_MotAg2EolPrm}
        {enable-take-address=true, indirect-api=false, port-defined-argument-value{value=PAdminProxy_Rte_NvmBlock_DiagcMgr_DiagcMgrNtcFltAry_0:100, value-type=NvM_BlockIdType}, port=PAdminProxy_Rte_NvmBlock_DiagcMgr_DiagcMgrNtcFltAry}
        {enable-take-address=false, indirect-api=false, port-defined-argument-value{value=PSProxy_Rte_NvmBlock_DiagcMgr_DiagcMgrNtcFltAry_0:100, value-type=NvM_BlockIdType}, port=PSProxy_Rte_NvmBlock_DiagcMgr_DiagcMgrNtcFltAry}
        {enable-take-address=true, indirect-api=false, port-defined-argument-value{value=PAdminProxy_Rte_NvmBlock_EotLrng_EotNvmData_0:99, value-type=NvM_BlockIdType}, port=PAdminProxy_Rte_NvmBlock_EotLrng_EotNvmData}
        {enable-take-address=false, indirect-api=false, port-defined-argument-value{value=PSProxy_Rte_NvmBlock_EotLrng_EotNvmData_0:99, value-type=NvM_BlockIdType}, port=PSProxy_Rte_NvmBlock_EotLrng_EotNvmData}
        {enable-take-address=true, indirect-api=false, port-defined-argument-value{value=PAdminProxy_Rte_NvmBlock_CDD_CurrMeas_CurrMeasEolOffsCalSet_0:98, value-type=NvM_BlockIdType}, port=PAdminProxy_Rte_NvmBlock_CDD_CurrMeas_CurrMeasEolOffsCalSet}
        {enable-take-address=false, indirect-api=false, port-defined-argument-value{value=PSProxy_Rte_NvmBlock_CDD_CurrMeas_CurrMeasEolOffsCalSet_0:98, value-type=NvM_BlockIdType}, port=PSProxy_Rte_NvmBlock_CDD_CurrMeas_CurrMeasEolOffsCalSet}
        {enable-take-address=true, indirect-api=false, port-defined-argument-value{value=PAdminProxy_Rte_NvmBlock_CDD_CurrMeas_CurrMeasEolGainCalSet_0:97, value-type=NvM_BlockIdType}, port=PAdminProxy_Rte_NvmBlock_CDD_CurrMeas_CurrMeasEolGainCalSet}
        {enable-take-address=false, indirect-api=false, port-defined-argument-value{value=PSProxy_Rte_NvmBlock_CDD_CurrMeas_CurrMeasEolGainCalSet_0:97, value-type=NvM_BlockIdType}, port=PSProxy_Rte_NvmBlock_CDD_CurrMeas_CurrMeasEolGainCalSet}
        {enable-take-address=true, indirect-api=false, port-defined-argument-value{value=PAdminProxy_Rte_NvmBlock_PartNr_PartNrRepairShopCod_0:83, value-type=NvM_BlockIdType}, port=PAdminProxy_Rte_NvmBlock_PartNr_PartNrRepairShopCod}
        {enable-take-address=false, indirect-api=false, port-defined-argument-value{value=PSProxy_Rte_NvmBlock_PartNr_PartNrRepairShopCod_0:83, value-type=NvM_BlockIdType}, port=PSProxy_Rte_NvmBlock_PartNr_PartNrRepairShopCod}
        {enable-take-address=true, indirect-api=false, port-defined-argument-value{value=PAdminProxy_Rte_NvmBlock_PartNr_PartNrSysName_0:84, value-type=NvM_BlockIdType}, port=PAdminProxy_Rte_NvmBlock_PartNr_PartNrSysName}
        {enable-take-address=false, indirect-api=false, port-defined-argument-value{value=PSProxy_Rte_NvmBlock_PartNr_PartNrSysName_0:84, value-type=NvM_BlockIdType}, port=PSProxy_Rte_NvmBlock_PartNr_PartNrSysName}
        {enable-take-address=true, indirect-api=false, port-defined-argument-value{value=PAdminProxy_Rte_NvmBlock_PartNr_PartNrCcaMfgTrakg_0:85, value-type=NvM_BlockIdType}, port=PAdminProxy_Rte_NvmBlock_PartNr_PartNrCcaMfgTrakg}
        {enable-take-address=false, indirect-api=false, port-defined-argument-value{value=PSProxy_Rte_NvmBlock_PartNr_PartNrCcaMfgTrakg_0:85, value-type=NvM_BlockIdType}, port=PSProxy_Rte_NvmBlock_PartNr_PartNrCcaMfgTrakg}
        {enable-take-address=true, indirect-api=false, port-defined-argument-value{value=PAdminProxy_Rte_NvmBlock_PartNr_PartNrSysCodVersNr_0:86, value-type=NvM_BlockIdType}, port=PAdminProxy_Rte_NvmBlock_PartNr_PartNrSysCodVersNr}
        {enable-take-address=false, indirect-api=false, port-defined-argument-value{value=PSProxy_Rte_NvmBlock_PartNr_PartNrSysCodVersNr_0:86, value-type=NvM_BlockIdType}, port=PSProxy_Rte_NvmBlock_PartNr_PartNrSysCodVersNr}
        {enable-take-address=true, indirect-api=false, port-defined-argument-value{value=PAdminProxy_Rte_NvmBlock_PartNr_PartNrNxtrMfgTrakg_0:87, value-type=NvM_BlockIdType}, port=PAdminProxy_Rte_NvmBlock_PartNr_PartNrNxtrMfgTrakg}
        {enable-take-address=false, indirect-api=false, port-defined-argument-value{value=PSProxy_Rte_NvmBlock_PartNr_PartNrNxtrMfgTrakg_0:87, value-type=NvM_BlockIdType}, port=PSProxy_Rte_NvmBlock_PartNr_PartNrNxtrMfgTrakg}
        {enable-take-address=true, indirect-api=false, port-defined-argument-value{value=PAdminProxy_Rte_NvmBlock_PartNr_PartNrEndMdlPartNr_0:88, value-type=NvM_BlockIdType}, port=PAdminProxy_Rte_NvmBlock_PartNr_PartNrEndMdlPartNr}
        {enable-take-address=false, indirect-api=false, port-defined-argument-value{value=PSProxy_Rte_NvmBlock_PartNr_PartNrEndMdlPartNr_0:88, value-type=NvM_BlockIdType}, port=PSProxy_Rte_NvmBlock_PartNr_PartNrEndMdlPartNr}
        {enable-take-address=true, indirect-api=false, port-defined-argument-value{value=PAdminProxy_Rte_NvmBlock_PartNr_PartNrBasMdlPartNr_0:89, value-type=NvM_BlockIdType}, port=PAdminProxy_Rte_NvmBlock_PartNr_PartNrBasMdlPartNr}
        {enable-take-address=false, indirect-api=false, port-defined-argument-value{value=PSProxy_Rte_NvmBlock_PartNr_PartNrBasMdlPartNr_0:89, value-type=NvM_BlockIdType}, port=PSProxy_Rte_NvmBlock_PartNr_PartNrBasMdlPartNr}
        {enable-take-address=true, indirect-api=false, port-defined-argument-value{value=PAdminProxy_Rte_NvmBlock_PartNr_PartNrCtrlPidSeedKey_0:90, value-type=NvM_BlockIdType}, port=PAdminProxy_Rte_NvmBlock_PartNr_PartNrCtrlPidSeedKey}
        {enable-take-address=false, indirect-api=false, port-defined-argument-value{value=PSProxy_Rte_NvmBlock_PartNr_PartNrCtrlPidSeedKey_0:90, value-type=NvM_BlockIdType}, port=PSProxy_Rte_NvmBlock_PartNr_PartNrCtrlPidSeedKey}
        {enable-take-address=true, indirect-api=false, port-defined-argument-value{value=PAdminProxy_Rte_NvmBlock_PartNr_PartNrVinData_0:91, value-type=NvM_BlockIdType}, port=PAdminProxy_Rte_NvmBlock_PartNr_PartNrVinData}
        {enable-take-address=false, indirect-api=false, port-defined-argument-value{value=PSProxy_Rte_NvmBlock_PartNr_PartNrVinData_0:91, value-type=NvM_BlockIdType}, port=PSProxy_Rte_NvmBlock_PartNr_PartNrVinData}
        {enable-take-address=true, indirect-api=false, port-defined-argument-value{value=PAdminProxy_Rte_NvmBlock_PartNr_PartNrProgmDate_0:92, value-type=NvM_BlockIdType}, port=PAdminProxy_Rte_NvmBlock_PartNr_PartNrProgmDate}
        {enable-take-address=false, indirect-api=false, port-defined-argument-value{value=PSProxy_Rte_NvmBlock_PartNr_PartNrProgmDate_0:92, value-type=NvM_BlockIdType}, port=PSProxy_Rte_NvmBlock_PartNr_PartNrProgmDate}
        {enable-take-address=true, indirect-api=false, port-defined-argument-value{value=PAdminProxy_Rte_NvmBlock_PartNr_PartNrDataUniversalNrSysId_0:93, value-type=NvM_BlockIdType}, port=PAdminProxy_Rte_NvmBlock_PartNr_PartNrDataUniversalNrSysId}
        {enable-take-address=false, indirect-api=false, port-defined-argument-value{value=PSProxy_Rte_NvmBlock_PartNr_PartNrDataUniversalNrSysId_0:93, value-type=NvM_BlockIdType}, port=PSProxy_Rte_NvmBlock_PartNr_PartNrDataUniversalNrSysId}
        {enable-take-address=true, indirect-api=false, port-defined-argument-value{value=PAdminProxy_Rte_NvmBlock_PartNr_PartNrCalProgdSts_0:94, value-type=NvM_BlockIdType}, port=PAdminProxy_Rte_NvmBlock_PartNr_PartNrCalProgdSts}
        {enable-take-address=false, indirect-api=false, port-defined-argument-value{value=PSProxy_Rte_NvmBlock_PartNr_PartNrCalProgdSts_0:94, value-type=NvM_BlockIdType}, port=PSProxy_Rte_NvmBlock_PartNr_PartNrCalProgdSts}
        {enable-take-address=true, indirect-api=false, port-defined-argument-value{value=PAdminProxy_Rte_NvmBlock_PartNr_PartNrCustMfgEnaCntr_0:95, value-type=NvM_BlockIdType}, port=PAdminProxy_Rte_NvmBlock_PartNr_PartNrCustMfgEnaCntr}
        {enable-take-address=false, indirect-api=false, port-defined-argument-value{value=PSProxy_Rte_NvmBlock_PartNr_PartNrCustMfgEnaCntr_0:95, value-type=NvM_BlockIdType}, port=PSProxy_Rte_NvmBlock_PartNr_PartNrCustMfgEnaCntr}
        {enable-take-address=true, indirect-api=false, port-defined-argument-value{value=PAdminProxy_Rte_NvmBlock_PartNr_PartNrProgmSessionSeedKey_0:96, value-type=NvM_BlockIdType}, port=PAdminProxy_Rte_NvmBlock_PartNr_PartNrProgmSessionSeedKey}
        {enable-take-address=false, indirect-api=false, port-defined-argument-value{value=PSProxy_Rte_NvmBlock_PartNr_PartNrProgmSessionSeedKey_0:96, value-type=NvM_BlockIdType}, port=PSProxy_Rte_NvmBlock_PartNr_PartNrProgmSessionSeedKey}
        {enable-take-address=true, indirect-api=false, port-defined-argument-value{value=PAdminProxy_Rte_NvmBlock_CmnMfgSrv_MfgTmpBuf4_0:74, value-type=NvM_BlockIdType}, port=PAdminProxy_Rte_NvmBlock_CmnMfgSrv_MfgTmpBuf4}
        {enable-take-address=false, indirect-api=false, port-defined-argument-value{value=PSProxy_Rte_NvmBlock_CmnMfgSrv_MfgTmpBuf4_0:74, value-type=NvM_BlockIdType}, port=PSProxy_Rte_NvmBlock_CmnMfgSrv_MfgTmpBuf4}
        {enable-take-address=true, indirect-api=false, port-defined-argument-value{value=PAdminProxy_Rte_NvmBlock_CmnMfgSrv_EpsSysSerlNr_0:75, value-type=NvM_BlockIdType}, port=PAdminProxy_Rte_NvmBlock_CmnMfgSrv_EpsSysSerlNr}
        {enable-take-address=false, indirect-api=false, port-defined-argument-value{value=PSProxy_Rte_NvmBlock_CmnMfgSrv_EpsSysSerlNr_0:75, value-type=NvM_BlockIdType}, port=PSProxy_Rte_NvmBlock_CmnMfgSrv_EpsSysSerlNr}
        {enable-take-address=true, indirect-api=false, port-defined-argument-value{value=PAdminProxy_Rte_NvmBlock_CmnMfgSrv_MfgTmpBuf3_0:76, value-type=NvM_BlockIdType}, port=PAdminProxy_Rte_NvmBlock_CmnMfgSrv_MfgTmpBuf3}
        {enable-take-address=false, indirect-api=false, port-defined-argument-value{value=PSProxy_Rte_NvmBlock_CmnMfgSrv_MfgTmpBuf3_0:76, value-type=NvM_BlockIdType}, port=PSProxy_Rte_NvmBlock_CmnMfgSrv_MfgTmpBuf3}
        {enable-take-address=true, indirect-api=false, port-defined-argument-value{value=PAdminProxy_Rte_NvmBlock_CmnMfgSrv_DiRestore_0:77, value-type=NvM_BlockIdType}, port=PAdminProxy_Rte_NvmBlock_CmnMfgSrv_DiRestore}
        {enable-take-address=false, indirect-api=false, port-defined-argument-value{value=PSProxy_Rte_NvmBlock_CmnMfgSrv_DiRestore_0:77, value-type=NvM_BlockIdType}, port=PSProxy_Rte_NvmBlock_CmnMfgSrv_DiRestore}
        {enable-take-address=true, indirect-api=false, port-defined-argument-value{value=PAdminProxy_Rte_NvmBlock_CmnMfgSrv_MfgTmpBuf2_0:78, value-type=NvM_BlockIdType}, port=PAdminProxy_Rte_NvmBlock_CmnMfgSrv_MfgTmpBuf2}
        {enable-take-address=false, indirect-api=false, port-defined-argument-value{value=PSProxy_Rte_NvmBlock_CmnMfgSrv_MfgTmpBuf2_0:78, value-type=NvM_BlockIdType}, port=PSProxy_Rte_NvmBlock_CmnMfgSrv_MfgTmpBuf2}
        {enable-take-address=true, indirect-api=false, port-defined-argument-value{value=PAdminProxy_Rte_NvmBlock_CmnMfgSrv_MfgTmpBuf1_0:79, value-type=NvM_BlockIdType}, port=PAdminProxy_Rte_NvmBlock_CmnMfgSrv_MfgTmpBuf1}
        {enable-take-address=false, indirect-api=false, port-defined-argument-value{value=PSProxy_Rte_NvmBlock_CmnMfgSrv_MfgTmpBuf1_0:79, value-type=NvM_BlockIdType}, port=PSProxy_Rte_NvmBlock_CmnMfgSrv_MfgTmpBuf1}
        {enable-take-address=true, indirect-api=false, port-defined-argument-value{value=PAdminProxy_Rte_NvmBlock_CmnMfgSrv_CcaHwPartNr_0:80, value-type=NvM_BlockIdType}, port=PAdminProxy_Rte_NvmBlock_CmnMfgSrv_CcaHwPartNr}
        {enable-take-address=false, indirect-api=false, port-defined-argument-value{value=PSProxy_Rte_NvmBlock_CmnMfgSrv_CcaHwPartNr_0:80, value-type=NvM_BlockIdType}, port=PSProxy_Rte_NvmBlock_CmnMfgSrv_CcaHwPartNr}
        {enable-take-address=true, indirect-api=false, port-defined-argument-value{value=PAdminProxy_Rte_NvmBlock_CmnMfgSrv_MfgTmpBuf0_0:81, value-type=NvM_BlockIdType}, port=PAdminProxy_Rte_NvmBlock_CmnMfgSrv_MfgTmpBuf0}
        {enable-take-address=false, indirect-api=false, port-defined-argument-value{value=PSProxy_Rte_NvmBlock_CmnMfgSrv_MfgTmpBuf0_0:81, value-type=NvM_BlockIdType}, port=PSProxy_Rte_NvmBlock_CmnMfgSrv_MfgTmpBuf0}
        {enable-take-address=true, indirect-api=false, port-defined-argument-value{value=PAdminProxy_Rte_NvmBlock_CmnMfgSrv_CcaSerlNr_0:82, value-type=NvM_BlockIdType}, port=PAdminProxy_Rte_NvmBlock_CmnMfgSrv_CcaSerlNr}
        {enable-take-address=false, indirect-api=false, port-defined-argument-value{value=PSProxy_Rte_NvmBlock_CmnMfgSrv_CcaSerlNr_0:82, value-type=NvM_BlockIdType}, port=PSProxy_Rte_NvmBlock_CmnMfgSrv_CcaSerlNr}
        {enable-take-address=true, indirect-api=false, port-defined-argument-value{value=PAdminProxy_Rte_NvmBlock_DutyCycThermProtn_FilStVal_0:73, value-type=NvM_BlockIdType}, port=PAdminProxy_Rte_NvmBlock_DutyCycThermProtn_FilStVal}
        {enable-take-address=false, indirect-api=false, port-defined-argument-value{value=PSProxy_Rte_NvmBlock_DutyCycThermProtn_FilStVal_0:73, value-type=NvM_BlockIdType}, port=PSProxy_Rte_NvmBlock_DutyCycThermProtn_FilStVal}
        {enable-take-address=true, indirect-api=false, port-defined-argument-value{value=PAdminProxy_Rte_NvmBlock_PullCmpActv_PullCmpLongTerm_0:72, value-type=NvM_BlockIdType}, port=PAdminProxy_Rte_NvmBlock_PullCmpActv_PullCmpLongTerm}
        {enable-take-address=false, indirect-api=false, port-defined-argument-value{value=PSProxy_Rte_NvmBlock_PullCmpActv_PullCmpLongTerm_0:72, value-type=NvM_BlockIdType}, port=PSProxy_Rte_NvmBlock_PullCmpActv_PullCmpLongTerm}
        {enable-take-address=true, indirect-api=false, port-defined-argument-value{value=PAdminProxy_Rte_NvmBlock_MotTqCmdSca_MotTqScaFac_0:71, value-type=NvM_BlockIdType}, port=PAdminProxy_Rte_NvmBlock_MotTqCmdSca_MotTqScaFac}
        {enable-take-address=false, indirect-api=false, port-defined-argument-value{value=PSProxy_Rte_NvmBlock_MotTqCmdSca_MotTqScaFac_0:71, value-type=NvM_BlockIdType}, port=PSProxy_Rte_NvmBlock_MotTqCmdSca_MotTqScaFac}
        {enable-take-address=true, indirect-api=false, port-defined-argument-value{value=PAdminProxy_Rte_NvmBlock_SnsrOffsLrng_SnsrOffsLrnd_0:70, value-type=NvM_BlockIdType}, port=PAdminProxy_Rte_NvmBlock_SnsrOffsLrng_SnsrOffsLrnd}
        {enable-take-address=false, indirect-api=false, port-defined-argument-value{value=PSProxy_Rte_NvmBlock_SnsrOffsLrng_SnsrOffsLrnd_0:70, value-type=NvM_BlockIdType}, port=PSProxy_Rte_NvmBlock_SnsrOffsLrng_SnsrOffsLrnd}
        {enable-take-address=true, indirect-api=false, port-defined-argument-value{value=PAdminProxy_Rte_NvmBlock_GmOvrlStMgr_GmLoaIgnCntr_0:69, value-type=NvM_BlockIdType}, port=PAdminProxy_Rte_NvmBlock_GmOvrlStMgr_GmLoaIgnCntr}
        {enable-take-address=false, indirect-api=false, port-defined-argument-value{value=PSProxy_Rte_NvmBlock_GmOvrlStMgr_GmLoaIgnCntr_0:69, value-type=NvM_BlockIdType}, port=PSProxy_Rte_NvmBlock_GmOvrlStMgr_GmLoaIgnCntr}
        {enable-take-address=true, indirect-api=false, port-defined-argument-value{value=PAdminProxy_Rte_NvmBlock_MotRplCoggCfg_MotRplCoggPrm_0:67, value-type=NvM_BlockIdType}, port=PAdminProxy_Rte_NvmBlock_MotRplCoggCfg_MotRplCoggPrm}
        {enable-take-address=false, indirect-api=false, port-defined-argument-value{value=PSProxy_Rte_NvmBlock_MotRplCoggCfg_MotRplCoggPrm_0:67, value-type=NvM_BlockIdType}, port=PSProxy_Rte_NvmBlock_MotRplCoggCfg_MotRplCoggPrm}
        {enable-take-address=true, indirect-api=false, port-defined-argument-value{value=PAdminProxy_Rte_NvmBlock_CDD_MotRplCoggCmd_MotCoggCmdY_0:68, value-type=NvM_BlockIdType}, port=PAdminProxy_Rte_NvmBlock_CDD_MotRplCoggCmd_MotCoggCmdY}
        {enable-take-address=false, indirect-api=false, port-defined-argument-value{value=PSProxy_Rte_NvmBlock_CDD_MotRplCoggCmd_MotCoggCmdY_0:68, value-type=NvM_BlockIdType}, port=PSProxy_Rte_NvmBlock_CDD_MotRplCoggCmd_MotCoggCmdY}
        {enable-take-address=true, indirect-api=false, port-defined-argument-value{value=PAdminProxy_Rte_NvmBlock_StHlthSigStc_SigStcHistDataAry_0:66, value-type=NvM_BlockIdType}, port=PAdminProxy_Rte_NvmBlock_StHlthSigStc_SigStcHistDataAry}
        {enable-take-address=false, indirect-api=false, port-defined-argument-value{value=PSProxy_Rte_NvmBlock_StHlthSigStc_SigStcHistDataAry_0:66, value-type=NvM_BlockIdType}, port=PSProxy_Rte_NvmBlock_StHlthSigStc_SigStcHistDataAry}
        {enable-take-address=true, indirect-api=false, port-defined-argument-value{value=PAdminProxy_Rte_NvmBlock_HwAgVehCentrTrim_HwAgTrimVal_Deprecated_0:65, value-type=NvM_BlockIdType}, port=PAdminProxy_Rte_NvmBlock_HwAgVehCentrTrim_HwAgTrimVal_Deprecated}
        {enable-take-address=false, indirect-api=false, port-defined-argument-value{value=PSProxy_Rte_NvmBlock_HwAgVehCentrTrim_HwAgTrimVal_Deprecated_0:65, value-type=NvM_BlockIdType}, port=PSProxy_Rte_NvmBlock_HwAgVehCentrTrim_HwAgTrimVal_Deprecated}
        {enable-take-address=true, indirect-api=false, port-defined-argument-value{value=PAdminProxy_Rte_NvmBlock_WhlImbRejctn_MaxCompPerc_Deprecated_0:59, value-type=NvM_BlockIdType}, port=PAdminProxy_Rte_NvmBlock_WhlImbRejctn_MaxCompPerc_Deprecated}
        {enable-take-address=false, indirect-api=false, port-defined-argument-value{value=PSProxy_Rte_NvmBlock_WhlImbRejctn_MaxCompPerc_Deprecated_0:59, value-type=NvM_BlockIdType}, port=PSProxy_Rte_NvmBlock_WhlImbRejctn_MaxCompPerc_Deprecated}
        {enable-take-address=true, indirect-api=false, port-defined-argument-value{value=PAdminProxy_Rte_NvmBlock_WhlImbRejctn_ActvCmpBand3_Deprecated_0:60, value-type=NvM_BlockIdType}, port=PAdminProxy_Rte_NvmBlock_WhlImbRejctn_ActvCmpBand3_Deprecated}
        {enable-take-address=false, indirect-api=false, port-defined-argument-value{value=PSProxy_Rte_NvmBlock_WhlImbRejctn_ActvCmpBand3_Deprecated_0:60, value-type=NvM_BlockIdType}, port=PSProxy_Rte_NvmBlock_WhlImbRejctn_ActvCmpBand3_Deprecated}
        {enable-take-address=true, indirect-api=false, port-defined-argument-value{value=PAdminProxy_Rte_NvmBlock_WhlImbRejctn_ActvCmpBand1_Deprecated_0:61, value-type=NvM_BlockIdType}, port=PAdminProxy_Rte_NvmBlock_WhlImbRejctn_ActvCmpBand1_Deprecated}
        {enable-take-address=false, indirect-api=false, port-defined-argument-value{value=PSProxy_Rte_NvmBlock_WhlImbRejctn_ActvCmpBand1_Deprecated_0:61, value-type=NvM_BlockIdType}, port=PSProxy_Rte_NvmBlock_WhlImbRejctn_ActvCmpBand1_Deprecated}
        {enable-take-address=true, indirect-api=false, port-defined-argument-value{value=PAdminProxy_Rte_NvmBlock_WhlImbRejctn_RiPeakPrev_Deprecated_0:62, value-type=NvM_BlockIdType}, port=PAdminProxy_Rte_NvmBlock_WhlImbRejctn_RiPeakPrev_Deprecated}
        {enable-take-address=false, indirect-api=false, port-defined-argument-value{value=PSProxy_Rte_NvmBlock_WhlImbRejctn_RiPeakPrev_Deprecated_0:62, value-type=NvM_BlockIdType}, port=PSProxy_Rte_NvmBlock_WhlImbRejctn_RiPeakPrev_Deprecated}
        {enable-take-address=true, indirect-api=false, port-defined-argument-value{value=PAdminProxy_Rte_NvmBlock_WhlImbRejctn_LePeakPrev_Deprecated_0:63, value-type=NvM_BlockIdType}, port=PAdminProxy_Rte_NvmBlock_WhlImbRejctn_LePeakPrev_Deprecated}
        {enable-take-address=false, indirect-api=false, port-defined-argument-value{value=PSProxy_Rte_NvmBlock_WhlImbRejctn_LePeakPrev_Deprecated_0:63, value-type=NvM_BlockIdType}, port=PSProxy_Rte_NvmBlock_WhlImbRejctn_LePeakPrev_Deprecated}
        {enable-take-address=true, indirect-api=false, port-defined-argument-value{value=PAdminProxy_Rte_NvmBlock_WhlImbRejctn_ActvCmpBand2_Deprecated_0:64, value-type=NvM_BlockIdType}, port=PAdminProxy_Rte_NvmBlock_WhlImbRejctn_ActvCmpBand2_Deprecated}
        {enable-take-address=false, indirect-api=false, port-defined-argument-value{value=PSProxy_Rte_NvmBlock_WhlImbRejctn_ActvCmpBand2_Deprecated_0:64, value-type=NvM_BlockIdType}, port=PSProxy_Rte_NvmBlock_WhlImbRejctn_ActvCmpBand2_Deprecated}
        {enable-take-address=true, indirect-api=false, port-defined-argument-value{value=PAdminProxy_Rte_NvmBlock_HwAgVehCentrTrim_HwAgTrimData_0:58, value-type=NvM_BlockIdType}, port=PAdminProxy_Rte_NvmBlock_HwAgVehCentrTrim_HwAgTrimData}
        {enable-take-address=false, indirect-api=false, port-defined-argument-value{value=PSProxy_Rte_NvmBlock_HwAgVehCentrTrim_HwAgTrimData_0:58, value-type=NvM_BlockIdType}, port=PSProxy_Rte_NvmBlock_HwAgVehCentrTrim_HwAgTrimData}
        {enable-take-address=true, indirect-api=false, port-defined-argument-value{value=PAdminProxy_Rte_NvmBlock_SysFricLrng_FricNonLrngData_0:56, value-type=NvM_BlockIdType}, port=PAdminProxy_Rte_NvmBlock_SysFricLrng_FricNonLrngData}
        {enable-take-address=false, indirect-api=false, port-defined-argument-value{value=PSProxy_Rte_NvmBlock_SysFricLrng_FricNonLrngData_0:56, value-type=NvM_BlockIdType}, port=PSProxy_Rte_NvmBlock_SysFricLrng_FricNonLrngData}
        {enable-take-address=true, indirect-api=false, port-defined-argument-value{value=PAdminProxy_Rte_NvmBlock_SysFricLrng_FricLrngData_0:57, value-type=NvM_BlockIdType}, port=PAdminProxy_Rte_NvmBlock_SysFricLrng_FricLrngData}
        {enable-take-address=false, indirect-api=false, port-defined-argument-value{value=PSProxy_Rte_NvmBlock_SysFricLrng_FricLrngData_0:57, value-type=NvM_BlockIdType}, port=PSProxy_Rte_NvmBlock_SysFricLrng_FricLrngData}
        {enable-take-address=true, indirect-api=false, port-defined-argument-value{value=PAdminProxy_Rte_NvmBlock_Bootloader_EcuId_0:55, value-type=NvM_BlockIdType}, port=PAdminProxy_Rte_NvmBlock_Bootloader_EcuId}
        {enable-take-address=false, indirect-api=false, port-defined-argument-value{value=PSProxy_Rte_NvmBlock_Bootloader_EcuId_0:55, value-type=NvM_BlockIdType}, port=PSProxy_Rte_NvmBlock_Bootloader_EcuId}
        {enable-take-address=true, indirect-api=false, port-defined-argument-value{value=PAdminProxy_Rte_NvmBlock_Bootloader_NbId_0:54, value-type=NvM_BlockIdType}, port=PAdminProxy_Rte_NvmBlock_Bootloader_NbId}
        {enable-take-address=false, indirect-api=false, port-defined-argument-value{value=PSProxy_Rte_NvmBlock_Bootloader_NbId_0:54, value-type=NvM_BlockIdType}, port=PSProxy_Rte_NvmBlock_Bootloader_NbId}
        {enable-take-address=true, indirect-api=false, port-defined-argument-value{value=PAdminProxy_Rte_NvmBlock_Bootloader_SBAT_0:53, value-type=NvM_BlockIdType}, port=PAdminProxy_Rte_NvmBlock_Bootloader_SBAT}
        {enable-take-address=false, indirect-api=false, port-defined-argument-value{value=PSProxy_Rte_NvmBlock_Bootloader_SBAT_0:53, value-type=NvM_BlockIdType}, port=PSProxy_Rte_NvmBlock_Bootloader_SBAT}
        {enable-take-address=true, indirect-api=false, port-defined-argument-value{value=PAdminProxy_DemAdminDataBlock_0:43, value-type=NvM_BlockIdType}, port=PAdminProxy_DemAdminDataBlock}
        {enable-take-address=false, indirect-api=false, port-defined-argument-value{value=PSProxy_DemAdminDataBlock_0:43, value-type=NvM_BlockIdType}, port=PSProxy_DemAdminDataBlock}
        {enable-take-address=true, indirect-api=false, port-defined-argument-value{value=PAdminProxy_DemStatusDataBlock_0:44, value-type=NvM_BlockIdType}, port=PAdminProxy_DemStatusDataBlock}
        {enable-take-address=false, indirect-api=false, port-defined-argument-value{value=PSProxy_DemStatusDataBlock_0:44, value-type=NvM_BlockIdType}, port=PSProxy_DemStatusDataBlock}
        {enable-take-address=true, indirect-api=false, port-defined-argument-value{value=PAdminProxy_DemPrimaryDataBlock0_0:45, value-type=NvM_BlockIdType}, port=PAdminProxy_DemPrimaryDataBlock0}
        {enable-take-address=false, indirect-api=false, port-defined-argument-value{value=PSProxy_DemPrimaryDataBlock0_0:45, value-type=NvM_BlockIdType}, port=PSProxy_DemPrimaryDataBlock0}
        {enable-take-address=true, indirect-api=false, port-defined-argument-value{value=PAdminProxy_DemPrimaryDataBlock1_0:46, value-type=NvM_BlockIdType}, port=PAdminProxy_DemPrimaryDataBlock1}
        {enable-take-address=false, indirect-api=false, port-defined-argument-value{value=PSProxy_DemPrimaryDataBlock1_0:46, value-type=NvM_BlockIdType}, port=PSProxy_DemPrimaryDataBlock1}
        {enable-take-address=true, indirect-api=false, port-defined-argument-value{value=PAdminProxy_DemPrimaryDataBlock2_0:47, value-type=NvM_BlockIdType}, port=PAdminProxy_DemPrimaryDataBlock2}
        {enable-take-address=false, indirect-api=false, port-defined-argument-value{value=PSProxy_DemPrimaryDataBlock2_0:47, value-type=NvM_BlockIdType}, port=PSProxy_DemPrimaryDataBlock2}
        {enable-take-address=true, indirect-api=false, port-defined-argument-value{value=PAdminProxy_DemPrimaryDataBlock3_0:48, value-type=NvM_BlockIdType}, port=PAdminProxy_DemPrimaryDataBlock3}
        {enable-take-address=false, indirect-api=false, port-defined-argument-value{value=PSProxy_DemPrimaryDataBlock3_0:48, value-type=NvM_BlockIdType}, port=PSProxy_DemPrimaryDataBlock3}
        {enable-take-address=true, indirect-api=false, port-defined-argument-value{value=PAdminProxy_DemPrimaryDataBlock4_0:49, value-type=NvM_BlockIdType}, port=PAdminProxy_DemPrimaryDataBlock4}
        {enable-take-address=false, indirect-api=false, port-defined-argument-value{value=PSProxy_DemPrimaryDataBlock4_0:49, value-type=NvM_BlockIdType}, port=PSProxy_DemPrimaryDataBlock4}
        {enable-take-address=true, indirect-api=false, port-defined-argument-value{value=PAdminProxy_DemPrimaryDataBlock5_0:50, value-type=NvM_BlockIdType}, port=PAdminProxy_DemPrimaryDataBlock5}
        {enable-take-address=false, indirect-api=false, port-defined-argument-value{value=PSProxy_DemPrimaryDataBlock5_0:50, value-type=NvM_BlockIdType}, port=PSProxy_DemPrimaryDataBlock5}
        {enable-take-address=true, indirect-api=false, port-defined-argument-value{value=PAdminProxy_DemPrimaryDataBlock6_0:51, value-type=NvM_BlockIdType}, port=PAdminProxy_DemPrimaryDataBlock6}
        {enable-take-address=false, indirect-api=false, port-defined-argument-value{value=PSProxy_DemPrimaryDataBlock6_0:51, value-type=NvM_BlockIdType}, port=PSProxy_DemPrimaryDataBlock6}
        {enable-take-address=true, indirect-api=false, port-defined-argument-value{value=PAdminProxy_DemPrimaryDataBlock7_0:52, value-type=NvM_BlockIdType}, port=PAdminProxy_DemPrimaryDataBlock7}
        {enable-take-address=false, indirect-api=false, port-defined-argument-value{value=PSProxy_DemPrimaryDataBlock7_0:52, value-type=NvM_BlockIdType}, port=PSProxy_DemPrimaryDataBlock7}
        {enable-take-address=true, indirect-api=false, port-defined-argument-value{value=PAdminProxy_DemPrimaryDataBlock8_0:11, value-type=NvM_BlockIdType}, port=PAdminProxy_DemPrimaryDataBlock8}
        {enable-take-address=false, indirect-api=false, port-defined-argument-value{value=PSProxy_DemPrimaryDataBlock8_0:11, value-type=NvM_BlockIdType}, port=PSProxy_DemPrimaryDataBlock8}
        {enable-take-address=true, indirect-api=false, port-defined-argument-value{value=PAdminProxy_DemPrimaryDataBlock9_0:12, value-type=NvM_BlockIdType}, port=PAdminProxy_DemPrimaryDataBlock9}
        {enable-take-address=false, indirect-api=false, port-defined-argument-value{value=PSProxy_DemPrimaryDataBlock9_0:12, value-type=NvM_BlockIdType}, port=PSProxy_DemPrimaryDataBlock9}
        {enable-take-address=true, indirect-api=false, port-defined-argument-value{value=PAdminProxy_DemPrimaryDataBlock10_0:13, value-type=NvM_BlockIdType}, port=PAdminProxy_DemPrimaryDataBlock10}
        {enable-take-address=false, indirect-api=false, port-defined-argument-value{value=PSProxy_DemPrimaryDataBlock10_0:13, value-type=NvM_BlockIdType}, port=PSProxy_DemPrimaryDataBlock10}
        {enable-take-address=true, indirect-api=false, port-defined-argument-value{value=PAdminProxy_DemPrimaryDataBlock11_0:14, value-type=NvM_BlockIdType}, port=PAdminProxy_DemPrimaryDataBlock11}
        {enable-take-address=false, indirect-api=false, port-defined-argument-value{value=PSProxy_DemPrimaryDataBlock11_0:14, value-type=NvM_BlockIdType}, port=PSProxy_DemPrimaryDataBlock11}
        {enable-take-address=true, indirect-api=false, port-defined-argument-value{value=PAdminProxy_DemPrimaryDataBlock12_0:15, value-type=NvM_BlockIdType}, port=PAdminProxy_DemPrimaryDataBlock12}
        {enable-take-address=false, indirect-api=false, port-defined-argument-value{value=PSProxy_DemPrimaryDataBlock12_0:15, value-type=NvM_BlockIdType}, port=PSProxy_DemPrimaryDataBlock12}
        {enable-take-address=true, indirect-api=false, port-defined-argument-value{value=PAdminProxy_DemPrimaryDataBlock13_0:16, value-type=NvM_BlockIdType}, port=PAdminProxy_DemPrimaryDataBlock13}
        {enable-take-address=false, indirect-api=false, port-defined-argument-value{value=PSProxy_DemPrimaryDataBlock13_0:16, value-type=NvM_BlockIdType}, port=PSProxy_DemPrimaryDataBlock13}
        {enable-take-address=true, indirect-api=false, port-defined-argument-value{value=PAdminProxy_DemPrimaryDataBlock14_0:17, value-type=NvM_BlockIdType}, port=PAdminProxy_DemPrimaryDataBlock14}
        {enable-take-address=false, indirect-api=false, port-defined-argument-value{value=PSProxy_DemPrimaryDataBlock14_0:17, value-type=NvM_BlockIdType}, port=PSProxy_DemPrimaryDataBlock14}
        {enable-take-address=true, indirect-api=false, port-defined-argument-value{value=PAdminProxy_DemPrimaryDataBlock15_0:18, value-type=NvM_BlockIdType}, port=PAdminProxy_DemPrimaryDataBlock15}
        {enable-take-address=false, indirect-api=false, port-defined-argument-value{value=PSProxy_DemPrimaryDataBlock15_0:18, value-type=NvM_BlockIdType}, port=PSProxy_DemPrimaryDataBlock15}
        {enable-take-address=true, indirect-api=false, port-defined-argument-value{value=PAdminProxy_DemPrimaryDataBlock16_0:19, value-type=NvM_BlockIdType}, port=PAdminProxy_DemPrimaryDataBlock16}
        {enable-take-address=false, indirect-api=false, port-defined-argument-value{value=PSProxy_DemPrimaryDataBlock16_0:19, value-type=NvM_BlockIdType}, port=PSProxy_DemPrimaryDataBlock16}
        {enable-take-address=true, indirect-api=false, port-defined-argument-value{value=PAdminProxy_DemPrimaryDataBlock17_0:20, value-type=NvM_BlockIdType}, port=PAdminProxy_DemPrimaryDataBlock17}
        {enable-take-address=false, indirect-api=false, port-defined-argument-value{value=PSProxy_DemPrimaryDataBlock17_0:20, value-type=NvM_BlockIdType}, port=PSProxy_DemPrimaryDataBlock17}
        {enable-take-address=true, indirect-api=false, port-defined-argument-value{value=PAdminProxy_DemPrimaryDataBlock18_0:21, value-type=NvM_BlockIdType}, port=PAdminProxy_DemPrimaryDataBlock18}
        {enable-take-address=false, indirect-api=false, port-defined-argument-value{value=PSProxy_DemPrimaryDataBlock18_0:21, value-type=NvM_BlockIdType}, port=PSProxy_DemPrimaryDataBlock18}
        {enable-take-address=true, indirect-api=false, port-defined-argument-value{value=PAdminProxy_DemPrimaryDataBlock19_0:22, value-type=NvM_BlockIdType}, port=PAdminProxy_DemPrimaryDataBlock19}
        {enable-take-address=false, indirect-api=false, port-defined-argument-value{value=PSProxy_DemPrimaryDataBlock19_0:22, value-type=NvM_BlockIdType}, port=PSProxy_DemPrimaryDataBlock19}
        {enable-take-address=true, indirect-api=false, port-defined-argument-value{value=PAdminProxy_DemPrimaryDataBlock20_0:23, value-type=NvM_BlockIdType}, port=PAdminProxy_DemPrimaryDataBlock20}
        {enable-take-address=false, indirect-api=false, port-defined-argument-value{value=PSProxy_DemPrimaryDataBlock20_0:23, value-type=NvM_BlockIdType}, port=PSProxy_DemPrimaryDataBlock20}
        {enable-take-address=true, indirect-api=false, port-defined-argument-value{value=PAdminProxy_DemPrimaryDataBlock21_0:24, value-type=NvM_BlockIdType}, port=PAdminProxy_DemPrimaryDataBlock21}
        {enable-take-address=false, indirect-api=false, port-defined-argument-value{value=PSProxy_DemPrimaryDataBlock21_0:24, value-type=NvM_BlockIdType}, port=PSProxy_DemPrimaryDataBlock21}
        {enable-take-address=true, indirect-api=false, port-defined-argument-value{value=PAdminProxy_DemPrimaryDataBlock22_0:25, value-type=NvM_BlockIdType}, port=PAdminProxy_DemPrimaryDataBlock22}
        {enable-take-address=false, indirect-api=false, port-defined-argument-value{value=PSProxy_DemPrimaryDataBlock22_0:25, value-type=NvM_BlockIdType}, port=PSProxy_DemPrimaryDataBlock22}
        {enable-take-address=true, indirect-api=false, port-defined-argument-value{value=PAdminProxy_DemPrimaryDataBlock23_0:26, value-type=NvM_BlockIdType}, port=PAdminProxy_DemPrimaryDataBlock23}
        {enable-take-address=false, indirect-api=false, port-defined-argument-value{value=PSProxy_DemPrimaryDataBlock23_0:26, value-type=NvM_BlockIdType}, port=PSProxy_DemPrimaryDataBlock23}
        {enable-take-address=true, indirect-api=false, port-defined-argument-value{value=PAdminProxy_DemPrimaryDataBlock24_0:27, value-type=NvM_BlockIdType}, port=PAdminProxy_DemPrimaryDataBlock24}
        {enable-take-address=false, indirect-api=false, port-defined-argument-value{value=PSProxy_DemPrimaryDataBlock24_0:27, value-type=NvM_BlockIdType}, port=PSProxy_DemPrimaryDataBlock24}
        {enable-take-address=true, indirect-api=false, port-defined-argument-value{value=PAdminProxy_DemPrimaryDataBlock25_0:28, value-type=NvM_BlockIdType}, port=PAdminProxy_DemPrimaryDataBlock25}
        {enable-take-address=false, indirect-api=false, port-defined-argument-value{value=PSProxy_DemPrimaryDataBlock25_0:28, value-type=NvM_BlockIdType}, port=PSProxy_DemPrimaryDataBlock25}
        {enable-take-address=true, indirect-api=false, port-defined-argument-value{value=PAdminProxy_DemPrimaryDataBlock26_0:29, value-type=NvM_BlockIdType}, port=PAdminProxy_DemPrimaryDataBlock26}
        {enable-take-address=false, indirect-api=false, port-defined-argument-value{value=PSProxy_DemPrimaryDataBlock26_0:29, value-type=NvM_BlockIdType}, port=PSProxy_DemPrimaryDataBlock26}
        {enable-take-address=true, indirect-api=false, port-defined-argument-value{value=PAdminProxy_DemPrimaryDataBlock27_0:30, value-type=NvM_BlockIdType}, port=PAdminProxy_DemPrimaryDataBlock27}
        {enable-take-address=false, indirect-api=false, port-defined-argument-value{value=PSProxy_DemPrimaryDataBlock27_0:30, value-type=NvM_BlockIdType}, port=PSProxy_DemPrimaryDataBlock27}
        {enable-take-address=true, indirect-api=false, port-defined-argument-value{value=PAdminProxy_DemPrimaryDataBlock28_0:31, value-type=NvM_BlockIdType}, port=PAdminProxy_DemPrimaryDataBlock28}
        {enable-take-address=false, indirect-api=false, port-defined-argument-value{value=PSProxy_DemPrimaryDataBlock28_0:31, value-type=NvM_BlockIdType}, port=PSProxy_DemPrimaryDataBlock28}
        {enable-take-address=true, indirect-api=false, port-defined-argument-value{value=PAdminProxy_DemPrimaryDataBlock29_0:32, value-type=NvM_BlockIdType}, port=PAdminProxy_DemPrimaryDataBlock29}
        {enable-take-address=false, indirect-api=false, port-defined-argument-value{value=PSProxy_DemPrimaryDataBlock29_0:32, value-type=NvM_BlockIdType}, port=PSProxy_DemPrimaryDataBlock29}
        {enable-take-address=true, indirect-api=false, port-defined-argument-value{value=PAdminProxy_DemPrimaryDataBlock30_0:33, value-type=NvM_BlockIdType}, port=PAdminProxy_DemPrimaryDataBlock30}
        {enable-take-address=false, indirect-api=false, port-defined-argument-value{value=PSProxy_DemPrimaryDataBlock30_0:33, value-type=NvM_BlockIdType}, port=PSProxy_DemPrimaryDataBlock30}
        {enable-take-address=true, indirect-api=false, port-defined-argument-value{value=PAdminProxy_DemPrimaryDataBlock31_0:34, value-type=NvM_BlockIdType}, port=PAdminProxy_DemPrimaryDataBlock31}
        {enable-take-address=false, indirect-api=false, port-defined-argument-value{value=PSProxy_DemPrimaryDataBlock31_0:34, value-type=NvM_BlockIdType}, port=PSProxy_DemPrimaryDataBlock31}
        {enable-take-address=true, indirect-api=false, port-defined-argument-value{value=PAdminProxy_DemPrimaryDataBlock32_0:35, value-type=NvM_BlockIdType}, port=PAdminProxy_DemPrimaryDataBlock32}
        {enable-take-address=false, indirect-api=false, port-defined-argument-value{value=PSProxy_DemPrimaryDataBlock32_0:35, value-type=NvM_BlockIdType}, port=PSProxy_DemPrimaryDataBlock32}
        {enable-take-address=true, indirect-api=false, port-defined-argument-value{value=PAdminProxy_DemPrimaryDataBlock33_0:36, value-type=NvM_BlockIdType}, port=PAdminProxy_DemPrimaryDataBlock33}
        {enable-take-address=false, indirect-api=false, port-defined-argument-value{value=PSProxy_DemPrimaryDataBlock33_0:36, value-type=NvM_BlockIdType}, port=PSProxy_DemPrimaryDataBlock33}
        {enable-take-address=true, indirect-api=false, port-defined-argument-value{value=PAdminProxy_DemPrimaryDataBlock34_0:37, value-type=NvM_BlockIdType}, port=PAdminProxy_DemPrimaryDataBlock34}
        {enable-take-address=false, indirect-api=false, port-defined-argument-value{value=PSProxy_DemPrimaryDataBlock34_0:37, value-type=NvM_BlockIdType}, port=PSProxy_DemPrimaryDataBlock34}
        {enable-take-address=true, indirect-api=false, port-defined-argument-value{value=PAdminProxy_DemPrimaryDataBlock35_0:38, value-type=NvM_BlockIdType}, port=PAdminProxy_DemPrimaryDataBlock35}
        {enable-take-address=false, indirect-api=false, port-defined-argument-value{value=PSProxy_DemPrimaryDataBlock35_0:38, value-type=NvM_BlockIdType}, port=PSProxy_DemPrimaryDataBlock35}
        {enable-take-address=true, indirect-api=false, port-defined-argument-value{value=PAdminProxy_DemPrimaryDataBlock36_0:39, value-type=NvM_BlockIdType}, port=PAdminProxy_DemPrimaryDataBlock36}
        {enable-take-address=false, indirect-api=false, port-defined-argument-value{value=PSProxy_DemPrimaryDataBlock36_0:39, value-type=NvM_BlockIdType}, port=PSProxy_DemPrimaryDataBlock36}
        {enable-take-address=true, indirect-api=false, port-defined-argument-value{value=PAdminProxy_DemPrimaryDataBlock37_0:40, value-type=NvM_BlockIdType}, port=PAdminProxy_DemPrimaryDataBlock37}
        {enable-take-address=false, indirect-api=false, port-defined-argument-value{value=PSProxy_DemPrimaryDataBlock37_0:40, value-type=NvM_BlockIdType}, port=PSProxy_DemPrimaryDataBlock37}
        {enable-take-address=true, indirect-api=false, port-defined-argument-value{value=PAdminProxy_DemPrimaryDataBlock38_0:41, value-type=NvM_BlockIdType}, port=PAdminProxy_DemPrimaryDataBlock38}
        {enable-take-address=false, indirect-api=false, port-defined-argument-value{value=PSProxy_DemPrimaryDataBlock38_0:41, value-type=NvM_BlockIdType}, port=PSProxy_DemPrimaryDataBlock38}
        {enable-take-address=true, indirect-api=false, port-defined-argument-value{value=PAdminProxy_DemPrimaryDataBlock39_0:42, value-type=NvM_BlockIdType}, port=PAdminProxy_DemPrimaryDataBlock39}
        {enable-take-address=false, indirect-api=false, port-defined-argument-value{value=PSProxy_DemPrimaryDataBlock39_0:42, value-type=NvM_BlockIdType}, port=PSProxy_DemPrimaryDataBlock39}
        {enable-take-address=true, indirect-api=false, port-defined-argument-value{value=PAdminProxy_Rte_NvmBlock_CustDiagc_GmIgnCntr_0:10, value-type=NvM_BlockIdType}, port=PAdminProxy_Rte_NvmBlock_CustDiagc_GmIgnCntr}
        {enable-take-address=false, indirect-api=false, port-defined-argument-value{value=PSProxy_Rte_NvmBlock_CustDiagc_GmIgnCntr_0:10, value-type=NvM_BlockIdType}, port=PSProxy_Rte_NvmBlock_CustDiagc_GmIgnCntr}
        {enable-take-address=true, indirect-api=false, port-defined-argument-value{value=PAdminProxy_Rte_NvmBlock_GmMsg778BusHiSpd_DtcTrigStsAry_0:9, value-type=NvM_BlockIdType}, port=PAdminProxy_Rte_NvmBlock_GmMsg778BusHiSpd_DtcTrigStsAry}
        {enable-take-address=false, indirect-api=false, port-defined-argument-value{value=PSProxy_Rte_NvmBlock_GmMsg778BusHiSpd_DtcTrigStsAry_0:9, value-type=NvM_BlockIdType}, port=PSProxy_Rte_NvmBlock_GmMsg778BusHiSpd_DtcTrigStsAry}
        {enable-take-address=true, indirect-api=false, port-defined-argument-value{value=PAdminProxy_SnpshtDataAry_0:8, value-type=NvM_BlockIdType}, port=PAdminProxy_SnpshtDataAry}
        {enable-take-address=false, indirect-api=false, port-defined-argument-value{value=PSProxy_SnpshtDataAry_0:8, value-type=NvM_BlockIdType}, port=PSProxy_SnpshtDataAry}
        {enable-take-address=true, indirect-api=false, port-defined-argument-value{value=PAdminProxy_Rte_NvmBlock_HwAgSnsrls_StordLstPrm_0:7, value-type=NvM_BlockIdType}, port=PAdminProxy_Rte_NvmBlock_HwAgSnsrls_StordLstPrm}
        {enable-take-address=false, indirect-api=false, port-defined-argument-value{value=PSProxy_Rte_NvmBlock_HwAgSnsrls_StordLstPrm_0:7, value-type=NvM_BlockIdType}, port=PSProxy_Rte_NvmBlock_HwAgSnsrls_StordLstPrm}
        {enable-take-address=true, indirect-api=false, port-defined-argument-value{value=PAdminProxy_Rte_NvmBlock_EotLrng_MaxHwAgCwAndCcw_Deprecated_0:6, value-type=NvM_BlockIdType}, port=PAdminProxy_Rte_NvmBlock_EotLrng_MaxHwAgCwAndCcw_Deprecated}
        {enable-take-address=false, indirect-api=false, port-defined-argument-value{value=PSProxy_Rte_NvmBlock_EotLrng_MaxHwAgCwAndCcw_Deprecated_0:6, value-type=NvM_BlockIdType}, port=PSProxy_Rte_NvmBlock_EotLrng_MaxHwAgCwAndCcw_Deprecated}
        {enable-take-address=true, indirect-api=false, port-defined-argument-value{value=PAdminProxy_Rte_NvmBlock_CmnMfgSrv_SeedKey_0:5, value-type=NvM_BlockIdType}, port=PAdminProxy_Rte_NvmBlock_CmnMfgSrv_SeedKey}
        {enable-take-address=false, indirect-api=false, port-defined-argument-value{value=PSProxy_Rte_NvmBlock_CmnMfgSrv_SeedKey_0:5, value-type=NvM_BlockIdType}, port=PSProxy_Rte_NvmBlock_CmnMfgSrv_SeedKey}
        {enable-take-address=true, indirect-api=false, port-defined-argument-value{value=PAdminProxy_Rte_NvmBlock_EotLrng_MaxHwAgCwAndCcw_0:4, value-type=NvM_BlockIdType}, port=PAdminProxy_Rte_NvmBlock_EotLrng_MaxHwAgCwAndCcw}
        {enable-take-address=false, indirect-api=false, port-defined-argument-value{value=PSProxy_Rte_NvmBlock_EotLrng_MaxHwAgCwAndCcw_0:4, value-type=NvM_BlockIdType}, port=PSProxy_Rte_NvmBlock_EotLrng_MaxHwAgCwAndCcw}
        {enable-take-address=true, indirect-api=false, port-defined-argument-value{value=PAdminProxy_Rte_NvmBlock_WhlImbRejctn_CmpPeakData_0:3, value-type=NvM_BlockIdType}, port=PAdminProxy_Rte_NvmBlock_WhlImbRejctn_CmpPeakData}
        {enable-take-address=false, indirect-api=false, port-defined-argument-value{value=PSProxy_Rte_NvmBlock_WhlImbRejctn_CmpPeakData_0:3, value-type=NvM_BlockIdType}, port=PSProxy_Rte_NvmBlock_WhlImbRejctn_CmpPeakData}
      11 x runnable:
        NvMProxy_MainFunction
        EraseBlock: can-be-invoked-concurrently=true, symbol=NvMProxy_EraseNvBlock
        GetDataIndex: can-be-invoked-concurrently=true, symbol=NvMProxy_GetDataIndex
        GetErrorStatus: can-be-invoked-concurrently=true, symbol=NvMProxy_GetErrorStatus
        InvalidateNvBlock: can-be-invoked-concurrently=true, symbol=NvMProxy_InvalidateNvBlock
        ReadBlock: can-be-invoked-concurrently=true, symbol=NvMProxy_ReadBlock
        RestoreBlockDefaults: can-be-invoked-concurrently=true, symbol=NvMProxy_RestoreBlockDefaults
        SetBlockProtection: can-be-invoked-concurrently=true, symbol=NvMProxy_SetBlockProtection
        SetDataIndex: symbol=NvM_SetDataIndex
        SetRamBlockStatus: can-be-invoked-concurrently=true, symbol=NvMProxy_SetRamBlockStatus
        WriteBlock: can-be-invoked-concurrently=true, symbol=NvMProxy_WriteBlock
  swc implementation NvMProxyImplementation: behavior=NvMProxyInternalBehavior
    code-descriptors:
      code Default: artifact-descriptors=autosar-engineering-object={short-label=Default, category=SWSRC}
