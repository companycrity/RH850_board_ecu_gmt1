AUTOSAR XML (schema 4-0-3)
package /MICROSAR
  4 x bsw implementation, all with programming-language=C, used-code-generator=DaVinci Configurator, vendor-id=30, ar-release-version=4.00.03:
    BswM_Impl: sw-version=8.00.00, behavior=BswMBehavior
    EcuM_Impl: sw-version=7.00.00, behavior=EcuMBehavior
    Fee_Impl: sw-version=8.01.02, behavior=FeeBehavior
    NvM_Impl: sw-version=5.05.00, behavior=NvMBehavior
package /MICROSAR/BswM_ib_bswmd/BswModuleDescriptions
  bsw module description BswM
    bsw internal behavior BswMBehavior
      exclusive area BSWM_EXCLUSIVE_AREA_0
      bsw schedulable entity BswM_MainFunction: implemented-entry=BswM_MainFunction
      bsw timing event BswM_MainFunctionTimingEvent0: starts-on-event=BswM_MainFunction, period=0.01
  bsw module entry BswM_MainFunction: call-type=SCHEDULED, execution-context=TASK
package /MICROSAR/EcuM_ib_bswmd/BswModuleDescriptions
  bsw module description EcuM
    bsw internal behavior EcuMBehavior
      exclusive area ECUM_EXCLUSIVE_AREA_0  # This exclusive area shall disable all wake up interrupts to prevent overwriting of some global variables.
      exclusive area ECUM_EXCLUSIVE_AREA_1  # This exclusive area is only used in case of multi core and if the the EcuM is configured to handle also the slave cores. It must be configured as a spinlock to allow access to some variables simultaneously from multiple cores.
      exclusive area ECUM_EXCLUSIVE_AREA_2  # This exclusive area is used for accessing the clock variable. It shall disable GPT interrupts and task changes. Only necessary if 32 Bit access is not atomic and Alarm Clock is present.
      bsw schedulable entity EcuM_MainFunction: implemented-entry=EcuM_MainFunction
      bsw timing event EcuM_MainFunctionTimingEvent0: starts-on-event=EcuM_MainFunction, period=0.01
  bsw module entry EcuM_MainFunction: call-type=SCHEDULED, execution-context=TASK
package /MICROSAR/Fee_ib_bswmd/BswModuleDescriptions
  bsw module description Fee
    bsw internal behavior FeeBehavior
      exclusive area FEE_EXCLUSIVE_AREA_0
      bsw schedulable entity Fee_MainFunction: implemented-entry=Fee_MainFunction
      bsw timing event Fee_MainFunctionTimingEvent0: starts-on-event=Fee_MainFunction, period=0.01
  bsw module entry Fee_MainFunction: call-type=SCHEDULED, execution-context=TASK
package /MICROSAR/NvM_ib_bswmd/BswModuleDescriptions
  bsw module description NvM
    bsw internal behavior NvMBehavior
      exclusive area NVM_EXCLUSIVE_AREA_0
      bsw schedulable entity NvM_MainFunction: implemented-entry=NvM_MainFunction
      bsw timing event NvM_MainFunctionTimingEvent0: starts-on-event=NvM_MainFunction, period=0.01
  bsw module entry NvM_MainFunction: call-type=SCHEDULED, execution-context=TASK
