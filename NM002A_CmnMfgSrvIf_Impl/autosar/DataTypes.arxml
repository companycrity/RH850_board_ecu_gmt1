AUTOSAR XML (schema 4-0-3)
standard types defined: float32_DataConstr, sint16_DataConstr, uint16_DataConstr, uint32_DataConstr, uint8_DataConstr, boolean, float32, sint16, uint16, uint32, uint8
package /DataTypes
  impl type Ary1D_u8_20: category=ARRAY, sw-calibration-access=READ-ONLY, type-emitter=RTE
    element Element: array-size=20, array-size-semantics=FIXED-SIZE, implementation-data-type=uint8
package /Nexteer/DataTypes
  7 x app type, all with sw-calibration-access=READ-ONLY:
    Ag19: category=VALUE, range phys -900..900, unit=HwDeg
    Ag9: category=VALUE, compu {raw=phys*65536 for phys 0; unit FixdPt}, range phys 0..0.9999847412, unit=MotRevElec
    Cnt15: category=VALUE, range phys 0..4294967295, unit=Cnt
    Logl1: category=BOOLEAN, range phys 0..1
    MotCon1: category=VALUE, range phys 0.025..0.075, unit=V/MotRad/Sec
    R6: category=VALUE, range phys 0.005..0.12565, unit=ohm
    Tq1: category=VALUE, range phys -8.8..8.8, unit=MotNm
  22 x impl type:
    Ary1D_f32_26: category=ARRAY, sw-calibration-access=READ-ONLY, type-emitter=RTE
      element Element: array-size=26, array-size-semantics=FIXED-SIZE, implementation-data-type=float32
    Ary1D_ReadFltInfoRec1_20: category=ARRAY, sw-calibration-access=READ-ONLY, type-emitter=RTE
      element Element: array-size=20, array-size-semantics=FIXED-SIZE, implementation-data-type=ReadFltInfoRec1
    Ary1D_s1p14_128: category=ARRAY, sw-calibration-access=READ-ONLY, type-emitter=RTE
      element Element: array-size=128, array-size-semantics=FIXED-SIZE, implementation-data-type=s1p14
    Ary1D_SnpshtDataRec1_8: category=ARRAY, sw-calibration-access=READ-ONLY, type-emitter=RTE
      element Element: array-size=8, array-size-semantics=FIXED-SIZE, implementation-data-type=SnpshtDataRec1
    Ary1D_u8_16: category=ARRAY, sw-calibration-access=READ-ONLY, type-emitter=RTE
      element Element: array-size=16, array-size-semantics=FIXED-SIZE, implementation-data-type=uint8
    Ary1D_u8_48: category=ARRAY, sw-calibration-access=READ-ONLY, type-emitter=RTE
      element Element: array-size=48, array-size-semantics=FIXED-SIZE, implementation-data-type=uint8
    Ary1D_u8_6: category=ARRAY, sw-calibration-access=READ-ONLY, type-emitter=RTE
      element Element: array-size=6, array-size-semantics=FIXED-SIZE, implementation-data-type=uint8
    Ary1D_u8_CmnMfgSrvIf: category=ARRAY, type-emitter=CmnMfgSrvIf
      element Element: array-size=65535, array-size-semantics=FIXED-SIZE, implementation-data-type=uint8
    MfgEnaSt1: compu {0=MFGENAST_PRDNMOD, 1=MFGENAST_MFGMOD, 2=MFGENAST_TESTMOD}, implementation-data-type=uint8, type-emitter=RTE
    MotAgMeasEolPrmRec1: category=STRUCTURE, sw-calibration-access=READ-ONLY, type-emitter=RTE
      5 x element, all with category=TYPE_REFERENCE, implementation-data-type=float32:
        SinOffs
        CosOffs
        SinAmpRecpr
        CosAmpRecpr
        SinDelta
    NtcInfoRec4: category=STRUCTURE, sw-calibration-access=READ-ONLY, type-emitter=DiagcMgr
      element NtcStInfo: implementation-data-type=uint8
      element Sts: implementation-data-type=uint8
      element AgiCntr: implementation-data-type=uint8
    NtcNr1: compu {1..511=NTCNR_0X001..NTCNR_0X1FF}, implementation-data-type=uint16, type-emitter=RTE
    NtcNrWithResd1: compu {0=NTCNR_RESD, 1..511=NTCNR_0X001..NTCNR_0X1FF}, implementation-data-type=uint16, type-emitter=RTE
    ReadFltInfoRec1: category=STRUCTURE, sw-calibration-access=READ-ONLY, type-emitter=RTE
      4 x element, all with category=TYPE_REFERENCE:
        NtcNr: implementation-data-type=NtcNrWithResd1
        AgiCntr: implementation-data-type=uint8
        Sts: implementation-data-type=uint8
        NtcStInfo: implementation-data-type=uint8
    s1p14: implementation-data-type=sint16, type-emitter=RTE
    s5p10: implementation-data-type=sint16, type-emitter=RTE
    s8p7: implementation-data-type=sint16, type-emitter=RTE
    SnpshtDataRec1: category=STRUCTURE, sw-calibration-access=READ-ONLY, type-emitter=RTE
      10 x element, all with category=TYPE_REFERENCE:
        MicroDiagcData: implementation-data-type=uint32
        HwTq: implementation-data-type=s5p10
        MotTq: implementation-data-type=s5p10
        IgnCntr: implementation-data-type=uint32
        BrdgVltg: implementation-data-type=u6p10
        EcuT: implementation-data-type=s8p7
        NtcNr: implementation-data-type=uint16
        NtcStInfo: implementation-data-type=uint8
        SysSt: implementation-data-type=SysSt1
        VehSpd: implementation-data-type=u9p7
    SysFricLrngOperMod1: compu {0=SYSFRICLRNGOPERMOD_CALIBRATION, 1=SYSFRICLRNGOPERMOD_NORMAL, 2=SYSFRICLRNGOPERMOD_CLEAR, 3=SYSFRICLRNGOPERMOD_IDLE, 4=SYSFRICLRNGOPERMOD_BASELINE}, implementation-data-type=uint8, type-emitter=RTE
    SysSt1: compu {0=SYSST_DI, 1=SYSST_OFF, 2=SYSST_ENA, 3=SYSST_WRMININ}, implementation-data-type=uint8, type-emitter=RTE
    u6p10: implementation-data-type=uint16, type-emitter=RTE
    u9p7: implementation-data-type=uint16, type-emitter=RTE
package /Nexteer/Units
  7 x unit, all with factor-si-to-unit=1, offset-si-to-unit=0:
    Cnt: display-name=Cnt
    FixdPt
    HwDeg: display-name=HwDeg
    MotNwtMtr: display-name=MotNm
    MotRevElec: display-name=MotRevElec
    Ohm: display-name=ohm
    VoltPerMotRadPerSec: display-name=V/MotRad/Sec
