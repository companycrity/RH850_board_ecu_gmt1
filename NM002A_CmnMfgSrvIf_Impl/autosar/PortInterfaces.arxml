AUTOSAR XML (schema 4-0-3)
package /Nexteer/PortInterfaces
  sender receiver interface MfgEnaSt1_PortIf1: invalidation-policy{data-element=Val, handle-invalid=DONT-INVALIDATE}
    data Val: sw-calibration-access=READ-ONLY, type=MfgEnaSt1
package /PortInterfaces
  client server interface CmnMfgSrvCmnMfgSrvMaiFct
    operation Oper
      7 x arg, all with server-argument-impl-policy=USE-ARGUMENT-TYPE:
        CmnMfgSrvCmnMfgSrvSrvId: type=uint8, direction=IN
        CmnMfgSrvCmnMfgSrvSubFct: type=uint8, direction=IN
        CmnMfgSrvCmnMfgSrvPrmId: type=uint16, direction=IN
        CmnMfgSrvCmnMfgSrvDataBufferPtr: type=uint8, direction=INOUT
        CmnMfgSrvCmnMfgSrvReqLen: type=uint16, direction=IN
        CmnMfgSrvCmnMfgSrvRespLen: type=uint16, direction=OUT
        CmnMfgSrvCmnMfgSrvRespCod: type=uint8, direction=OUT
  client server interface CmnMfgSrvIfCmnMfgSrvIfImdtTx
    operation Oper
      arg CmnMfgSrvCmnMfgSrvDataBufferPtr: type=Ary1D_u8_CmnMfgSrvIf, direction=IN, server-argument-impl-policy=USE-ARGUMENT-TYPE
      arg CmnMfgSrvCmnMfgSrvDataLen: type=uint16, direction=IN, server-argument-impl-policy=USE-ARGUMENT-TYPE
