AUTOSAR XML (schema 4-0-3)
standard types defined: float32_DataConstr, float64_DataConstr, sint16_DataConstr, sint32_DataConstr, sint8_DataConstr, uint16_DataConstr, uint32_DataConstr, uint8_DataConstr, boolean, float32, float64, sint16, sint32, sint8, uint16, uint32, uint8, Boolean, dtRef_const_VOID, dtRef_VOID
package /Nexteer/DataTypes
  17 x impl type:
    Ary1D_f32_30: category=ARRAY, sw-calibration-access=READ-ONLY, type-emitter=RTE
      element Element: array-size=30, array-size-semantics=FIXED-SIZE, implementation-data-type=float32
    Ary1D_s8p7_3: category=ARRAY, sw-calibration-access=READ-ONLY, type-emitter=RTE
      element Element: array-size=3, array-size-semantics=FIXED-SIZE, implementation-data-type=s8p7
    Ary1D_u1p15_6: category=ARRAY, sw-calibration-access=READ-ONLY, type-emitter=RTE
      element Element: array-size=6, array-size-semantics=FIXED-SIZE, implementation-data-type=u1p15
    Ary1D_u6p10_6: category=ARRAY, sw-calibration-access=READ-ONLY, type-emitter=RTE
      element Element: array-size=6, array-size-semantics=FIXED-SIZE, implementation-data-type=u6p10
    Ary1D_u7p9_3: category=ARRAY, sw-calibration-access=READ-ONLY, type-emitter=RTE
      element Element: array-size=3, array-size-semantics=FIXED-SIZE, implementation-data-type=u7p9
    FilLpRec1: category=STRUCTURE, sw-calibration-access=READ-ONLY, type-emitter=NxtrFil
      element FilSt: implementation-data-type=float32
      element FilGain: implementation-data-type=float32
      symbol props FilLpRec1
    NtcNr1: compu {1..511=NTCNR_0X001..NTCNR_0X1FF}, implementation-data-type=uint16, type-emitter=RTE
    NtcSts1: compu {0=NTCSTS_PASSD, 1=NTCSTS_FAILD, 2=NTCSTS_PREPASSD, 3=NTCSTS_PREFAILD}, implementation-data-type=uint8, type-emitter=RTE
    PassFailCntrDiagcRec1: category=STRUCTURE, sw-calibration-access=READ-ONLY, type-emitter=RTE
      5 x element, all with category=TYPE_REFERENCE:
        Cntr: implementation-data-type=float32
        Thd: implementation-data-type=float32
        NegStep: implementation-data-type=float32
        PosStep: implementation-data-type=float32
        Sts: implementation-data-type=SigQlfr1
    s8p7: implementation-data-type=sint16, type-emitter=RTE
    SigQlfr1: compu {0=SIGQLFR_NORES, 1=SIGQLFR_PASSD, 2=SIGQLFR_FAILD}, implementation-data-type=uint8, type-emitter=RTE
    SysSt1: compu {0=SYSST_DI, 1=SYSST_OFF, 2=SYSST_ENA, 3=SYSST_WRMININ}, implementation-data-type=uint8, type-emitter=RTE
    u16p0: implementation-data-type=uint16, type-emitter=RTE
    u1p15: implementation-data-type=uint16, type-emitter=RTE
    u6p10: implementation-data-type=uint16, type-emitter=RTE
    u7p9: implementation-data-type=uint16, type-emitter=RTE
    WhlImbRejctnCmpPeakRec1: category=STRUCTURE, sw-calibration-access=READ-ONLY, type-emitter=RTE
      6 x element, all with category=TYPE_REFERENCE:
        LePeakPrev: implementation-data-type=float32
        RiPeakPrev: implementation-data-type=float32
        MaxCompPerc: implementation-data-type=float32
        ActvCmpBand{1..3}: implementation-data-type=uint32
package /Nexteer/NvMProxy_swc/DataTypes
  impl type NvM_RequestResultType: category=VALUE, base-type=NvM_RequestResultType, compu {0=NVM_REQ_OK, 1=NVM_REQ_NOT_OK, 2=NVM_REQ_PENDING, 3=NVM_REQ_INTEGRITY_FAILED, 4=NVM_REQ_BLOCK_SKIPPED, 5=NVM_REQ_NV_INVALIDATED, 6=NVM_REQ_CANCELED, 7=NVM_REQ_REDUNDANCY_FAILED, 8=NVM_REQ_RESTORED_FROM_ROM}
package /Nexteer/NvMProxy_swc/DataTypes/BaseTypes
  base type NvM_RequestResultType: category=FIXED_LENGTH, base-type-size=8, base-type-encoding=NONE, native-declaration=uint8
