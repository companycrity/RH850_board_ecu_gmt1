AUTOSAR XML (schema 4-0-3)
package /Nexteer/Calibrations
  66 x parameter interface:
    Ag1
      parameter data prototype Val: sw-calibration-access=READ-WRITE, type=Ag1
    Ag2
      parameter data prototype Val: sw-calibration-access=READ-WRITE, type=Ag6
    Ag3
      parameter data prototype Val: sw-calibration-access=READ-WRITE, type=Ag11
    Ary1D_u32_512
      parameter data prototype Ary1D: sw-calibration-access=READ-WRITE, type=Ary1D_u32_512
    Cnt1
      parameter data prototype Val: sw-calibration-access=READ-WRITE, type=Cnt5
    Cnt2
      parameter data prototype Val: sw-calibration-access=READ-WRITE, type=uint16
    Cnt3
      parameter data prototype Val: sw-calibration-access=READ-WRITE, type=uint8
    Cnt4
      parameter data prototype Val: sw-calibration-access=READ-WRITE, type=Cnt9
    Cnt5
      parameter data prototype Val: sw-calibration-access=READ-WRITE, type=Cnt10
    Cnt6
      parameter data prototype Val: sw-calibration-access=READ-WRITE, type=Cnt14
    CntAry1D1
      parameter data prototype Ary1D: sw-calibration-access=READ-WRITE, type=CntAry1D1
    CntAry1D2
      parameter data prototype Ary1D: sw-calibration-access=READ-WRITE, type=CntAry1D4
    Curr1
      parameter data prototype Val: sw-calibration-access=READ-WRITE, type=Curr2
    Curr2
      parameter data prototype Val: sw-calibration-access=READ-WRITE, type=Curr3
    Frq1
      parameter data prototype Val: sw-calibration-access=READ-WRITE, type=Frq1
    Frq2
      parameter data prototype Val: sw-calibration-access=READ-WRITE, type=Frq2
    FrqAry1D1
      parameter data prototype Ary1D: sw-calibration-access=READ-WRITE, type=FrqAry1D1
    FrqAry1D2
      parameter data prototype Ary1D: sw-calibration-access=READ-WRITE, type=FrqAry1D2
    FrqAry1D3
      parameter data prototype Ary1D: sw-calibration-access=READ-WRITE, type=FrqAry1D3
    FrqAry1D4
      parameter data prototype Ary1D: sw-calibration-access=READ-WRITE, type=FrqAry1D4
    Gain1
      parameter data prototype Val: sw-calibration-access=READ-WRITE, type=Gain1
    Gain2
      parameter data prototype Val: sw-calibration-access=READ-WRITE, type=Gain2
    Gain3
      parameter data prototype Val: sw-calibration-access=READ-WRITE, type=Gain3
    Logl1
      parameter data prototype Logl: sw-calibration-access=READ-WRITE, type=Logl1
    R1
      parameter data prototype Val: sw-calibration-access=READ-WRITE, type=R1
    Rate1
      parameter data prototype Val: sw-calibration-access=READ-WRITE, type=Rate3
    Spd2
      parameter data prototype Val: sw-calibration-access=READ-WRITE, type=Spd3
    SpdAry1D1
      parameter data prototype Ary1D: sw-calibration-access=READ-WRITE, type=SpdAry1D1
    T1
      parameter data prototype Val: sw-calibration-access=READ-WRITE, type=T1
    T2
      parameter data prototype Val: sw-calibration-access=READ-WRITE, type=T2
    T3
      parameter data prototype Val: sw-calibration-access=READ-WRITE, type=T4
    Ti1
      parameter data prototype Val: sw-calibration-access=READ-WRITE, type=Ti1
    Ti2
      parameter data prototype Val: sw-calibration-access=READ-WRITE, type=Ti2
    Ti3
      parameter data prototype Val: sw-calibration-access=READ-WRITE, type=Ti3
    Ti4
      parameter data prototype Val: sw-calibration-access=READ-WRITE, type=Ti4
    Ti5
      parameter data prototype Val: sw-calibration-access=READ-WRITE, type=Ti5
    Ti6
      parameter data prototype Val: sw-calibration-access=READ-WRITE, type=Ti6
    Ti7
      parameter data prototype Val: sw-calibration-access=READ-WRITE, type=Ti10
    Ti8
      parameter data prototype Val: sw-calibration-access=READ-WRITE, type=Ti11
    Tq1
      parameter data prototype Val: sw-calibration-access=READ-WRITE, type=Tq3
    Tq2
      parameter data prototype Val: sw-calibration-access=READ-WRITE, type=Tq10
    TqAry2D1
      parameter data prototype Ary2D: sw-calibration-access=READ-WRITE, type=TqAry2D1
    TqAry2D2
      parameter data prototype Ary2D: sw-calibration-access=READ-WRITE, type=TqAry2D2
    TqAry2D3
      parameter data prototype Ary2D: sw-calibration-access=READ-WRITE, type=TqAry2D3
    TqAry2D4
      parameter data prototype Ary2D: sw-calibration-access=READ-WRITE, type=TqAry2D4
    TqAry2D5
      parameter data prototype Ary2D: sw-calibration-access=READ-WRITE, type=TqAry2D5
    Uls1
      parameter data prototype Val: sw-calibration-access=READ-WRITE, type=Uls1
    Uls2
      parameter data prototype Val: sw-calibration-access=READ-WRITE, type=Uls7
    Uls3
      parameter data prototype Val: sw-calibration-access=READ-WRITE, type=Uls9
    Uls4
      parameter data prototype Val: sw-calibration-access=READ-WRITE, type=Uls2
    Uls5
      parameter data prototype Val: sw-calibration-access=READ-WRITE, type=Uls10
    UlsAry1D1
      parameter data prototype Ary1D: sw-calibration-access=READ-WRITE, type=UlsAry1D2
    UlsAry2D1
      parameter data prototype Ary2D: sw-calibration-access=READ-WRITE, type=UlsAry2D1
    Vel1
      parameter data prototype Val: sw-calibration-access=READ-WRITE, type=Vel2
    VelAry1D1
      parameter data prototype Ary1D: sw-calibration-access=READ-WRITE, type=VelAry1D1
    Volt1
      parameter data prototype Val: sw-calibration-access=READ-WRITE, type=Volt1
    Volt10
      parameter data prototype Val: sw-calibration-access=READ-WRITE, type=Volt16
    Volt2
      parameter data prototype Val: sw-calibration-access=READ-WRITE, type=Volt3
    Volt3
      parameter data prototype Val: sw-calibration-access=READ-WRITE, type=Volt4
    Volt4
      parameter data prototype Val: sw-calibration-access=READ-WRITE, type=Volt8
    Volt5
      parameter data prototype Val: sw-calibration-access=READ-WRITE, type=Volt10
    Volt6
      parameter data prototype Val: sw-calibration-access=READ-WRITE, type=Volt9
    Volt7
      parameter data prototype Val: sw-calibration-access=READ-WRITE, type=Volt11
    Volt8
      parameter data prototype Val: sw-calibration-access=READ-WRITE, type=Volt12
    Volt9
      parameter data prototype Val: sw-calibration-access=READ-WRITE, type=Volt13
    VoltTi1
      parameter data prototype Val: sw-calibration-access=READ-WRITE, type=VoltTi2
package /Nexteer/PortInterfaces
  32 x client server interface:
    Adc1CfgAndUseAdc1EnaCnvn1
      operation Oper
    CurrMeasEolGainReq1
      operation Oper: possible-error=CurrMeasEolGainReq1/E_NOT_OK
      error E_NOT_OK: error-code=1
    CurrMeasEolGainStReq1
      operation Oper: possible-error=CurrMeasEolGainStReq1/E_NOT_OK
        arg CurrMeasEolGainSt: type=Cnt12, direction=OUT
      error E_NOT_OK: error-code=1
    CurrMeasEolOffsReq1
      operation Oper: possible-error=CurrMeasEolOffsReq1/E_NOT_OK
      error E_NOT_OK: error-code=1
    CurrMeasEolOffsStReq1
      operation Oper: possible-error=CurrMeasEolOffsStReq1/E_NOT_OK
        arg CurrMeasEolOffsSt: type=Cnt12, direction=OUT
      error E_NOT_OK: error-code=1
    DmaEna2MilliSecToMotCtrlTrf1
      operation Oper
    DmaEna2msToMotCtrlTrf
      operation Oper
    DmaWaitForMotCtrlTo2MilliSecTrf1
      operation Oper: possible-error=DmaWaitForMotCtrlTo2MilliSecTrf1/E_NOT_OK
      error E_NOT_OK: error-code=1
    DmaWaitForMotCtrlTo2msTrf
      operation Oper: possible-error=DmaWaitForMotCtrlTo2msTrf/E_NOT_OK
      error E_NOT_OK: error-code=1
    FltInj1
      operation Oper: possible-error=FltInj1/E_NOT_OK
        arg SigPah: type=Uls5, direction=INOUT
        arg LocnKey: type=Cnt16, direction=IN
      error E_NOT_OK: error-code=1
    GetNtcActv1
      operation Oper: possible-error=GetNtcActv1/E_NOT_OK
        arg NtcNr: type=NtcNr1, direction=IN
        arg NtcActv: type=boolean, direction=OUT
      error E_NOT_OK: error-code=1
    GetNtcQlfrSts1
      operation Oper: possible-error=GetNtcQlfrSts1/E_NOT_OK
        arg NtcNr: type=NtcNr1, direction=IN
        arg NtcQlfr: type=SigQlfr1, direction=OUT
      error E_NOT_OK: error-code=1
    GetNtcSts1
      operation Oper: possible-error=GetNtcSts1/E_NOT_OK
        arg NtcNr: type=NtcNr1, direction=IN
        arg NtcInfoSts: type=uint8, direction=OUT
      error E_NOT_OK: error-code=1
    GetRefTmr100MicroSec32bit1
      operation Oper
        arg RefTmr: type=uint32, direction=OUT
    GetRefTmr1MicroSec32bit1
      operation Oper
        arg RefTmr: type=uint32, direction=OUT
    GetTiSpan100MicroSec32bit1
      operation Oper
        arg RefTmr: type=uint32, direction=IN
        arg TiSpan: type=uint32, direction=OUT
    GetTiSpan1MicroSec32bit1
      operation Oper
        arg RefTmr: type=uint32, direction=IN
        arg TiSpan: type=uint32, direction=OUT
    MotAg0MeasMotAg0CorrnTblClr1
      operation Oper
    MotAg0MeasMotAg0CorrnTblRead1
      operation Oper
        arg MotAg0MeasMotAg0CorrnTblCrc: type=Cnt16, direction=OUT
    MotAg0MeasMotAg0CorrnTblSegRead1
      operation Oper
        arg MotAg0MeasMotAg0CorrnTblSegReadData: type=CntAry1D3, direction=OUT
        arg MotAg0MeasMotAg0CorrnTblSegRead: type=Cnt13, direction=IN
    MotAg0MeasMotAg0CorrnTblSegUpd1
      operation Oper
        arg MotAg0MeasMotAg0CorrnTblSegWrData: type=CntAry1D3, direction=IN
        arg MotAg0MeasMotAg0CorrnTblSegWr: type=Cnt13, direction=IN
        arg MotAg0MeasMotAg0CorrnTblSegUpdResp: type=Cnt25, direction=OUT
    MotAg0MeasMotAg0CorrnTblWr1
      operation Oper
        arg MotAg0MeasMotAg0CorrnTblCrc: type=Cnt16, direction=IN
        arg MotAg0MeasMotAg0CorrnTblWrResp: type=Cnt25, direction=OUT
    MotAgCmpBackEmfRead1
      operation Oper: possible-error=MotAgCmpBackEmfRead1/E_NOT_OK
        arg MotAgBackEmfRead: type=Ag9, direction=OUT
      error E_NOT_OK: error-code=1
    MotAgCmpBackEmfWr1
      operation Oper: possible-error=MotAgCmpBackEmfWr1/E_NOT_OK
        arg MotAgCmpBackEmfWrData: type=Ag9, direction=IN
      error E_NOT_OK: error-code=1
    PolarityCfgRead1
      operation Oper: possible-error=PolarityCfgRead1/E_NOT_OK
        arg PolarityCfgSaved: type=Cnt15, direction=OUT
      error E_NOT_OK: error-code=1
    PolarityCfgWr1
      operation Oper: possible-error=PolarityCfgWr1/E_NOT_OK
        arg PolarityCfgSaved: type=Cnt15, direction=IN
      error E_NOT_OK: error-code=1
    ReadNtcFltAry1
      operation Oper: possible-error=ReadNtcFltAry1/E_NOT_OK
        arg DiagcMgrNtcFltAry: type=NtcFltInfoRec1, direction=OUT
      error E_NOT_OK: error-code=1
    SetFctGpio1
      operation Oper: possible-error=SetFctGpio1/E_NOT_OK
      error E_NOT_OK: error-code=1
    SetFctPeriph1
      operation Oper: possible-error=SetFctPeriph1/E_NOT_OK
      error E_NOT_OK: error-code=1
    SetGpio1
      operation Oper: possible-error=SetGpio1/E_NOT_OK
        arg PinSt: type=boolean, direction=IN
      error E_NOT_OK: error-code=1
    SetManTqCmd1
      operation Oper: possible-error=SetManTqCmd1/E_NOT_OK
        arg ManTqCmd: type=Tq1, direction=IN
        arg ManTqCmdEna: type=boolean, direction=IN
      error E_NOT_OK: error-code=1
    SetNtcSts1
      operation Oper: possible-error=SetNtcSts1/E_NOT_OK
        4 x arg, all with direction=IN:
          NtcNr: type=NtcNr1
          NtcStInfo: type=uint8
          NtcSts: type=NtcSts1
          DebStep: type=uint16
      error E_NOT_OK: error-code=1
  64 x sender receiver interface:
    Ag1: invalidation-policy{data-element=Ag1/Val, handle-invalid=DONT-INVALIDATE}
      data Val: sw-calibration-access=READ-ONLY, type=Ag2
    Ag2: invalidation-policy{data-element=Ag2/Val, handle-invalid=DONT-INVALIDATE}
      data Val: sw-calibration-access=READ-ONLY, type=Ag5
    Ag3: invalidation-policy{data-element=Ag3/Val, handle-invalid=DONT-INVALIDATE}
      data Val: sw-calibration-access=READ-ONLY, type=Ag7
    Ag4: invalidation-policy{data-element=Ag4/Val, handle-invalid=DONT-INVALIDATE}
      data Val: sw-calibration-access=READ-ONLY, type=Ag8
    Ag5: invalidation-policy{data-element=Ag5/Val, handle-invalid=DONT-INVALIDATE}
      data Val: sw-calibration-access=READ-ONLY, type=Ag12
    AgAry1D1: invalidation-policy{data-element=AgAry1D1/Ary1D, handle-invalid=DONT-INVALIDATE}
      data Ary1D: sw-calibration-access=READ-ONLY, type=AgAry1D2
    BattSwdVltgCorrlnSts1: invalidation-policy{data-element=BattSwdVltgCorrlnSts1/Val, handle-invalid=DONT-INVALIDATE}
      data Val: sw-calibration-access=READ-ONLY, type=BattSwdVltgCorrlnSts1
    Cnt1: invalidation-policy{data-element=Cnt1/Val, handle-invalid=DONT-INVALIDATE}
      data Val: sw-calibration-access=READ-ONLY, type=Cnt1
    Cnt10: invalidation-policy{data-element=Cnt10/Val, handle-invalid=DONT-INVALIDATE}
      data Val: sw-calibration-access=READ-ONLY, type=Cnt16
    Cnt11: invalidation-policy{data-element=Cnt11/Val, handle-invalid=DONT-INVALIDATE}
      data Val: sw-calibration-access=READ-ONLY, type=Cnt17
    Cnt12: invalidation-policy{data-element=Cnt12/Val, handle-invalid=DONT-INVALIDATE}
      data Val: sw-calibration-access=READ-ONLY, type=Cnt22
    Cnt13: invalidation-policy{data-element=Cnt13/Val, handle-invalid=DONT-INVALIDATE}
      data Val: sw-calibration-access=READ-ONLY, type=Cnt13
    Cnt14: invalidation-policy{data-element=Cnt14/Val, handle-invalid=DONT-INVALIDATE}
      data Val: sw-calibration-access=READ-ONLY, type=Cnt19
    Cnt2: invalidation-policy{data-element=Cnt2/Val, handle-invalid=DONT-INVALIDATE}
      data Val: sw-calibration-access=READ-ONLY, type=Cnt2
    Cnt3: invalidation-policy{data-element=Cnt3/Val, handle-invalid=DONT-INVALIDATE}
      data Val: sw-calibration-access=READ-ONLY, type=Cnt3
    Cnt4: invalidation-policy{data-element=Cnt4/Val, handle-invalid=DONT-INVALIDATE}
      data Val: sw-calibration-access=READ-ONLY, data-constr=p0pt0_p31pt0, type=Cnt4
    Cnt5: invalidation-policy{data-element=Cnt5/Val, handle-invalid=DONT-INVALIDATE}
      data Val: sw-calibration-access=READ-ONLY, type=Cnt5
    Cnt6: invalidation-policy{data-element=Cnt6/Val, handle-invalid=DONT-INVALIDATE}
      data Val: sw-calibration-access=READ-ONLY, type=uint8
    Cnt7: invalidation-policy{data-element=Cnt7/Val, handle-invalid=DONT-INVALIDATE}
      data Val: sw-calibration-access=READ-ONLY, type=Cnt6
    Cnt8: invalidation-policy{data-element=Cnt8/Val, handle-invalid=DONT-INVALIDATE}
      data Val: sw-calibration-access=READ-ONLY, type=Cnt7
    Cnt9: invalidation-policy{data-element=Cnt9/Val, handle-invalid=DONT-INVALIDATE}
      data Val: sw-calibration-access=READ-ONLY, type=uint32
    CntAry1D1: invalidation-policy{data-element=CntAry1D1/Ary1D, handle-invalid=DONT-INVALIDATE}
      data Ary1D: sw-calibration-access=READ-ONLY, type=CntAry1D2
    Curr1: invalidation-policy{data-element=Curr1/Val, handle-invalid=DONT-INVALIDATE}
      data Val: sw-calibration-access=READ-ONLY, type=Curr1
    Frq1: invalidation-policy{data-element=Frq1/Val, handle-invalid=DONT-INVALIDATE}
      data Val: sw-calibration-access=READ-ONLY, type=Frq1
    Indu1: invalidation-policy{data-element=Indu1, handle-invalid=DONT-INVALIDATE}  # OBSOLETE
      data Indu1: sw-calibration-access=READ-ONLY, type=Indu1
    Indu2: invalidation-policy{data-element=Indu2/Val, handle-invalid=DONT-INVALIDATE}
      data Val: sw-calibration-access=READ-ONLY, type=Indu1
    Logl1: invalidation-policy{data-element=Logl1/Logl, handle-invalid=DONT-INVALIDATE}
      data Logl: sw-calibration-access=READ-ONLY, type=boolean
    Logl2: invalidation-policy{data-element=Logl2/Logl, handle-invalid=DONT-INVALIDATE}
      data Logl: sw-calibration-access=READ-ONLY, type=Logl1
    MotCurrEolCalSt1: invalidation-policy{data-element=MotCurrEolCalSt1/Val, handle-invalid=DONT-INVALIDATE}
      data Val: sw-calibration-access=READ-ONLY, type=MotCurrEolCalSt1
    MotCurrEolCalSt2: invalidation-policy{data-element=MotCurrEolCalSt2/Val, handle-invalid=DONT-INVALIDATE}
      data Val: sw-calibration-access=READ-ONLY, type=MotCurrEolCalSt2
    MotQuad1: invalidation-policy{data-element=MotQuad1/Val, handle-invalid=DONT-INVALIDATE}
      data Val: sw-calibration-access=READ-ONLY, type=MotQuad1
    R1: invalidation-policy{data-element=R1/Val, handle-invalid=DONT-INVALIDATE}
      data Val: sw-calibration-access=READ-ONLY, type=R2
    R2: invalidation-policy{data-element=R2/Val, handle-invalid=DONT-INVALIDATE}
      data Val: sw-calibration-access=READ-ONLY, type=R3
    R3: invalidation-policy{data-element=R3/Val, handle-invalid=DONT-INVALIDATE}
      data Val: sw-calibration-access=READ-ONLY, type=R4
    R4: invalidation-policy{data-element=R4/Val, handle-invalid=DONT-INVALIDATE}
      data Val: sw-calibration-access=READ-ONLY, type=R5
    Rate1: invalidation-policy{data-element=Rate1/Val, handle-invalid=DONT-INVALIDATE}
      data Val: type=Rate1
    SigQlfr1: invalidation-policy{data-element=SigQlfr1/Val, handle-invalid=DONT-INVALIDATE}
      data Val: sw-calibration-access=READ-ONLY, type=SigQlfr1
    Spd1: invalidation-policy{data-element=Spd1/Val, handle-invalid=DONT-INVALIDATE}
      data Val: sw-calibration-access=READ-ONLY, type=Spd1
    Spd2: invalidation-policy{data-element=Spd2/Val, handle-invalid=DONT-INVALIDATE}
      data Val: sw-calibration-access=READ-ONLY, type=Spd2
    StrtUpSt1: invalidation-policy{data-element=StrtUpSt1/Val, handle-invalid=DONT-INVALIDATE}
      data Val: sw-calibration-access=READ-ONLY, type=StrtUpSt1
    SysSt1: invalidation-policy{data-element=SysSt1/Val, handle-invalid=DONT-INVALIDATE}
      data Val: sw-calibration-access=READ-ONLY, type=SysSt1
    T1: invalidation-policy{data-element=T1/Val, handle-invalid=DONT-INVALIDATE}
      data Val: sw-calibration-access=READ-ONLY, type=T1
    T2: invalidation-policy{data-element=T2, handle-invalid=DONT-INVALIDATE}
      data T2: sw-calibration-access=READ-ONLY, type=T2
    T3: invalidation-policy{data-element=T3, handle-invalid=DONT-INVALIDATE}
      data T3: sw-calibration-access=READ-ONLY, type=T3
    T4: invalidation-policy{data-element=Element, handle-invalid=DONT-INVALIDATE}
      data Element: sw-calibration-access=READ-ONLY, type=T4
    Ti1: invalidation-policy{data-element=Ti1/Val, handle-invalid=DONT-INVALIDATE}
      data Val: sw-calibration-access=READ-ONLY, type=Ti1
    Ti3: invalidation-policy{data-element=Ti3/Val, handle-invalid=DONT-INVALIDATE}
      data Val: sw-calibration-access=READ-ONLY, type=Ti3
    Tq1: invalidation-policy{data-element=Tq1/Val, handle-invalid=DONT-INVALIDATE}
      data Val: sw-calibration-access=READ-ONLY, type=Tq1
    Tq2: invalidation-policy{data-element=Tq2/Val, handle-invalid=DONT-INVALIDATE}
      data Val: sw-calibration-access=READ-ONLY, type=Tq2
    Tq3: invalidation-policy{data-element=Tq3/Val, handle-invalid=DONT-INVALIDATE}
      data Val: sw-calibration-access=READ-ONLY, type=Tq3
    Tq4: invalidation-policy{data-element=Tq4/Val, handle-invalid=DONT-INVALIDATE}
      data Val: sw-calibration-access=READ-ONLY, type=Tq4
    Tq5: invalidation-policy{data-element=Tq5/Val, handle-invalid=DONT-INVALIDATE}
      data Val: sw-calibration-access=READ-ONLY, type=Tq8
    Tq6: invalidation-policy{data-element=Tq6/Val, handle-invalid=DONT-INVALIDATE}
      data Val: sw-calibration-access=READ-ONLY, type=Tq9
    Tq7: invalidation-policy{data-element=Tq7/Val, handle-invalid=DONT-INVALIDATE}
      data Val: sw-calibration-access=READ-ONLY, type=Tq10
    Uls2: invalidation-policy{data-element=Uls2/Val, handle-invalid=DONT-INVALIDATE}
      data Val: type=Uls2
    Uls3: invalidation-policy{data-element=Uls3/Val, handle-invalid=DONT-INVALIDATE}
      data Val: sw-calibration-access=READ-ONLY, type=Uls3
    Uls4: invalidation-policy{data-element=Uls4/Val, handle-invalid=DONT-INVALIDATE}
      data Val: sw-calibration-access=READ-ONLY, type=Uls6
    Vel1: invalidation-policy{data-element=Vel1/Val, handle-invalid=DONT-INVALIDATE}
      data Val: type=Vel1
    Vel2: invalidation-policy{data-element=Vel2/Val, handle-invalid=DONT-INVALIDATE}
      data Val: sw-calibration-access=READ-ONLY, type=Vel3
    Volt1: invalidation-policy{data-element=Volt1/Val, handle-invalid=DONT-INVALIDATE}
      data Val: sw-calibration-access=READ-ONLY, type=Volt1
    Volt2: invalidation-policy{data-element=Volt2/Val, handle-invalid=DONT-INVALIDATE}
      data Val: sw-calibration-access=READ-ONLY, type=Volt2
    Volt3: invalidation-policy{data-element=Volt3/Val, handle-invalid=DONT-INVALIDATE}
      data Val: sw-calibration-access=READ-ONLY, type=Volt3
    Volt4: invalidation-policy{data-element=Volt4/Val, handle-invalid=DONT-INVALIDATE}
      data Val: sw-calibration-access=READ-ONLY, type=Volt6
    Volt5: invalidation-policy{data-element=Volt5/Val, handle-invalid=DONT-INVALIDATE}
      data Val: sw-calibration-access=READ-ONLY, type=Volt7
