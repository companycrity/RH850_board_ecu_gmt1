AUTOSAR XML (schema 4-0-3)
standard types defined: float32_DataConstr, float64_DataConstr, sint16_DataConstr, sint32_DataConstr, sint8_DataConstr, uint16_DataConstr, uint32_DataConstr, uint8_DataConstr, boolean, float32, float64, sint16, sint32, sint8, uint16, uint32, uint8
package /Nexteer/DataTypeMappingSets
  data type mapping set Nexteer
    data-type-maps:
      application-data-type=FrqAry1D2, implementation-data-type=Ary1D_u10p6_4
      application-data-type=Spd2, implementation-data-type=u9p7
      application-data-type=Ag10, implementation-data-type=float32
      application-data-type=Ti3, implementation-data-type=uint32
      application-data-type=TqAry2D4, implementation-data-type=Ary2D_s4p11_12_20
      application-data-type=Tq8, implementation-data-type=float32
      application-data-type=Uls4, implementation-data-type=u2p14
      application-data-type=Cnt20, implementation-data-type=sint16
      application-data-type=Uls8, implementation-data-type=float32
      application-data-type=TqAry1D1, implementation-data-type=Ary1D_s4p11_20
      application-data-type=Ag12, implementation-data-type=float32
      application-data-type=Tq2, implementation-data-type=float32
      application-data-type=Gain3, implementation-data-type=float32
      application-data-type=Cnt15, implementation-data-type=uint32
      application-data-type=Cnt24, implementation-data-type=uint8
      application-data-type=T4, implementation-data-type=float32
      application-data-type=Ti5, implementation-data-type=uint32
      application-data-type=Volt6, implementation-data-type=float32
      application-data-type=Cnt25, implementation-data-type=uint8
      application-data-type=TqAry1D2, implementation-data-type=Ary1D_u8p8_20
      application-data-type=TqAry1D4, implementation-data-type=Ary1D_s4p11_20
      application-data-type=Cnt7, implementation-data-type=uint8
      application-data-type=Curr3, implementation-data-type=float32
      application-data-type=Ti6, implementation-data-type=uint32
      application-data-type=Gain2, implementation-data-type=float32
      application-data-type=Cnt12, implementation-data-type=uint8
      application-data-type=FrqAry1D4, implementation-data-type=Ary1D_u9p7_4
      application-data-type=Vel4, implementation-data-type=u11p5
      application-data-type=UlsAry1D2, implementation-data-type=Ary1D_u2p14_2
      application-data-type=Cnt5, implementation-data-type=uint16
      application-data-type=Ti2, implementation-data-type=uint32
      application-data-type=Ti7, implementation-data-type=float32
      application-data-type=Rate3, implementation-data-type=float32
      application-data-type=Volt1, implementation-data-type=float32
      application-data-type=VoltTi2, implementation-data-type=uint32
      application-data-type=Tq5, implementation-data-type=s4p11
      application-data-type=Logl1, implementation-data-type=boolean
      application-data-type=R1, implementation-data-type=float32
      application-data-type=Vel3, implementation-data-type=float32
      application-data-type=Volt2, implementation-data-type=float32
      application-data-type=Volt10, implementation-data-type=float32
      application-data-type=Volt8, implementation-data-type=float32
      application-data-type=Ti10, implementation-data-type=float32
      application-data-type=Cnt13, implementation-data-type=uint8
      application-data-type=Cnt6, implementation-data-type=uint8
      application-data-type=Cnt2, implementation-data-type=sint8
      application-data-type=Indu1, implementation-data-type=float32
      application-data-type=Cnt18, implementation-data-type=uint8
      application-data-type=Cnt9, implementation-data-type=uint16
      application-data-type=CntAry1D3, implementation-data-type=Ary1D_u16_257
      application-data-type=Uls7, implementation-data-type=float32
      application-data-type=Tq9, implementation-data-type=float32
      application-data-type=Uls5, implementation-data-type=float32
      application-data-type=TqAry1D3, implementation-data-type=Ary1D_u5p11_5
      application-data-type=Cnt14, implementation-data-type=uint8
      application-data-type=Curr2, implementation-data-type=float32
      application-data-type=T3, implementation-data-type=float32
      application-data-type=Frq3, implementation-data-type=u10p6
      application-data-type=Ag5, implementation-data-type=u0p16
      application-data-type=T1, implementation-data-type=float32
      application-data-type=CntAry1D4, implementation-data-type=Ary1D_u16p0_2
      application-data-type=Uls2, implementation-data-type=float32
      application-data-type=Rate2, implementation-data-type=float32
      application-data-type=UlsAry2D1, implementation-data-type=Ary2D_u2p14_12_5
      application-data-type=Gain4, implementation-data-type=float32
      application-data-type=Tq12, implementation-data-type=u5p11
      application-data-type=FrqAry1D1, implementation-data-type=Ary1D_u10p6_4
      application-data-type=TqAry2D3, implementation-data-type=Ary2D_u5p11_12_5
      application-data-type=CntAry1D1, implementation-data-type=Ary1D_u16p0_2
      application-data-type=Cnt23, implementation-data-type=u16p0
      application-data-type=Ag8, implementation-data-type=s15p16
      application-data-type=R4, implementation-data-type=float32
      application-data-type=UlsAry1D1, implementation-data-type=Ary1D_u2p14_5
      application-data-type=Cnt3, implementation-data-type=uint16
      application-data-type=Cnt17, implementation-data-type=uint32
      application-data-type=Uls10, implementation-data-type=float32
      application-data-type=Cnt10, implementation-data-type=uint16
      application-data-type=Ag1, implementation-data-type=float32
      application-data-type=R2, implementation-data-type=float32
      application-data-type=Ag2, implementation-data-type=float32
      application-data-type=FrqAry1D3, implementation-data-type=Ary1D_u9p7_4
      application-data-type=Spd1, implementation-data-type=float32
      application-data-type=Frq6, implementation-data-type=u9p7
      application-data-type=Cnt26, implementation-data-type=u16p0
      application-data-type=Volt9, implementation-data-type=float32
      application-data-type=TqAry2D5, implementation-data-type=Ary2D_u5p11_12_5
      application-data-type=Ag9, implementation-data-type=u0p16
      application-data-type=Uls6, implementation-data-type=float32
      application-data-type=Tq3, implementation-data-type=float32
      application-data-type=T2, implementation-data-type=float32
      application-data-type=VoltGain1, implementation-data-type=float32
      application-data-type=Rate1, implementation-data-type=float32
      application-data-type=Ag11, implementation-data-type=float32
      application-data-type=Volt12, implementation-data-type=float32
      application-data-type=Tq6, implementation-data-type=u8p8
      application-data-type=VoltTi1, implementation-data-type=uint32
      application-data-type=Uls3, implementation-data-type=sint8
      application-data-type=Volt15, implementation-data-type=float32
      application-data-type=Ti8, implementation-data-type=float32
      application-data-type=Curr4, implementation-data-type=float32
      application-data-type=R3, implementation-data-type=float32
      application-data-type=Cnt1, implementation-data-type=uint8
      application-data-type=Cnt19, implementation-data-type=uint8
      application-data-type=Tq10, implementation-data-type=float32
      application-data-type=Cnt4, implementation-data-type=uint16
      application-data-type=Frq1, implementation-data-type=float32
      application-data-type=Ti4, implementation-data-type=uint32
      application-data-type=Tq1, implementation-data-type=float32
      application-data-type=AgAry1D1, implementation-data-type=Ary1D_s2p13_1024
      application-data-type=Gain1, implementation-data-type=float32
      application-data-type=Ti11, implementation-data-type=float32
      application-data-type=Volt13, implementation-data-type=float32
      application-data-type=Frq4, implementation-data-type=u10p6
      application-data-type=Cnt22, implementation-data-type=uint8
      application-data-type=Ti9, implementation-data-type=uint32
      application-data-type=SpdAry1D1, implementation-data-type=Ary1D_u9p7_12
      application-data-type=Tq7, implementation-data-type=u5p11
      application-data-type=Vel2, implementation-data-type=float32
      application-data-type=Uls1, implementation-data-type=float32
      application-data-type=Ag7, implementation-data-type=s18p13
      application-data-type=Cnt16, implementation-data-type=uint16
      application-data-type=Volt5, implementation-data-type=float32
      application-data-type=TqAry2D1, implementation-data-type=Ary2D_s4p11_12_20
      application-data-type=Tq11, implementation-data-type=s4p11
      application-data-type=Curr1, implementation-data-type=float32
      application-data-type=Volt4, implementation-data-type=float32
      application-data-type=Volt3, implementation-data-type=float32
      application-data-type=AgAry1D3, implementation-data-type=Ary1D_s2p13_1025
      application-data-type=Ag3, implementation-data-type=float32
      application-data-type=R5, implementation-data-type=float32
      application-data-type=Cnt21, implementation-data-type=uint8
      application-data-type=Cnt11, implementation-data-type=uint16
      application-data-type=Spd3, implementation-data-type=float32
      application-data-type=Volt7, implementation-data-type=float32
      application-data-type=Volt11, implementation-data-type=float32
      application-data-type=AgAry1D2, implementation-data-type=Ary1D_u0p16_8
      application-data-type=Vel1, implementation-data-type=float32
      application-data-type=TqAry2D2, implementation-data-type=Ary2D_u8p8_12_20
      application-data-type=TqAry1D5, implementation-data-type=Ary1D_u5p11_5
      application-data-type=Frq5, implementation-data-type=u9p7
      application-data-type=Ag6, implementation-data-type=s18p13
      application-data-type=CntAry1D2, implementation-data-type=Ary1D_u32_8
      application-data-type=Curr5, implementation-data-type=float32
      application-data-type=Ag4, implementation-data-type=s2p13
      application-data-type=Volt14, implementation-data-type=float32
      application-data-type=Tq4, implementation-data-type=u5p11
      application-data-type=Volt17, implementation-data-type=float32
      application-data-type=Frq2, implementation-data-type=float32
      application-data-type=Ti1, implementation-data-type=uint32
      application-data-type=Volt16, implementation-data-type=float32
      application-data-type=Uls9, implementation-data-type=float32
      application-data-type=VelAry1D1, implementation-data-type=Ary1D_u11p5_4
      application-data-type=Cnt8, implementation-data-type=uint32
package /Nexteer/DataTypes
  26 x application array data type, all with category=ARRAY, sw-calibration-access=READ-ONLY:
    AgAry1D1
      element Element: category=VALUE, type=Ag4, array-size-semantics=FIXED-SIZE, max-number-of-elements=1024
    AgAry1D2
      element Element: category=VALUE, type=Ag5, array-size-semantics=FIXED-SIZE, max-number-of-elements=8
    AgAry1D3
      element Element: category=VALUE, type=Ag4, array-size-semantics=FIXED-SIZE, max-number-of-elements=1025
    CntAry1D1
      element Element: category=VALUE, type=Cnt23, array-size-semantics=FIXED-SIZE, max-number-of-elements=2
    CntAry1D2
      element Element: category=VALUE, type=Cnt15, array-size-semantics=FIXED-SIZE, max-number-of-elements=8
    CntAry1D3
      element Element: category=VALUE, type=Cnt16, array-size-semantics=FIXED-SIZE, max-number-of-elements=257
    CntAry1D4
      element Element: category=VALUE, type=Cnt26, array-size-semantics=FIXED-SIZE, max-number-of-elements=2
    FrqAry1D1
      element Element: category=VALUE, type=Frq3, array-size-semantics=FIXED-SIZE, max-number-of-elements=4
    FrqAry1D2
      element Element: category=VALUE, type=Frq4, array-size-semantics=FIXED-SIZE, max-number-of-elements=4
    FrqAry1D3
      element Element: category=VALUE, type=Frq5, array-size-semantics=FIXED-SIZE, max-number-of-elements=4
    FrqAry1D4
      element Element: category=VALUE, type=Frq6, array-size-semantics=FIXED-SIZE, max-number-of-elements=4
    SpdAry1D1
      element Element: category=VALUE, type=Spd2, array-size-semantics=FIXED-SIZE, max-number-of-elements=12
    TqAry1D1
      element Element: category=VALUE, type=Tq5, array-size-semantics=FIXED-SIZE, max-number-of-elements=20
    TqAry1D2
      element Element: category=VALUE, type=Tq6, array-size-semantics=FIXED-SIZE, max-number-of-elements=20
    TqAry1D3
      element Element: category=VALUE, type=Tq7, array-size-semantics=FIXED-SIZE, max-number-of-elements=5
    TqAry1D4
      element Element: category=VALUE, type=Tq11, array-size-semantics=FIXED-SIZE, max-number-of-elements=20
    TqAry1D5
      element Element: category=VALUE, type=Tq12, array-size-semantics=FIXED-SIZE, max-number-of-elements=5
    TqAry2D1
      element Element: category=ARRAY, type=TqAry1D1, array-size-semantics=FIXED-SIZE, max-number-of-elements=12
    TqAry2D2
      element Element: category=ARRAY, type=TqAry1D2, array-size-semantics=FIXED-SIZE, max-number-of-elements=12
    TqAry2D3
      element Element: category=ARRAY, type=TqAry1D3, array-size-semantics=FIXED-SIZE, max-number-of-elements=12
    TqAry2D4
      element Element: category=ARRAY, type=TqAry1D4, array-size-semantics=FIXED-SIZE, max-number-of-elements=12
    TqAry2D5
      element Element: category=ARRAY, type=TqAry1D5, array-size-semantics=FIXED-SIZE, max-number-of-elements=12
    UlsAry1D1
      element Element: category=VALUE, type=Uls4, array-size-semantics=FIXED-SIZE, max-number-of-elements=5
    UlsAry1D2
      element Element: category=VALUE, type=Uls4, array-size-semantics=FIXED-SIZE, max-number-of-elements=2
    UlsAry2D1
      element Element: category=ARRAY, type=UlsAry1D1, array-size-semantics=FIXED-SIZE, max-number-of-elements=12
    VelAry1D1
      element Element: category=VALUE, type=Vel4, array-size-semantics=FIXED-SIZE, max-number-of-elements=4
  127 x app type, all with sw-calibration-access=READ-ONLY:
    Ag1: category=VALUE, range phys 0..6.25, unit=MotDeg
    Ag10: category=VALUE, range phys 0..6.2832, unit=MotRad
    Ag11: category=VALUE, range phys 10..40, unit=MotDeg/HwDeg
    Ag12: category=VALUE, range phys -1.62..1.62, unit=MotRad
    Ag2: category=VALUE, range phys -11796480..11796480, unit=MotDeg
    Ag3: category=VALUE, range phys 0..0.999, unit=MotRevElec
    Ag4: category=VALUE, compu {raw=phys*8192 for phys 0; unit FixdPt}, range phys -0.05555555556..0.05555555556, unit=MotRev
    Ag5: category=VALUE, compu {raw=phys*65536 for phys 0; unit FixdPt}, range phys 0..0.9999847412, unit=MotRev
    Ag6: category=VALUE, compu {raw=phys*8192 for phys 0; unit FixdPt}, range phys 0..6.25, unit=MotDeg
    Ag7: category=VALUE, compu {raw=phys*8192 for phys 0; unit FixdPt}, range phys -262144..262143.9998, unit=MotDeg
    Ag8: category=VALUE, compu {raw=phys*65536 for phys 0; unit FixdPt}, range phys -32768..32767.999984741, unit=MotRev
    Ag9: category=VALUE, compu {raw=phys*65536 for phys 0; unit FixdPt}, range phys 0..0.9999847412, unit=MotRevElec
    Cnt1: category=VALUE, range phys 1..4, unit=Cnt
    Cnt10: category=VALUE, range phys 1..10000, unit=Cnt
    Cnt11: category=VALUE, range phys 0..10000, unit=Cnt
    Cnt12: category=VALUE, range phys 0..3, unit=Cnt
    Cnt13: category=VALUE, range phys 0..3, unit=Cnt
    Cnt14: category=VALUE, range phys 2..12, unit=Cnt
    Cnt15: category=VALUE, range phys 0..4294967295, unit=Cnt
    Cnt16: category=VALUE, range phys 0..65535, unit=Cnt
    Cnt17: category=VALUE, range phys 0..67108863, unit=Cnt
    Cnt18: category=VALUE, range phys 0..31, unit=Cnt
    Cnt19: category=VALUE, range phys 0..255, unit=Cnt
    Cnt2: category=VALUE, range phys -1..1, unit=Cnt
    Cnt20: category=VALUE, range phys -512..511, unit=Cnt
    Cnt21: category=VALUE, range phys 1..3, unit=Cnt
    Cnt22: category=VALUE, range phys 0..7, unit=Cnt
    Cnt23: category=VALUE, range phys 0..100, unit=Cnt
    Cnt24: category=VALUE, range phys 0..42, unit=Cnt
    Cnt25: category=VALUE, range phys 0..2, unit=Cnt
    Cnt26: category=VALUE, range phys 0..200, unit=Cnt
    Cnt3: category=VALUE, range phys 0..1, unit=Cnt
    Cnt4: category=VALUE, range phys 0..31, unit=Cnt
    Cnt5: category=VALUE, range phys 0..32767, unit=Cnt
    Cnt6: category=VALUE, range phys 0..63, unit=Cnt
    Cnt7: category=VALUE, range phys 20..160, unit=Cnt
    Cnt8: category=VALUE, range phys 0..1800, unit=Cnt
    Cnt9: category=VALUE, range phys 1..1000, unit=Cnt
    Curr1: category=VALUE, range phys -145..145, unit=Amp
    Curr2: category=VALUE, range phys 0..50, unit=Amp
    Curr3: category=VALUE, range phys 10..100, unit=Amp
    Curr4: category=VALUE, range phys -450..450, unit=Amp
    Curr5: category=VALUE, range phys -1000..1000, unit=Amp
    Frq1: category=VALUE, range phys 0.1..10, unit=Hz
    Frq2: category=VALUE, range phys 1..200, unit=Hz
    Frq3: category=VALUE, compu {raw=phys*64 for phys 0; unit FixdPt}, range phys 0..750, unit=Hz
    Frq4: category=VALUE, compu {raw=phys*64 for phys 0; unit FixdPt}, range phys 0..1000, unit=Hz
    Frq5: category=VALUE, compu {raw=phys*128 for phys 0; unit FixdPt}, range phys 0..500, unit=Hz
    Frq6: category=VALUE, compu {raw=phys*128 for phys 0; unit FixdPt}, range phys 0..400, unit=Hz
    Gain1: category=VALUE, range phys 0..200, unit=degC/Volt
    Gain2: category=VALUE, range phys 70..76, unit=Amp/V
    Gain3: category=VALUE, range phys 56..60, unit=Amp/V
    Gain4: category=VALUE, range phys 0..76, unit=Amp/V
    Indu1: category=VALUE, range phys 3e-05..0.00041, unit=H
    Logl1: category=BOOLEAN, range phys 0..1
    R1: category=VALUE, range phys 0..0.2, unit=ohm
    R2: category=VALUE, range phys 0..45, unit=ohm
    R3: category=VALUE, range phys 0..2.25, unit=ohm
    R4: category=VALUE, range phys 0..3.6, unit=ohm
    R5: category=VALUE, range phys 0.005..0.125, unit=ohm
    Rate1: category=VALUE, range phys 0.1..500, unit=Uls/S
    Rate2: category=VALUE, range phys 0..500, unit=Uls/S
    Rate3: category=VALUE, range phys 0..1000, unit=Uls/S
    Spd1: category=VALUE, range phys 0..511, unit=kph
    Spd2: category=VALUE, compu {raw=phys*128 for phys 0; unit FixdPt}, range phys 0..511, unit=kph
    Spd3: category=VALUE, range phys 0..255, unit=kph
    T1: category=VALUE, range phys -50..150, unit=degC
    T2: category=VALUE, range phys -50..200, unit=degC
    T3: category=VALUE, range phys -50..300, unit=degC
    T4: category=VALUE, range phys -100..150, unit=degC
    Ti1: category=VALUE, range phys 0..25000, unit=nS
    Ti10: category=VALUE, range phys 0..0.0002, unit=sec
    Ti11: category=VALUE, range phys 9.1e-05..0.000143, unit=sec
    Ti2: category=VALUE, range phys 1..1000, unit=nS
    Ti3: category=VALUE, range phys 0..71429, unit=nS
    Ti4: category=VALUE, range phys 55555..71429, unit=nS
    Ti5: category=VALUE, range phys 6666..8572, unit=nS
    Ti6: category=VALUE, range phys 0..30000, unit=nS
    Ti7: category=VALUE, range phys 0..4295, unit=uS
    Ti8: category=VALUE, range phys 0..71429, unit=nS
    Ti9: category=VALUE, range phys 0..4294967295, unit=nS
    Tq1: category=VALUE, range phys -8.8..8.8, unit=MotNm
    Tq10: category=VALUE, range phys 0..8.8, unit=MotNm
    Tq11: category=VALUE, compu {raw=phys*2048 for phys 0; unit FixdPt}, range phys -1..15.99, unit=MotNm
    Tq12: category=VALUE, compu {raw=phys*2048 for phys 0; unit FixdPt}, range phys 0..8.8, unit=MotNm
    Tq2: category=VALUE, range phys -10..10, unit=HwNm
    Tq3: category=VALUE, range phys 0..8.8, unit=HwNm
    Tq4: category=VALUE, compu {raw=phys*2048 for phys 0; unit FixdPt}, range phys 0..8, unit=MotNm
    Tq5: category=VALUE, compu {raw=phys*2048 for phys 0; unit FixdPt}, range phys -10..10, unit=MotNm
    Tq6: category=VALUE, compu {raw=phys*256 for phys 0; unit FixdPt}, range phys 0..10, unit=HwNm
    Tq7: category=VALUE, compu {raw=phys*2048 for phys 0; unit FixdPt}, range phys 0..1.1, unit=MotNm
    Tq8: category=VALUE, range phys -3..3, unit=MotNm
    Tq9: category=VALUE, range phys -8..8, unit=MotNm
    Uls1: category=VALUE, range phys 0.5..1, unit=Uls
    Uls10: category=VALUE, range phys 0..20, unit=Uls
    Uls2: category=VALUE, range phys 0..1, unit=Uls
    Uls3: category=VALUE, range phys -1..1, unit=Uls
    Uls4: category=VALUE, compu {raw=phys*16384 for phys 0; unit FixdPt}, range phys 0..1, unit=Uls
    Uls5: category=VALUE, range phys -1000000000..1000000000, unit=Uls
    Uls6: category=VALUE, range phys 0..200, unit=Uls
    Uls7: category=VALUE, range phys -25..25, unit=Uls
    Uls8: category=VALUE, range phys -200..200, unit=Uls
    Uls9: category=VALUE, range phys 0.98..1, unit=Uls
    Vel1: category=VALUE, range phys -1350..1350, unit=MotRad/s
    Vel2: category=VALUE, range phys 0..1350, unit=MotRad/s
    Vel3: category=VALUE, range phys -42..42, unit=HwRad/s
    Vel4: category=VALUE, compu {raw=phys*32 for phys 0; unit FixdPt}, range phys 0..1350, unit=MotRad/s
    Volt1: category=VALUE, range phys 6..26.5, unit=V
    Volt10: category=VALUE, range phys 2.5..4.8, unit=V
    Volt11: category=VALUE, range phys 0.3..2.5, unit=V
    Volt12: category=VALUE, range phys 2.5..3, unit=V
    Volt13: category=VALUE, range phys 2..2.5, unit=V
    Volt14: category=VALUE, range phys 0..4800, unit=V
    Volt15: category=VALUE, range phys 0..48000, unit=V
    Volt16: category=VALUE, range phys 0..1, unit=V
    Volt17: category=VALUE, range phys -26.5..26.5, unit=V
    Volt2: category=VALUE, range phys 6..16, unit=V
    Volt3: category=VALUE, range phys 0..5, unit=V
    Volt4: category=VALUE, range phys 0..26.5, unit=V
    Volt5: category=VALUE, range phys 0..16, unit=V
    Volt6: category=VALUE, range phys 0..40, unit=V
    Volt7: category=VALUE, range phys 0.3..4.8, unit=V
    Volt8: category=VALUE, range phys 2.8..3, unit=V
    Volt9: category=VALUE, range phys 2..2.3, unit=V
    VoltGain1: category=VALUE, range phys -1..1, unit=VoltPerVoltNanoSec
    VoltTi1: category=VALUE, range phys 0..1040000, unit=VnS
    VoltTi2: category=VALUE, range phys 233330..1325008, unit=VnS
  47 x impl type:
    Ary1D_NtcFltInfoRec1_20: category=ARRAY, sw-calibration-access=READ-ONLY, type-emitter=RTE
      element Element: array-size=20, array-size-semantics=FIXED-SIZE, implementation-data-type=NtcFltInfoRec1
    Ary1D_NtcInfoRec1_512: category=ARRAY, sw-calibration-access=READ-ONLY, type-emitter=RTE
      element Element: array-size=512, array-size-semantics=FIXED-SIZE, implementation-data-type=NtcInfoRec1
    Ary1D_s2p13_1024: category=ARRAY, sw-calibration-access=READ-ONLY, type-emitter=RTE
      element Element: array-size=1024, array-size-semantics=FIXED-SIZE, implementation-data-type=s2p13
    Ary1D_s2p13_1025: category=ARRAY, sw-calibration-access=READ-ONLY, type-emitter=RTE
      element Element: array-size=1025, array-size-semantics=FIXED-SIZE, implementation-data-type=s2p13
    Ary1D_s4p11_20: category=ARRAY, sw-calibration-access=READ-ONLY, type-emitter=RTE
      element Element: array-size=20, array-size-semantics=FIXED-SIZE, implementation-data-type=s4p11
    Ary1D_u0p16_8: category=ARRAY, sw-calibration-access=READ-ONLY, type-emitter=RTE
      element Element: array-size=8, array-size-semantics=FIXED-SIZE, implementation-data-type=u0p16
    Ary1D_u10p6_4: category=ARRAY, sw-calibration-access=READ-ONLY, type-emitter=RTE
      element Element: array-size=4, array-size-semantics=FIXED-SIZE, implementation-data-type=u10p6
    Ary1D_u11p5_4: category=ARRAY, sw-calibration-access=READ-ONLY, type-emitter=RTE
      element Element: array-size=4, array-size-semantics=FIXED-SIZE, implementation-data-type=u11p5
    Ary1D_u16_257: category=ARRAY, sw-calibration-access=READ-ONLY, type-emitter=RTE
      element Element: array-size=257, array-size-semantics=FIXED-SIZE, implementation-data-type=uint16
    Ary1D_u16p0_2: category=ARRAY, sw-calibration-access=READ-ONLY, type-emitter=RTE
      element Element: array-size=2, array-size-semantics=FIXED-SIZE, implementation-data-type=u16p0
    Ary1D_u2p14_2: category=ARRAY, sw-calibration-access=READ-ONLY, type-emitter=RTE
      element Element: array-size=2, array-size-semantics=FIXED-SIZE, implementation-data-type=u2p14
    Ary1D_u2p14_5: category=ARRAY, sw-calibration-access=READ-ONLY, type-emitter=RTE
      element Element: array-size=5, array-size-semantics=FIXED-SIZE, implementation-data-type=u2p14
    Ary1D_u32_512: category=ARRAY, sw-calibration-access=READ-ONLY, type-emitter=RTE
      element Element: array-size=512, array-size-semantics=FIXED-SIZE, implementation-data-type=uint32
    Ary1D_u32_8: category=ARRAY, sw-calibration-access=READ-ONLY, type-emitter=RTE
      element Element: array-size=8, array-size-semantics=FIXED-SIZE, implementation-data-type=uint32
    Ary1D_u5p11_5: category=ARRAY, sw-calibration-access=READ-ONLY, type-emitter=RTE
      element Element: array-size=5, array-size-semantics=FIXED-SIZE, implementation-data-type=u5p11
    Ary1D_u8p8_20: category=ARRAY, sw-calibration-access=READ-ONLY, type-emitter=RTE
      element Element: array-size=20, array-size-semantics=FIXED-SIZE, implementation-data-type=u8p8
    Ary1D_u9p7_12: category=ARRAY, sw-calibration-access=READ-ONLY, type-emitter=RTE
      element Element: array-size=12, array-size-semantics=FIXED-SIZE, implementation-data-type=u9p7
    Ary1D_u9p7_4: category=ARRAY, sw-calibration-access=READ-ONLY, type-emitter=RTE
      element Element: array-size=4, array-size-semantics=FIXED-SIZE, implementation-data-type=u9p7
    Ary2D_s4p11_12_20: category=ARRAY, sw-calibration-access=READ-ONLY, type-emitter=RTE
      element Element: array-size=12, array-size-semantics=FIXED-SIZE, implementation-data-type=Ary1D_s4p11_20
    Ary2D_u2p14_12_5: category=ARRAY, sw-calibration-access=READ-ONLY, type-emitter=RTE
      element Element: array-size=12, array-size-semantics=FIXED-SIZE, implementation-data-type=Ary1D_u2p14_5
    Ary2D_u5p11_12_5: category=ARRAY, sw-calibration-access=READ-ONLY, type-emitter=RTE
      element Element: array-size=12, array-size-semantics=FIXED-SIZE, implementation-data-type=Ary1D_u5p11_5
    Ary2D_u8p8_12_20: category=ARRAY, sw-calibration-access=READ-ONLY, type-emitter=RTE
      element Element: array-size=12, array-size-semantics=FIXED-SIZE, implementation-data-type=Ary1D_u8p8_20
    BattSwdVltgCorrlnSts1: compu {0=BSVCS_NOFLT, 1=BSVCS_BATTVLTGSWD2FLT, 2=BSVCS_BATTVLTGSWD1FLT, 3=BSVCS_BATTVLTGFLT, 4=BSVCS_NOCORRLN}, implementation-data-type=uint8, type-emitter=RTE
    EOLGainOffs1: category=STRUCTURE, sw-calibration-access=READ-ONLY, type-emitter=RTE
      19 x element, all with category=TYPE_REFERENCE, implementation-data-type=float32:
        CurrMeasEolOffsHiBrdgVltg
        CurrMeasMotCurrEolGainA
        CurrMeasMotCurrEolGainB
        CurrMeasMotCurrEolGainC
        CurrMeasMotCurrEolGainD
        CurrMeasMotCurrEolGainE
        CurrMeasMotCurrEolGainF
        CurrMeasMotCurrEolOffsDifA
        CurrMeasMotCurrEolOffsDifB
        CurrMeasMotCurrEolOffsDifC
        CurrMeasMotCurrEolOffsDifD
        CurrMeasMotCurrEolOffsDifE
        CurrMeasMotCurrEolOffsDifF
        CurrMeasMotCurrOffsLoAvrgA
        CurrMeasMotCurrOffsLoAvrgB
        CurrMeasMotCurrOffsLoAvrgC
        CurrMeasMotCurrOffsLoAvrgD
        CurrMeasMotCurrOffsLoAvrgE
        CurrMeasMotCurrOffsLoAvrgF
      symbol props EOLGainOffs1
    FilLpRec1: category=STRUCTURE, sw-calibration-access=READ-ONLY, type-emitter=NxtrFil
      element FilSt: implementation-data-type=float32
      element FilGain: implementation-data-type=float32
      symbol props FilLpRec1
    MotCurrEolCalSt1: compu {1=MCECS_OFFSCMDHI, 2=MCECS_OFFSCMDLO, 3=MCECS_OFFSCMDZERO, 4=MCECS_OFFSCMDEND, 5=MCECS_GAINCMDAD, 6=MCECS_GAINCMDBE, 7=MCECS_GAINCMDCF, 8=MCECS_CMDSAFEST}, implementation-data-type=uint8, type-emitter=RTE
    MotCurrEolCalSt2: compu {0=MCECS_OFFSCMDSTRT, 1=MCECS_OFFSCMDHI, 2=MCECS_OFFSCMDLO, 3=MCECS_OFFSCMDZERO, 4=MCECS_OFFSCMDEND, 5=MCECS_GAINCMDAD, 6=MCECS_GAINCMDBE, 7=MCECS_GAINCMDCF, 8=MCECS_CMDSAFEST}, implementation-data-type=uint8, type-emitter=RTE
    MotQuad1: compu {1..4=MOTQUAD_QUAD1..MOTQUAD_QUAD4}, implementation-data-type=uint8, type-emitter=RTE
    NtcFltInfoRec1: category=STRUCTURE, sw-calibration-access=READ-ONLY, type-emitter=RTE
      4 x element, all with category=TYPE_REFERENCE:
        NtcNr: implementation-data-type=uint16
        AgiCntr: implementation-data-type=uint8
        Sts: implementation-data-type=uint8
        NtcStInfo: implementation-data-type=uint8
    NtcInfoRec1: category=STRUCTURE, sw-calibration-access=READ-ONLY, type-emitter=RTE
      element AgiCntr: implementation-data-type=uint8
      element Sts: implementation-data-type=uint8
      element NtcStInfo: implementation-data-type=uint8
    NtcNr1: compu {1..511=NTCNR_0X001..NTCNR_0X1FF}, implementation-data-type=uint16, type-emitter=RTE
    NtcSts1: compu {0=NTCSTS_PASSD, 1=NTCSTS_FAILD, 2=NTCSTS_PREPASSD, 3=NTCSTS_PREFAILD}, implementation-data-type=uint8, type-emitter=RTE
    s15p16: implementation-data-type=sint32, type-emitter=RTE
    s18p13: implementation-data-type=sint32, type-emitter=RTE
    s2p13: implementation-data-type=sint16, type-emitter=RTE
    s4p11: implementation-data-type=sint16, type-emitter=RTE
    SigQlfr1: compu {0=SIGQLFR_NORES, 1=SIGQLFR_PASSD, 2=SIGQLFR_FAILD}, implementation-data-type=uint8, type-emitter=RTE
    StrtUpSt1: compu {1=STRTUPST_PWRDISCNCTATESTCMPL, 2=STRTUPST_PWRDISCNCTBTESTCMPL, 3=STRTUPST_TMPLMONININTESTCMPL, 4=STRTUPST_MOTDRVRININCMPL, 5=STRTUPST_CURRMEASWRMININTESTCMPL, 6=STRTUPST_WARMININCMPL, 7=STRTUPST_RUN, 8=STRTUPST_DISABLE}, implementation-data-type=uint8, type-emitter=RTE
    SysSt1: compu {0=SYSST_DI, 1=SYSST_OFF, 2=SYSST_ENA, 3=SYSST_WRMININ}, implementation-data-type=uint8, type-emitter=RTE
    u0p16: implementation-data-type=uint16, type-emitter=RTE
    u10p6: implementation-data-type=uint16, type-emitter=RTE
    u11p5: implementation-data-type=uint16, type-emitter=RTE
    u16p0: implementation-data-type=uint16, type-emitter=RTE
    u2p14: implementation-data-type=uint16, type-emitter=RTE
    u5p11: implementation-data-type=uint16, type-emitter=RTE
    u8p8: implementation-data-type=uint16, type-emitter=RTE
    u9p7: implementation-data-type=uint16, type-emitter=RTE
package /Nexteer/Units
  65 x unit, all with factor-si-to-unit=1, offset-si-to-unit=0:
    Ampr: display-name=Amp
    AmprPerVolt: display-name=Amp/V
    AmprSqd: display-name=Amp^2
    Bar: display-name=bar
    Cnt: display-name=Cnt
    CntPerNanoSec: display-name=Cnt/nS
    DegCgrd: display-name=degC
    DegCgrdPerSec: display-name=degC/s
    DegCgrdPerVolt: display-name=degC/Volt
    DegCgrdPerWatt: display-name=degC/Watt
    FixdPt
    Henry: display-name=H
    HwDeg: display-name=HwDeg
    HwDegPerSec: display-name=HwDeg/s
    HwDegPerVolt: display-name=HwDeg/volt
    HwNwtMtr: display-name=HwNm
    HwNwtMtrPerHwDeg: display-name=HwNm/HwDeg
    HwNwtMtrPerMotNwtMtr: display-name=HwNm/MotNm
    HwRad: display-name=HwRad
    HwRadPerSec: display-name=HwRad/s
    Hz: display-name=Hz
    IvsHwNwtMtr: display-name=1/HwNm
    KiloGrMtrSqd: display-name=kgm^2
    KiloHz: display-name=kHz
    KiloMtrPerHr: display-name=KpH
    Kph: display-name=kph
    KphPerSecSqd: display-name=kph/s^2
    MicroSec: display-name=uS
    MilliSec: display-name=mS
    MotDeg: display-name=MotDeg
    MotDegElec: display-name=MotDegElec
    MotDegPerHwDeg: display-name=MotDeg/HwDeg
    MotDegPerSec: display-name=MotDeg/s
    MotNwtMtr: display-name=MotNm
    MotNwtMtrPerHwDegSec: display-name=MotNm/HwDegS
    MotNwtMtrPerHwNwtMtr: display-name=MotNm/HwNm
    MotNwtMtrPerMotDeg: display-name=MotNm/MotDeg
    MotNwtMtrPerMotRadPerSec: display-name=MotNm/MotRad/S
    MotNwtMtrPerRadPerSec: display-name=MotNM/Rad/s
    MotNwtMtrPerSec: display-name=MotNm/S
    MotRad: display-name=MotRad
    MotRadPerSec: display-name=MotRad/s
    MotRev: display-name=MotRev
    MotRevElec: display-name=MotRevElec
    Mtr: display-name=m
    MtrPerSec: display-name=m/s
    MtrPerSecSqd: display-name=m/s^2
    NanoSec: display-name=nS
    Ohm: display-name=ohm
    OhmPerDegCgrd: display-name=ohm/degC
    Rad: display-name=Radians  # Motor Positions
    Rec: display-name=rec
    Sec: display-name=sec
    TrsmNwtMtr: display-name=TrsmNm
    Uls: display-name=Uls
    UlsPerMilliSec: display-name=Uls/mS
    UlsPerSec: display-name=Uls/S
    Volt: display-name=V
    VoltNanoSec: display-name=VnS
    VoltPerCnt: display-name=Volt/Cnt
    VoltPerRadPerSec: display-name=V/Rad/s
    VoltPerRadPerSecPerDegCgrd: display-name=(V/Rad/S)/degC
    VoltPerSec: display-name=V/s
    VoltPerVoltNanoSec
    WattPerAmprSqd: display-name=Watt/A^2
