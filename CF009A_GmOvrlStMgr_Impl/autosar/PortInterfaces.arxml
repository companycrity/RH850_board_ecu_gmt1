AUTOSAR XML (schema 4-0-3)
package /Nexteer/Calibrations
  6 x parameter interface:
    Ary1D_u10p6_8_CalPortIf1
      parameter data prototype Ary1D: sw-calibration-access=READ-WRITE, type=Ary1D_u10p6_8
    Ary1D_u2p14_8_CalPortIf1
      parameter data prototype Ary1D: sw-calibration-access=READ-WRITE, type=Ary1D_u2p14_8
    boolean_CalPortIf1
      parameter data prototype Logl: sw-calibration-access=READ-WRITE, type=boolean
    float32_CalPortIf1
      parameter data prototype Val: sw-calibration-access=READ-WRITE, type=float32
    uint16_CalPortIf1
      parameter data prototype Val: sw-calibration-access=READ-WRITE, type=uint16
    uint32_CalPortIf1
      parameter data prototype Val: sw-calibration-access=READ-WRITE, type=uint32
package /Nexteer/NvMProxy_swc/Interfaces
  client server interface NvMService_AC3_SRBS: is-service=true
    6 x operation, all with possible-error=NvMService_AC3_SRBS/E_NOT_OK:
      EraseBlock
      GetErrorStatus
        arg ErrorStatus_Arg: type=NvM_RequestResultType, direction=OUT
      InvalidateNvBlock
      ReadBlock
        arg DstPtr_Arg: type=dtRef_VOID, direction=IN
      SetRamBlockStatus
        arg RamBlockStatus_Arg: type=boolean, direction=IN
      WriteBlock
        arg SrcPtr_Arg: type=dtRef_const_VOID, direction=IN
    error E_NOT_OK: error-code=1
package /Nexteer/PortInterfaces
  5 x client server interface:
    GetGmLoaIgnCntr_PortIf1
      operation Oper
        arg GmLoaIgnCntr_Arg: type=uint16, direction=OUT
    GetRefTmr100MicroSec32bit_PortIf1
      operation Oper
        arg RefTmr_Arg: type=uint32, direction=OUT
    GetTiSpan100MicroSec32bit_PortIf1
      operation Oper
        arg RefTmr_Arg: type=uint32, direction=IN
        arg TiSpan_Arg: type=uint32, direction=OUT
    SetGmLoaIgnCntr_PortIf1
      operation Oper
        arg GmLoaIgnCntr_Arg: type=uint16, direction=IN
    SetNtcSts_PortIf1
      operation Oper: possible-error=SetNtcSts_PortIf1/E_NOT_OK
        4 x arg, all with direction=IN:
          NtcNr_Arg: type=NtcNr1
          NtcStInfo_Arg: type=uint8
          NtcSts_Arg: type=NtcSts1
          DebStep_Arg: type=uint16
      error E_NOT_OK: error-code=1
  5 x sender receiver interface:
    boolean_PortIf1: invalidation-policy{data-element=Logl, handle-invalid=DONT-INVALIDATE}
      data Logl: sw-calibration-access=READ-ONLY, type=boolean
    float32_PortIf1: invalidation-policy{data-element=float32_PortIf1/Val, handle-invalid=DONT-INVALIDATE}
      data Val: sw-calibration-access=READ-ONLY, type=float32
    LoaSt1_PortIf1: invalidation-policy{data-element=LoaSt1_PortIf1/Val, handle-invalid=DONT-INVALIDATE}
      data Val: sw-calibration-access=READ-ONLY, type=LoaSt1
    SysSt1_PortIf1: invalidation-policy{data-element=SysSt1_PortIf1/Val, handle-invalid=DONT-INVALIDATE}
      data Val: sw-calibration-access=READ-ONLY, type=SysSt1
    uint8_PortIf1: invalidation-policy{data-element=uint8_PortIf1/Val, handle-invalid=DONT-INVALIDATE}
      data Val: sw-calibration-access=READ-ONLY, type=uint8
