AUTOSAR XML (schema 4-0-3)
package /Nexteer/PortInterfaces
  sender receiver interface Logl1: invalidation-policy{data-element=Logl, handle-invalid=DONT-INVALIDATE}
    data Logl: sw-calibration-access=READ-ONLY, type=boolean
  sender receiver interface Rate1: invalidation-policy{data-element=Rate1/Val, handle-invalid=DONT-INVALIDATE}
    data Val: type=Rate1
  sender receiver interface Uls2: invalidation-policy{data-element=Uls2/Val, handle-invalid=DONT-INVALIDATE}
    data Val: type=Uls2
