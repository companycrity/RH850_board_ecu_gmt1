AUTOSAR XML (schema 4-0-3)
standard types defined: float32_DataConstr, float64_DataConstr, sint16_DataConstr, sint32_DataConstr, sint8_DataConstr, uint16_DataConstr, uint32_DataConstr, uint8_DataConstr, boolean, float32, float64, sint16, sint32, sint8, uint16, uint32, uint8
package /Nexteer/DataTypeMappingSets
  data type mapping set Nexteer
    data-type-maps:
      application-data-type=Cnt7, implementation-data-type=uint8
      application-data-type=Volt12, implementation-data-type=float32
      application-data-type=AgAry1D1, implementation-data-type=Ary1D_s2p13_1024
      application-data-type=Uls1, implementation-data-type=float32
      application-data-type=Volt3, implementation-data-type=float32
      application-data-type=Uls2, implementation-data-type=float32
      application-data-type=Ti5, implementation-data-type=uint32
      application-data-type=Vel1, implementation-data-type=float32
      application-data-type=Volt9, implementation-data-type=float32
      application-data-type=Cnt10, implementation-data-type=uint16
      application-data-type=Gain1, implementation-data-type=float32
      application-data-type=Volt10, implementation-data-type=float32
      application-data-type=Ag3, implementation-data-type=float32
      application-data-type=T4, implementation-data-type=float32
      application-data-type=Volt14, implementation-data-type=float32
      application-data-type=Volt1, implementation-data-type=float32
      application-data-type=Ti6, implementation-data-type=uint32
      application-data-type=Cnt9, implementation-data-type=uint16
      application-data-type=Ti2, implementation-data-type=uint32
      application-data-type=T2, implementation-data-type=float32
      application-data-type=Rate1, implementation-data-type=float32
      application-data-type=Cnt14, implementation-data-type=uint8
      application-data-type=Cnt16, implementation-data-type=uint16
      application-data-type=Volt7, implementation-data-type=float32
      application-data-type=Cnt13, implementation-data-type=uint8
      application-data-type=Ag5, implementation-data-type=u0p16
      application-data-type=T3, implementation-data-type=float32
      application-data-type=Uls3, implementation-data-type=sint8
      application-data-type=Volt8, implementation-data-type=float32
      application-data-type=Volt11, implementation-data-type=float32
      application-data-type=Cnt6, implementation-data-type=uint8
      application-data-type=Ti1, implementation-data-type=uint32
      application-data-type=Gain4, implementation-data-type=float32
      application-data-type=Curr2, implementation-data-type=float32
      application-data-type=Cnt21, implementation-data-type=uint8
      application-data-type=VoltTi1, implementation-data-type=uint32
      application-data-type=T1, implementation-data-type=float32
      application-data-type=Gain2, implementation-data-type=float32
      application-data-type=Cnt1, implementation-data-type=uint8
      application-data-type=Ag2, implementation-data-type=float32
      application-data-type=Cnt2, implementation-data-type=sint8
      application-data-type=Ag1, implementation-data-type=float32
      application-data-type=Cnt19, implementation-data-type=uint8
      application-data-type=Gain3, implementation-data-type=float32
      application-data-type=Tq1, implementation-data-type=float32
      application-data-type=Volt6, implementation-data-type=float32
      application-data-type=Frq1, implementation-data-type=float32
      application-data-type=Curr1, implementation-data-type=float32
      application-data-type=Volt13, implementation-data-type=float32
      application-data-type=VoltGain1, implementation-data-type=float32
      application-data-type=Volt5, implementation-data-type=float32
      application-data-type=Volt4, implementation-data-type=float32
      application-data-type=Volt2, implementation-data-type=float32
      application-data-type=Cnt4, implementation-data-type=uint16
      application-data-type=Ti4, implementation-data-type=uint32
      application-data-type=Rate2, implementation-data-type=float32
      application-data-type=Tq2, implementation-data-type=float32
      application-data-type=Cnt11, implementation-data-type=uint16
      application-data-type=Curr3, implementation-data-type=float32
      application-data-type=Cnt15, implementation-data-type=uint32
      application-data-type=Ti3, implementation-data-type=uint32
      application-data-type=Spd1, implementation-data-type=float32
      application-data-type=Cnt17, implementation-data-type=uint32
      application-data-type=Ag4, implementation-data-type=s2p13
      application-data-type=Cnt3, implementation-data-type=uint16
      application-data-type=VoltTi2, implementation-data-type=uint32
      application-data-type=Vel2, implementation-data-type=float32
      application-data-type=Volt15, implementation-data-type=float32
      application-data-type=Cnt20, implementation-data-type=sint16
      application-data-type=Cnt18, implementation-data-type=uint8
      application-data-type=Cnt12, implementation-data-type=uint8
      application-data-type=Cnt5, implementation-data-type=uint16
      application-data-type=Cnt8, implementation-data-type=uint32
package /Nexteer/DataTypes
  application array data type AgAry1D1: category=ARRAY, sw-calibration-access=READ-ONLY
    element Element: category=VALUE, type=Ag4, array-size-semantics=FIXED-SIZE, max-number-of-elements=1024
  72 x app type, all with category=VALUE, sw-calibration-access=READ-ONLY:
    Ag1: range phys 0..6.25, unit=MotDeg
    Ag2: range phys -11796480..11796480, unit=MotDeg
    Ag3: range phys 0..0.999, unit=MotRevElec
    Ag4: compu {raw=phys*8192 for phys 0; unit FixdPt}, range phys -0.05555555556..0.05555555556, unit=MotRev
    Ag5: compu {raw=phys*65536 for phys 0; unit FixdPt}, range phys 0..0.9999847412, unit=MotRev
    Cnt1: range phys 1..4, unit=Cnt
    Cnt10: range phys 1..10000, unit=Cnt
    Cnt11: range phys 0..10000, unit=Cnt
    Cnt12: range phys 0..3, unit=Cnt
    Cnt13: range phys 0..3, unit=Cnt
    Cnt14: range phys 2..12, unit=Cnt
    Cnt15: range phys 0..4294967295, unit=Cnt
    Cnt16: range phys 0..65535, unit=Cnt
    Cnt17: range phys 0..67108863, unit=Cnt
    Cnt18: range phys 0..31, unit=Cnt
    Cnt19: range phys 0..255, unit=Cnt
    Cnt2: range phys -1..1, unit=Cnt
    Cnt20: range phys -512..511, unit=Cnt
    Cnt21: range phys 1..3, unit=Cnt
    Cnt3: range phys 0..1, unit=Cnt
    Cnt4: range phys 0..31, unit=Cnt
    Cnt5: range phys 0..32767, unit=Cnt
    Cnt6: range phys 0..63, unit=Cnt
    Cnt7: range phys 20..160, unit=Cnt
    Cnt8: range phys 0..1800, unit=Cnt
    Cnt9: range phys 1..1000, unit=Cnt
    Curr1: range phys -145..145, unit=Amp
    Curr2: range phys 0..50, unit=Amp
    Curr3: range phys 10..100, unit=Amp
    Frq1: range phys 0.1..10, unit=Hz
    Gain1: range phys 0..200, unit=degC/Volt
    Gain2: range phys 70..76, unit=Amp/V
    Gain3: range phys 56..60, unit=Amp/V
    Gain4: range phys 0..76, unit=Amp/V
    Rate1: range phys 0.1..500, unit=Uls/S
    Rate2: range phys 0..500, unit=Uls/S
    Spd1: range phys 0..511, unit=kph
    T1: range phys -50..150, unit=degC
    T2: range phys -50..200, unit=degC
    T3: range phys -50..300, unit=degC
    T4: range phys -100..150, unit=degC
    Ti1: range phys 0..25000, unit=nS
    Ti2: range phys 1..1000, unit=nS
    Ti3: range phys 0..71429, unit=nS
    Ti4: range phys 55555..71429, unit=nS
    Ti5: range phys 6666..8572, unit=nS
    Ti6: range phys 0..30000, unit=nS
    Tq1: range phys -8.8..8.8, unit=MotNm
    Tq2: range phys -10..10, unit=HwNm
    Uls1: range phys 0.5..1, unit=Uls
    Uls2: range phys 0..1, unit=Uls
    Uls3: range phys -1..1, unit=Uls
    Vel1: range phys -1350..1350, unit=MotRad/s
    Vel2: range phys 0..1350, unit=MotRad/s
    Volt1: range phys 6..26.5, unit=V
    Volt10: range phys 2.5..4.8, unit=V
    Volt11: range phys 0.3..2.5, unit=V
    Volt12: range phys 2.5..3, unit=V
    Volt13: range phys 2..2.5, unit=V
    Volt14: range phys 0..4800, unit=V
    Volt15: range phys 0..48000, unit=V
    Volt2: range phys 6..16, unit=V
    Volt3: range phys 0..5, unit=V
    Volt4: range phys 0..26.5, unit=V
    Volt5: range phys 0..16, unit=V
    Volt6: range phys 0..40, unit=V
    Volt7: range phys 0.3..4.8, unit=V
    Volt8: range phys 2.8..3, unit=V
    Volt9: range phys 2..2.3, unit=V
    VoltGain1: range phys -1..1, unit=VoltPerVoltNanoSec
    VoltTi1: range phys 0..1040000, unit=VnS
    VoltTi2: range phys 233330..1325008, unit=VnS
  impl type Ary1D_s2p13_1024: category=ARRAY, sw-calibration-access=READ-ONLY, type-emitter=RTE
    element Element: array-size=1024, array-size-semantics=FIXED-SIZE, implementation-data-type=s2p13
  impl type s2p13: implementation-data-type=sint16, type-emitter=RTE
  impl type u0p16: implementation-data-type=uint16, type-emitter=RTE
package /Nexteer/Units
  20 x unit, all with factor-si-to-unit=1, offset-si-to-unit=0:
    Ampr: display-name=Amp
    AmprPerVolt: display-name=Amp/V
    Cnt: display-name=Cnt
    DegCgrd: display-name=degC
    DegCgrdPerVolt: display-name=degC/Volt
    FixdPt
    HwNwtMtr: display-name=HwNm
    Hz: display-name=Hz
    Kph: display-name=kph
    MotDeg: display-name=MotDeg
    MotNwtMtr: display-name=MotNm
    MotRadPerSec: display-name=MotRad/s
    MotRev: display-name=MotRev
    MotRevElec: display-name=MotRevElec
    NanoSec: display-name=nS
    Uls: display-name=Uls
    UlsPerSec: display-name=Uls/S
    Volt: display-name=V
    VoltNanoSec: display-name=VnS
    VoltPerVoltNanoSec
