AUTOSAR XML (schema 4-0-3)
package /Nexteer/Calibrations
  4 x parameter interface:
    Cnt10
      parameter data prototype Val: sw-calibration-access=READ-WRITE, type=Cnt16
    Cnt11
      parameter data prototype Val: sw-calibration-access=READ-WRITE, type=Cnt30
    CntAry1D3
      parameter data prototype Ary1D: sw-calibration-access=READ-WRITE, type=CntAry1D5
    CntAry1D4
      parameter data prototype Ary1D: sw-calibration-access=READ-WRITE, type=CntAry1D6
package /Nexteer/NvMProxy_swc/Interfaces
  client server interface NvMService_AC3_SRBS_Defs: is-service=true
    7 x operation, all with possible-error=NvMService_AC3_SRBS_Defs/E_NOT_OK:
      EraseBlock
      GetErrorStatus
        arg ErrorStatus: type=NvM_RequestResultType, direction=OUT
      InvalidateNvBlock
      ReadBlock
        arg DstPtr: type=dtRef_VOID, direction=IN
      RestoreBlockDefaults
        arg DstPtr: type=dtRef_VOID, direction=IN
      SetRamBlockStatus
        arg RamBlockStatus: type=Boolean, direction=IN
      WriteBlock
        arg SrcPtr: type=dtRef_const_VOID, direction=IN
    error E_NOT_OK: error-code=1
package /Nexteer/PortInterfaces
  12 x client server interface:
    FltInj2
      operation Oper
        arg SigPah_Arg: type=Uls5, direction=INOUT
        arg LocnKey_Arg: type=Cnt16, direction=IN
    FltInj3
      operation Oper
        arg SigPah_Arg: type=Uls24, direction=INOUT
        arg LocnKey_Arg: type=Cnt16, direction=IN
    GetNtcQlfrSts1
      operation Oper: possible-error=GetNtcQlfrSts1/E_NOT_OK
        arg NtcNr: type=NtcNr1, direction=IN
        arg NtcQlfr: type=SigQlfr1, direction=OUT
      error E_NOT_OK: error-code=1
    GetRefTmr1MicroSec32bit1
      operation Oper
        arg RefTmr: type=uint32, direction=OUT
    GetTiSpan1MicroSec32bit1
      operation Oper
        arg RefTmr: type=uint32, direction=IN
        arg TiSpan: type=uint32, direction=OUT
    HwAgMeasHwAgAutTrim1
      operation Oper
    HwAgMeasHwAgClrTrim1
      operation Oper
    HwAgMeasHwAgReadTrim1
      operation Oper
        arg HwAgReadTrimData_Arg: type=Ag19, direction=OUT
    HwAgMeasHwAgTrimPrfmdSts1
      operation Oper
        arg HwAgOffsTrimPrfmdStsData_Arg: type=Logl1, direction=OUT
    HwAgMeasHwAgWrTrim1
      operation Oper
        arg HwAgWrOffsTrimData_Arg: type=Ag19, direction=IN
    SetFctPeriph_PortIf1
      operation Oper: possible-error=SetFctPeriph_PortIf1/E_NOT_OK
      error E_NOT_OK: error-code=1
    SetNtcSts1
      operation Oper: possible-error=SetNtcSts1/E_NOT_OK
        4 x arg, all with direction=IN:
          NtcNr: type=NtcNr1
          NtcStInfo: type=uint8
          NtcSts: type=NtcSts1
          DebStep: type=uint16
      error E_NOT_OK: error-code=1
  4 x sender receiver interface:
    Ag9: invalidation-policy{data-element=Ag9/Val, handle-invalid=DONT-INVALIDATE}
      data Val: sw-calibration-access=READ-ONLY, type=Ag19
    Cnt14: invalidation-policy{data-element=Cnt14/Val, handle-invalid=DONT-INVALIDATE}
      data Val: sw-calibration-access=READ-ONLY, type=Cnt19
    SigQlfr1: invalidation-policy{data-element=SigQlfr1/Val, handle-invalid=DONT-INVALIDATE}
      data Val: sw-calibration-access=READ-ONLY, type=SigQlfr1
    Uls3: invalidation-policy{data-element=Uls3/Val, handle-invalid=DONT-INVALIDATE}
      data Val: sw-calibration-access=READ-ONLY, type=Uls3
