AUTOSAR XML (schema 4-0-3)
package /ActiveEcuC
  ecuc value collection ActiveEcuC: ecuc-values=[MotCtrlMgr, Rte]
  module config MotCtrlMgr: implementation-config-variant=VARIANT-PRE-COMPILE
    MotCtrlMgrConfigSet
      SignalManagement
        42 x Signal, all with ReadIn2msRunnable=false:
          ReadMotCtrlWriteMotCtrlEnum: WrittenInMotCtrlRunnable=true, ReadInMotCtrlRunnable=true, WrittenIn2msRunnable=false, ImplementationDataType=uint8, Size=1, InitialValue=TestEnum_u08_Element3, Min=0, Max=255, Units=Cnt, EnumerationNameReference=TestEnum_u08
          ReadMotCtrlWriteMotCtrlbool: WrittenInMotCtrlRunnable=true, ReadInMotCtrlRunnable=true, WrittenIn2msRunnable=false, ImplementationDataType=boolean, Size=1, InitialValue=FALSE, Min=0, Max=1, Units=Cnt
          ReadMotCtrlWriteMotCtrlf32: WrittenInMotCtrlRunnable=true, ReadInMotCtrlRunnable=true, WrittenIn2msRunnable=false, ImplementationDataType=float32, Size=1, InitialValue=1.0F, Min=-8.8, Max=8.8, Units=MotNwtMtr
          ReadMotCtrlWriteMotCtrlf32Ary: WrittenInMotCtrlRunnable=true, ReadInMotCtrlRunnable=true, WrittenIn2msRunnable=false, ImplementationDataType=float32, Size=4, InitialValue=1.0F, 2.0F, 3.0F, 4.0F, Min=-8.8, Max=8.8, Units=MotNwtMtr
          ReadMotCtrlWriteMotCtrls08: WrittenInMotCtrlRunnable=true, ReadInMotCtrlRunnable=true, WrittenIn2msRunnable=false, ImplementationDataType=sint8, Size=1, InitialValue=-128, Min=-128, Max=127, Units=Cnt
          ReadMotCtrlWriteMotCtrls08Ary: WrittenInMotCtrlRunnable=true, ReadInMotCtrlRunnable=true, WrittenIn2msRunnable=false, ImplementationDataType=sint8, Size=2, InitialValue=-128, 127, Min=-128, Max=127, Units=Cnt
          ReadMotCtrlWriteMotCtrls16: WrittenInMotCtrlRunnable=true, ReadInMotCtrlRunnable=true, WrittenIn2msRunnable=false, ImplementationDataType=sint16, Size=1, InitialValue=-32768, Min=-32768, Max=32767, Units=Cnt
          ReadMotCtrlWriteMotCtrls32: WrittenInMotCtrlRunnable=true, ReadInMotCtrlRunnable=true, WrittenIn2msRunnable=false, ImplementationDataType=sint32, Size=1, InitialValue=-2147483647, Min=-2147483648, Max=2147483647, Units=Cnt
          ReadMotCtrlWriteMotCtrlu08: WrittenInMotCtrlRunnable=true, ReadInMotCtrlRunnable=true, WrittenIn2msRunnable=false, ImplementationDataType=uint8, Size=1, InitialValue=255U, Min=0, Max=255, Units=Cnt
          ReadMotCtrlWriteMotCtrlu16: WrittenInMotCtrlRunnable=true, ReadInMotCtrlRunnable=true, WrittenIn2msRunnable=false, ImplementationDataType=uint16, Size=1, InitialValue=65535U, Min=0, Max=65535, Units=Cnt
          ReadMotCtrlWriteMotCtrlu32: WrittenInMotCtrlRunnable=true, ReadInMotCtrlRunnable=true, WrittenIn2msRunnable=false, ImplementationDataType=uint32, Size=1, InitialValue=4294967295U, Min=0, Max=4294967295, Units=Cnt
          ReadMotCtrlWriteNoneEnum: WrittenInMotCtrlRunnable=false, ReadInMotCtrlRunnable=true, WrittenIn2msRunnable=false, ImplementationDataType=uint32, Size=1, InitialValue=TestEnum_u32_Element3, Min=0, Max=2147483647, Units=Cnt, EnumerationNameReference=TestEnum_u32
          ReadMotCtrlWriteNonebool: WrittenInMotCtrlRunnable=false, ReadInMotCtrlRunnable=true, WrittenIn2msRunnable=false, ImplementationDataType=boolean, Size=1, InitialValue=TRUE, Min=0, Max=1, Units=Cnt
          ReadMotCtrlWriteNonef32: WrittenInMotCtrlRunnable=false, ReadInMotCtrlRunnable=true, WrittenIn2msRunnable=false, ImplementationDataType=float32, Size=1, InitialValue=1.0F, Min=-8.8, Max=8.8, Units=MotNwtMtr
          ReadMotCtrlWriteNones08: WrittenInMotCtrlRunnable=false, ReadInMotCtrlRunnable=true, WrittenIn2msRunnable=false, ImplementationDataType=sint8, Size=1, InitialValue=-128, Min=-128, Max=127, Units=Cnt
          ReadMotCtrlWriteNones16: WrittenInMotCtrlRunnable=false, ReadInMotCtrlRunnable=true, WrittenIn2msRunnable=false, ImplementationDataType=sint16, Size=1, InitialValue=-32768, Min=-32768, Max=32767, Units=Cnt
          ReadMotCtrlWriteNones16Ary: WrittenInMotCtrlRunnable=false, ReadInMotCtrlRunnable=true, WrittenIn2msRunnable=false, ImplementationDataType=sint16, Size=2, InitialValue=-32768, 32767, Min=-32768, Max=32767, Units=Cnt
          ReadMotCtrlWriteNones32: WrittenInMotCtrlRunnable=false, ReadInMotCtrlRunnable=true, WrittenIn2msRunnable=false, ImplementationDataType=sint32, Size=1, InitialValue=-2147483647, Min=-2147483648, Max=2147483647, Units=Cnt
          ReadMotCtrlWriteNoneu08: WrittenInMotCtrlRunnable=false, ReadInMotCtrlRunnable=true, WrittenIn2msRunnable=false, ImplementationDataType=uint8, Size=1, InitialValue=255U, Min=0, Max=255, Units=Cnt
          ReadMotCtrlWriteNoneu16: WrittenInMotCtrlRunnable=false, ReadInMotCtrlRunnable=true, WrittenIn2msRunnable=false, ImplementationDataType=uint16, Size=1, InitialValue=65535U, Min=0, Max=65535, Units=Cnt
          ReadMotCtrlWriteNoneu32: WrittenInMotCtrlRunnable=false, ReadInMotCtrlRunnable=true, WrittenIn2msRunnable=false, ImplementationDataType=uint32, Size=1, InitialValue=4294967295U, Min=0, Max=4294967295, Units=Cnt
          ReadMotCtrlWriteTwoMsEnum: WrittenInMotCtrlRunnable=false, ReadInMotCtrlRunnable=true, WrittenIn2msRunnable=true, ImplementationDataType=uint32, Size=1, InitialValue=TestEnum_u32_Element3, Min=0, Max=2147483647, Units=Cnt, EnumerationNameReference=TestEnum_u32
          ReadMotCtrlWriteTwoMsbool: WrittenInMotCtrlRunnable=false, ReadInMotCtrlRunnable=true, WrittenIn2msRunnable=true, ImplementationDataType=boolean, Size=1, InitialValue=FALSE, Min=0, Max=1, Units=Cnt
          ReadMotCtrlWriteTwoMsf32: WrittenInMotCtrlRunnable=false, ReadInMotCtrlRunnable=true, WrittenIn2msRunnable=true, ImplementationDataType=float32, Size=1, InitialValue=1.0F, Min=-8.8, Max=8.8, Units=MotNwtMtr
          ReadMotCtrlWriteTwoMss08: WrittenInMotCtrlRunnable=false, ReadInMotCtrlRunnable=true, WrittenIn2msRunnable=true, ImplementationDataType=sint8, Size=1, InitialValue=-128, Min=-128, Max=127, Units=Cnt
          ReadMotCtrlWriteTwoMss16: WrittenInMotCtrlRunnable=false, ReadInMotCtrlRunnable=true, WrittenIn2msRunnable=true, ImplementationDataType=sint16, Size=1, InitialValue=-32768, Min=-32768, Max=32767, Units=Cnt
          ReadMotCtrlWriteTwoMss32: WrittenInMotCtrlRunnable=false, ReadInMotCtrlRunnable=true, WrittenIn2msRunnable=true, ImplementationDataType=sint32, Size=1, InitialValue=-2147483647, Min=-2147483648, Max=2147483647, Units=Cnt
          ReadMotCtrlWriteTwoMss32Ary: WrittenInMotCtrlRunnable=false, ReadInMotCtrlRunnable=true, WrittenIn2msRunnable=true, ImplementationDataType=sint32, Size=2, InitialValue=-2147483647, 2147483647, Min=-2147483648, Max=2147483647, Units=Cnt
          ReadMotCtrlWriteTwoMsu08: WrittenInMotCtrlRunnable=false, ReadInMotCtrlRunnable=true, WrittenIn2msRunnable=true, ImplementationDataType=uint8, Size=1, InitialValue=255U, Min=0, Max=255, Units=Cnt
          ReadMotCtrlWriteTwoMsu16: WrittenInMotCtrlRunnable=false, ReadInMotCtrlRunnable=true, WrittenIn2msRunnable=true, ImplementationDataType=uint16, Size=1, InitialValue=65535U, Min=0, Max=65535, Units=Cnt
          ReadMotCtrlWriteTwoMsu32: WrittenInMotCtrlRunnable=false, ReadInMotCtrlRunnable=true, WrittenIn2msRunnable=true, ImplementationDataType=uint32, Size=1, InitialValue=4294967295U, Min=0, Max=4294967295, Units=Cnt
          ReadNoneWriteMotCtrlEnum: WrittenInMotCtrlRunnable=true, ReadInMotCtrlRunnable=false, WrittenIn2msRunnable=false, ImplementationDataType=uint8, Size=1, InitialValue=TestEnum_u08_Element3, Min=0, Max=255, Units=Cnt, EnumerationNameReference=TestEnum_u08
          ReadNoneWriteMotCtrlbool: WrittenInMotCtrlRunnable=true, ReadInMotCtrlRunnable=false, WrittenIn2msRunnable=false, ImplementationDataType=boolean, Size=1, InitialValue=TRUE, Min=0, Max=1, Units=Cnt
          ReadNoneWriteMotCtrlf32: WrittenInMotCtrlRunnable=true, ReadInMotCtrlRunnable=false, WrittenIn2msRunnable=false, ImplementationDataType=float32, Size=1, InitialValue=1.0F, Min=-8.8, Max=8.8, Units=MotNwtMtr
          ReadNoneWriteMotCtrls08: WrittenInMotCtrlRunnable=true, ReadInMotCtrlRunnable=false, WrittenIn2msRunnable=false, ImplementationDataType=sint8, Size=1, InitialValue=-128, Min=-128, Max=127, Units=Cnt
          ReadNoneWriteMotCtrls16: WrittenInMotCtrlRunnable=true, ReadInMotCtrlRunnable=false, WrittenIn2msRunnable=false, ImplementationDataType=sint16, Size=1, InitialValue=-32768, Min=-32768, Max=32767, Units=Cnt
          ReadNoneWriteMotCtrls32: WrittenInMotCtrlRunnable=true, ReadInMotCtrlRunnable=false, WrittenIn2msRunnable=false, ImplementationDataType=sint32, Size=1, InitialValue=-2147483647, Min=-2147483648, Max=2147483647, Units=Cnt
          ReadNoneWriteMotCtrlu08: WrittenInMotCtrlRunnable=true, ReadInMotCtrlRunnable=false, WrittenIn2msRunnable=false, ImplementationDataType=uint8, Size=1, InitialValue=255U, Min=0, Max=255, Units=Cnt
          ReadNoneWriteMotCtrlu08Ary: WrittenInMotCtrlRunnable=true, ReadInMotCtrlRunnable=false, WrittenIn2msRunnable=false, ImplementationDataType=uint8, Size=2, InitialValue=0U, 255U, Min=0, Max=255, Units=Cnt
          ReadNoneWriteMotCtrlu16: WrittenInMotCtrlRunnable=true, ReadInMotCtrlRunnable=false, WrittenIn2msRunnable=false, ImplementationDataType=uint16, Size=1, InitialValue=65535U, Min=0, Max=65535, Units=Cnt
          ReadNoneWriteMotCtrlu32: WrittenInMotCtrlRunnable=true, ReadInMotCtrlRunnable=false, WrittenIn2msRunnable=false, ImplementationDataType=uint32, Size=1, InitialValue=4294967295U, Min=0, Max=4294967295, Units=Cnt
          Signal0: WrittenInMotCtrlRunnable=false, ReadInMotCtrlRunnable=false, WrittenIn2msRunnable=true, ImplementationDataType=boolean, Size=1, InitialValue=FALSE, Min=0, Max=1, Units=Cnt
        Signal0Map (SignalMapping): OutputSignalName=Signal0, InputSignalName=SignalA, InputSignalName=SignalB
        Signal1 (Signal):
          WrittenInMotCtrlRunnable = true
          ReadInMotCtrlRunnable = false
          WrittenIn2msRunnable = false
          ReadIn2msRunnable = false
          ImplementationDataType = uint16
          Size = 1
          InitialValue = 65535U
          Min = 0
          Max = 65535
          Units = Cnt
        Signal1Map (SignalMapping): OutputSignalName=Signal1, InputSignalName=SignalZ
        Signal2 (Signal):
          WrittenInMotCtrlRunnable = true
          ReadInMotCtrlRunnable = false
          WrittenIn2msRunnable = false
          ReadIn2msRunnable = false
          ImplementationDataType = sint8
          Size = 1
          InitialValue = -128
          Min = -128
          Max = 127
          Units = Cnt
        Signal2Map (SignalMapping): OutputSignalName=Signal2, InputSignalName=SignalX, InputSignalName=SignalY
        Signal3 (Signal):
          WrittenInMotCtrlRunnable = true
          ReadInMotCtrlRunnable = false
          WrittenIn2msRunnable = false
          ReadIn2msRunnable = true
          ImplementationDataType = sint8
          Size = 1
          InitialValue = -128
          Min = -128
          Max = 127
          Units = Cnt
        Signal3Map (SignalMapping): OutputSignalName=Signal3, InputSignalName=SignalW
        Signal4 (Signal):
          WrittenInMotCtrlRunnable = true
          ReadInMotCtrlRunnable = true
          WrittenIn2msRunnable = false
          ReadIn2msRunnable = false
          ImplementationDataType = sint8
          Size = 1
          InitialValue = -128
          Min = -128
          Max = 127
          Units = Cnt
        Signal4Map (SignalMapping): OutputSignalName=Signal4, InputSignalName=SignalV
        Signal5 (Signal):
          WrittenInMotCtrlRunnable = false
          ReadInMotCtrlRunnable = false
          WrittenIn2msRunnable = true
          ReadIn2msRunnable = true
          ImplementationDataType = boolean
          Size = 1
          InitialValue = FALSE
          Min = 0
          Max = 1
          Units = Cnt
        Signal5Map (SignalMapping): OutputSignalName=Signal5, InputSignalName=SignalU
        8 x Signal, all with WrittenInMotCtrlRunnable=false, WrittenIn2msRunnable=false, Size=1, Units=Cnt:
          SignalA: ReadInMotCtrlRunnable=false, ReadIn2msRunnable=true, ImplementationDataType=boolean, InitialValue=FALSE, Min=0, Max=1
          SignalB: ReadInMotCtrlRunnable=true, ReadIn2msRunnable=false, ImplementationDataType=boolean, InitialValue=FALSE, Min=0, Max=1
          SignalU: ReadInMotCtrlRunnable=true, ReadIn2msRunnable=false, ImplementationDataType=boolean, InitialValue=FALSE, Min=0, Max=1
          SignalV: ReadInMotCtrlRunnable=false, ReadIn2msRunnable=true, ImplementationDataType=sint8, InitialValue=-128, Min=-128, Max=127
          SignalW: ReadInMotCtrlRunnable=true, ReadIn2msRunnable=false, ImplementationDataType=sint8, InitialValue=-128, Min=-128, Max=127
          SignalX: ReadInMotCtrlRunnable=true, ReadIn2msRunnable=false, ImplementationDataType=sint8, InitialValue=-128, Min=-128, Max=127
          SignalY: ReadInMotCtrlRunnable=false, ReadIn2msRunnable=true, ImplementationDataType=sint8, InitialValue=-128, Min=-128, Max=127
          SignalZ: ReadInMotCtrlRunnable=true, ReadIn2msRunnable=false, ImplementationDataType=uint16, InitialValue=65535U, Min=0, Max=65535
        3 x NonRteEnum:
          TestEnum_u08: EnumImplementationDataType=uint8
            3 x EnumElement:
              TestEnum_u08_Element1: Value=0
              TestEnum_u08_Element2: Value=7
              TestEnum_u08_Element3: Value=255
          TestEnum_u16: EnumImplementationDataType=uint16
            3 x EnumElement:
              TestEnum_u16_Element1: Value=0
              TestEnum_u16_Element2: Value=256
              TestEnum_u16_Element3: Value=65535
          TestEnum_u32: EnumImplementationDataType=uint32
            3 x EnumElement:
              TestEnum_u32_Element1: Value=0
              TestEnum_u32_Element2: Value=65535
              TestEnum_u32_Element3: Value=2147483647
        20 x Signal, all with WrittenInMotCtrlRunnable=true, WrittenIn2msRunnable=false, ReadIn2msRunnable=true:
          WriteMotCtrlReadMotCtrlReadTwoMsEnum: ReadInMotCtrlRunnable=true, ImplementationDataType=uint16, Size=1, InitialValue=TestEnum_u16_Element3, Min=0, Max=65535, Units=Cnt, EnumerationNameReference=TestEnum_u16
          WriteMotCtrlReadMotCtrlReadTwoMsbool: ReadInMotCtrlRunnable=true, ImplementationDataType=boolean, Size=1, InitialValue=FALSE, Min=0, Max=1, Units=Cnt
          WriteMotCtrlReadMotCtrlReadTwoMsf32: ReadInMotCtrlRunnable=true, ImplementationDataType=float32, Size=1, InitialValue=1.0F, Min=-8.8, Max=8.8, Units=MotNwtMtr
          WriteMotCtrlReadMotCtrlReadTwoMss08: ReadInMotCtrlRunnable=true, ImplementationDataType=sint8, Size=1, InitialValue=-128, Min=-128, Max=127, Units=Cnt
          WriteMotCtrlReadMotCtrlReadTwoMss16: ReadInMotCtrlRunnable=true, ImplementationDataType=sint16, Size=1, InitialValue=-32768, Min=-32768, Max=32767, Units=Cnt
          WriteMotCtrlReadMotCtrlReadTwoMss32: ReadInMotCtrlRunnable=true, ImplementationDataType=sint32, Size=1, InitialValue=-2147483647, Min=-2147483648, Max=2147483647, Units=Cnt
          WriteMotCtrlReadMotCtrlReadTwoMsu08: ReadInMotCtrlRunnable=true, ImplementationDataType=uint8, Size=1, InitialValue=255U, Min=0, Max=255, Units=Cnt
          WriteMotCtrlReadMotCtrlReadTwoMsu16: ReadInMotCtrlRunnable=true, ImplementationDataType=uint16, Size=1, InitialValue=65535U, Min=0, Max=65535, Units=Cnt
          WriteMotCtrlReadMotCtrlReadTwoMsu16Ary: ReadInMotCtrlRunnable=true, ImplementationDataType=uint16, Size=2, InitialValue=0U, 65535U, Min=0, Max=65535, Units=Cnt
          WriteMotCtrlReadMotCtrlReadTwoMsu32: ReadInMotCtrlRunnable=true, ImplementationDataType=uint32, Size=1, InitialValue=4294967295U, Min=0, Max=4294967295, Units=Cnt
          WriteMotCtrlReadTwoMsEnum: ReadInMotCtrlRunnable=false, ImplementationDataType=uint16, Size=1, InitialValue=TestEnum_u16_Element3, Min=0, Max=65535, Units=Cnt, EnumerationNameReference=TestEnum_u16
          WriteMotCtrlReadTwoMsbool: ReadInMotCtrlRunnable=false, ImplementationDataType=boolean, Size=1, InitialValue=TRUE, Min=0, Max=1, Units=Cnt
          WriteMotCtrlReadTwoMsf32: ReadInMotCtrlRunnable=false, ImplementationDataType=float32, Size=1, InitialValue=1.0F, Min=-8.8, Max=8.8, Units=MotNwtMtr
          WriteMotCtrlReadTwoMss08: ReadInMotCtrlRunnable=false, ImplementationDataType=sint8, Size=1, InitialValue=-128, Min=-128, Max=127, Units=Cnt
          WriteMotCtrlReadTwoMss16: ReadInMotCtrlRunnable=false, ImplementationDataType=sint16, Size=1, InitialValue=-32768, Min=-32768, Max=32767, Units=Cnt
          WriteMotCtrlReadTwoMss32: ReadInMotCtrlRunnable=false, ImplementationDataType=sint32, Size=1, InitialValue=-2147483647, Min=-2147483648, Max=2147483647, Units=Cnt
          WriteMotCtrlReadTwoMsu08: ReadInMotCtrlRunnable=false, ImplementationDataType=uint8, Size=1, InitialValue=255U, Min=0, Max=255, Units=Cnt
          WriteMotCtrlReadTwoMsu16: ReadInMotCtrlRunnable=false, ImplementationDataType=uint16, Size=1, InitialValue=65535U, Min=0, Max=65535, Units=Cnt
          WriteMotCtrlReadTwoMsu32: ReadInMotCtrlRunnable=false, ImplementationDataType=uint32, Size=1, InitialValue=4294967295U, Min=0, Max=4294967295, Units=Cnt
          WriteMotCtrlReadTwoMsu32Ary: ReadInMotCtrlRunnable=false, ImplementationDataType=uint32, Size=2, InitialValue=0U, 4294967295U, Min=0, Max=4294967295, Units=Cnt
      RunnableManagement: IncludeHeaders=MotCtrlRunnable.h
        MotCtrlReadRunPer1 (Runnable): RunnableRate=MotorControlx2, SequenceOrder=1
        MotCtrlWriteRunPer1 (Runnable): RunnableRate=MotorControl, SequenceOrder=2
  module config Rte: implementation-config-variant=VARIANT-PRE-COMPILE, module-description=Rte_Impl
    RteBswGeneral: RteSchMVersionInfoApi=false, RteUseComShadowSignalApi=false
    RteGeneration:
      RteCalibrationSupport = NONE
      RteCodeVendorId = 30
      RteDevErrorDetect = false
      RteDevErrorDetectUninit = false
      RteGenerationMode = COMPATIBILITY_MODE
      RteIocInteractionReturnValue = RTE_IOC
      RteMeasurementSupport = false
      RteOptimizationMode = MEMORY
      RteValueRangeCheckEnabled = false
      RteVfbTraceEnabled = false
      RteEnforceIoc = false
      RteXcpEventSupport = false
    RteInitializationBehavior: RteInitializationStrategy=RTE_INITIALIZATION_STRATEGY_AT_RTE_START_AND_PARTITION_RESTART, RteSectionInitializationPolicy=
    RteOsInteraction
    Rte (RteBswModuleInstance): RteBswImplementationRef=Rte_Impl, RteBswModuleConfigurationRef=Rte
