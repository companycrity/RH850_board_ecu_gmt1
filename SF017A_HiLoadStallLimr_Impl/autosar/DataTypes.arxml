AUTOSAR XML (schema 4-0-3)
standard types defined: float32_DataConstr, float64_DataConstr, sint16_DataConstr, sint32_DataConstr, sint8_DataConstr, uint16_DataConstr, uint32_DataConstr, uint8_DataConstr, boolean, float32, float64, sint16, sint32, sint8, uint16, uint32, uint8
package /Nexteer/DataTypes
  impl type Ary1D_u8p8_6: category=ARRAY, sw-calibration-access=READ-ONLY, type-emitter=RTE
    element Element: array-size=6, array-size-semantics=FIXED-SIZE, implementation-data-type=u8p8
  impl type FilLpRec1: category=STRUCTURE, sw-calibration-access=READ-ONLY, type-emitter=NxtrFil
    element FilSt: implementation-data-type=float32
    element FilGain: implementation-data-type=float32
    symbol props FilLpRec1
  impl type u8p8: implementation-data-type=uint16, type-emitter=RTE
