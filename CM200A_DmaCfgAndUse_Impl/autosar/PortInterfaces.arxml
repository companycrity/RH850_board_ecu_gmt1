AUTOSAR XML (schema 4-0-3)
package /Nexteer/PortInterfaces
  5 x client server interface:
    Adc1CfgAndUseAdc1EnaCnvn1
      operation Oper
    DmaEna2MilliSecToMotCtrlTrf1
      operation Oper
    DmaWaitForMotCtrlTo2MilliSecTrf1
      operation Oper: possible-error=E_NOT_OK
      error E_NOT_OK: error-code=1
    GetRefTmr1MicroSec32bit1
      operation Oper
        arg RefTmr: type=uint32, direction=OUT
    GetTiSpan1MicroSec32bit1
      operation Oper
        arg RefTmr: type=uint32, direction=IN
        arg TiSpan: type=uint32, direction=OUT
