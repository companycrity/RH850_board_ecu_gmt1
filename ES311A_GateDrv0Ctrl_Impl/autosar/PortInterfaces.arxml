AUTOSAR XML (schema 4-0-3)
package /Nexteer/Calibrations
  parameter interface uint16_CalPortIf1
    parameter data prototype Val: sw-calibration-access=READ-WRITE, type=uint16
package /Nexteer/PortInterfaces
  client server interface GetGpio_PortIf1
    operation Oper: possible-error=GetGpio_PortIf1/E_NOT_OK
      arg PinSt_Arg: type=boolean, direction=OUT
    error E_NOT_OK: error-code=1
  client server interface SetGpio1
    operation Oper: possible-error=SetGpio1/E_NOT_OK
      arg PinSt: type=boolean, direction=IN
    error E_NOT_OK: error-code=1
  client server interface SetNtcSts_PortIf1
    operation Oper: possible-error=SetNtcSts_PortIf1/E_NOT_OK
      4 x arg, all with direction=IN:
        NtcNr_Arg: type=NtcNr1
        NtcStInfo_Arg: type=uint8
        NtcSts_Arg: type=NtcSts1
        DebStep_Arg: type=uint16
    error E_NOT_OK: error-code=1
  sender receiver interface boolean_PortIf1: invalidation-policy{data-element=Logl, handle-invalid=DONT-INVALIDATE}
    data Logl: sw-calibration-access=READ-ONLY, type=boolean
  sender receiver interface SysSt1_PortIf1: invalidation-policy{data-element=SysSt1_PortIf1/Val, handle-invalid=DONT-INVALIDATE}
    data Val: sw-calibration-access=READ-ONLY, type=SysSt1
  sender receiver interface uint8_PortIf1: invalidation-policy{data-element=uint8_PortIf1/Val, handle-invalid=DONT-INVALIDATE}
    data Val: sw-calibration-access=READ-ONLY, type=uint8
