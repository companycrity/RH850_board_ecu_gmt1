AUTOSAR XML (schema 4-0-3)
package /Nexteer/Calibrations
  parameter interface uint16_CalPortIf1
    parameter data prototype Val: sw-calibration-access=READ-WRITE, type=uint16
package /Nexteer/NvMProxy_swc/Interfaces
  client server interface NvMService_AC3_SRBS_Defs: is-service=true
    7 x operation, all with possible-error=NvMService_AC3_SRBS_Defs/E_NOT_OK:
      EraseBlock
      GetErrorStatus
        arg ErrorStatus: type=NvM_RequestResultType, direction=OUT
      InvalidateNvBlock
      ReadBlock
        arg DstPtr: type=dtRef_VOID, direction=IN
      RestoreBlockDefaults
        arg DstPtr: type=dtRef_VOID, direction=IN
      SetRamBlockStatus
        arg RamBlockStatus: type=Boolean, direction=IN
      WriteBlock
        arg SrcPtr: type=dtRef_const_VOID, direction=IN
    error E_NOT_OK: error-code=1
package /Nexteer/PortInterfaces
  13 x client server interface:
    FltInj_f32_PortIf1
      operation Oper
        arg SigPah_Arg: type=float32, direction=INOUT
        arg LocnKey_Arg: type=uint16, direction=IN
    FltInj_u08_PortIf1
      operation Oper
        arg SigPah_Arg: type=uint8, direction=INOUT
        arg LocnKey_Arg: type=uint16, direction=IN
    GetNtcQlfrSts_PortIf1
      operation Oper: possible-error=GetNtcQlfrSts_PortIf1/E_NOT_OK
        arg NtcNr_Arg: type=NtcNr1, direction=IN
        arg NtcQlfr_Arg: type=SigQlfr1, direction=OUT
      error E_NOT_OK: error-code=1
    GetRefTmr1MicroSec32bit_PortIf1
      operation Oper
        arg RefTmr_Arg: type=uint32, direction=OUT
    GetTiSpan1MicroSec32bit_PortIf1
      operation Oper
        arg RefTmr_Arg: type=uint32, direction=IN
        arg TiSpan_Arg: type=uint32, direction=OUT
    HwTqMeasHwTqAutTrim_PortIf1
      operation Oper
    HwTqMeasHwTqClrTrim_PortIf1
      operation Oper
    HwTqMeasHwTqReadTrim_PortIf1
      operation Oper
        arg HwTqReadTrimData_Arg: type=float32, direction=OUT
    HwTqMeasHwTqTrimPrfmdSts_PortIf1
      operation Oper
        arg HwTqOffsTrimPrfmdStsData_Arg: type=boolean, direction=OUT
    HwTqMeasHwTqWrTrim_PortIf1
      operation Oper
        arg HwTqWrOffsTrimData_Arg: type=float32, direction=IN
    MeasTrigStrt_PortIf1
      operation Oper
    SetFctPeriph_PortIf1
      operation Oper: possible-error=SetFctPeriph_PortIf1/E_NOT_OK
      error E_NOT_OK: error-code=1
    SetNtcSts_PortIf1
      operation Oper: possible-error=SetNtcSts_PortIf1/E_NOT_OK
        4 x arg, all with direction=IN:
          NtcNr_Arg: type=NtcNr1
          NtcStInfo_Arg: type=uint8
          NtcSts_Arg: type=NtcSts1
          DebStep_Arg: type=uint16
      error E_NOT_OK: error-code=1
  5 x sender receiver interface:
    boolean_PortIf1: invalidation-policy{data-element=Logl, handle-invalid=DONT-INVALIDATE}
      data Logl: sw-calibration-access=READ-ONLY, type=boolean
    float32_PortIf1: invalidation-policy{data-element=float32_PortIf1/Val, handle-invalid=DONT-INVALIDATE}
      data Val: sw-calibration-access=READ-ONLY, type=float32
    SigQlfr_PortIf1: invalidation-policy{data-element=SigQlfr_PortIf1/Val, handle-invalid=DONT-INVALIDATE}
      data Val: sw-calibration-access=READ-ONLY, type=SigQlfr1
    sint8_PortIf1: invalidation-policy{data-element=sint8_PortIf1/Val, handle-invalid=DONT-INVALIDATE}
      data Val: sw-calibration-access=READ-ONLY, type=sint8
    uint8_PortIf1: invalidation-policy{data-element=uint8_PortIf1/Val, handle-invalid=DONT-INVALIDATE}
      data Val: sw-calibration-access=READ-ONLY, type=uint8
