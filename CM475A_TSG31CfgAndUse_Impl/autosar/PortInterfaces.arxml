AUTOSAR XML (schema 4-0-3)
package /Nexteer/Calibrations
  17 x parameter interface:
    Cnt1
      parameter data prototype Val: sw-calibration-access=READ-WRITE, type=Cnt5
    Cnt2
      parameter data prototype Val: sw-calibration-access=READ-WRITE, type=uint16
    Cnt3
      parameter data prototype Val: sw-calibration-access=READ-WRITE, type=uint8
    Curr1
      parameter data prototype Val: sw-calibration-access=READ-WRITE, type=Curr2
    Frq1
      parameter data prototype Val: sw-calibration-access=READ-WRITE, type=Frq1
    Gain1
      parameter data prototype Val: sw-calibration-access=READ-WRITE, type=Gain1
    T1
      parameter data prototype Val: sw-calibration-access=READ-WRITE, type=T1
    T2
      parameter data prototype Val: sw-calibration-access=READ-WRITE, type=T2
    T3
      parameter data prototype Val: sw-calibration-access=READ-WRITE, type=T4
    Ti1
      parameter data prototype Val: sw-calibration-access=READ-WRITE, type=Ti1
    Ti2
      parameter data prototype Val: sw-calibration-access=READ-WRITE, type=Ti2
    Ti3
      parameter data prototype Val: sw-calibration-access=READ-WRITE, type=Ti3
    Ti4
      parameter data prototype Val: sw-calibration-access=READ-WRITE, type=Ti4
    Uls1
      parameter data prototype Val: sw-calibration-access=READ-WRITE, type=Uls1
    Volt1
      parameter data prototype Val: sw-calibration-access=READ-WRITE, type=Volt1
    Volt2
      parameter data prototype Val: sw-calibration-access=READ-WRITE, type=Volt3
    Volt3
      parameter data prototype Val: sw-calibration-access=READ-WRITE, type=Volt4
package /Nexteer/PortInterfaces
  9 x client server interface:
    GetNtcQlfrSts1
      operation Oper: possible-error=GetNtcQlfrSts1/E_NOT_OK
        arg NtcNr: type=NtcNr1, direction=IN
        arg NtcQlfr: type=SigQlfr1, direction=OUT
      error E_NOT_OK: error-code=1
    GetRefTmr100MicroSec32bit1
      operation Oper
        arg RefTmr: type=uint32, direction=OUT
    GetRefTmr1MicroSec32bit1
      operation Oper
        arg RefTmr: type=uint32, direction=OUT
    GetTiSpan100MicroSec32bit1
      operation Oper
        arg RefTmr: type=uint32, direction=IN
        arg TiSpan: type=uint32, direction=OUT
    GetTiSpan1MicroSec32bit1
      operation Oper
        arg RefTmr: type=uint32, direction=IN
        arg TiSpan: type=uint32, direction=OUT
    SetFctGpio1
      operation Oper: possible-error=SetFctGpio1/E_NOT_OK
      error E_NOT_OK: error-code=1
    SetFctPeriph1
      operation Oper: possible-error=SetFctPeriph1/E_NOT_OK
      error E_NOT_OK: error-code=1
    SetGpio1
      operation Oper: possible-error=SetGpio1/E_NOT_OK
        arg PinSt: type=boolean, direction=IN
      error E_NOT_OK: error-code=1
    SetNtcSts1
      operation Oper: possible-error=SetNtcSts1/E_NOT_OK
        4 x arg, all with direction=IN:
          NtcNr: type=NtcNr1
          NtcStInfo: type=uint8
          NtcSts: type=NtcSts1
          DebStep: type=uint16
      error E_NOT_OK: error-code=1
  28 x sender receiver interface:
    BattSwdVltgCorrlnSts1: invalidation-policy{data-element=BattSwdVltgCorrlnSts1/Val, handle-invalid=DONT-INVALIDATE}
      data Val: sw-calibration-access=READ-ONLY, type=BattSwdVltgCorrlnSts1
    Cnt1: invalidation-policy{data-element=Cnt1/Val, handle-invalid=DONT-INVALIDATE}
      data Val: sw-calibration-access=READ-ONLY, type=Cnt1
    Cnt2: invalidation-policy{data-element=Cnt2/Val, handle-invalid=DONT-INVALIDATE}
      data Val: sw-calibration-access=READ-ONLY, type=Cnt2
    Cnt3: invalidation-policy{data-element=Cnt3/Val, handle-invalid=DONT-INVALIDATE}
      data Val: sw-calibration-access=READ-ONLY, type=Cnt3
    Cnt4: invalidation-policy{data-element=Cnt4/Val, handle-invalid=DONT-INVALIDATE}
      data Val: sw-calibration-access=READ-ONLY, data-constr=p0pt0_p31pt0, type=Cnt4
    Cnt5: invalidation-policy{data-element=Cnt5/Val, handle-invalid=DONT-INVALIDATE}
      data Val: sw-calibration-access=READ-ONLY, type=Cnt5
    Cnt6: invalidation-policy{data-element=Cnt6/Val, handle-invalid=DONT-INVALIDATE}
      data Val: sw-calibration-access=READ-ONLY, type=uint8
    Cnt7: invalidation-policy{data-element=Cnt7/Val, handle-invalid=DONT-INVALIDATE}
      data Val: sw-calibration-access=READ-ONLY, type=Cnt6
    Cnt8: invalidation-policy{data-element=Cnt8/Val, handle-invalid=DONT-INVALIDATE}
      data Val: sw-calibration-access=READ-ONLY, type=Cnt7
    Curr1: invalidation-policy{data-element=Curr1/Val, handle-invalid=DONT-INVALIDATE}
      data Val: sw-calibration-access=READ-ONLY, type=Curr1
    Frq1: invalidation-policy{data-element=Frq1/Val, handle-invalid=DONT-INVALIDATE}
      data Val: sw-calibration-access=READ-ONLY, type=Frq1
    Logl1: invalidation-policy{data-element=Logl, handle-invalid=DONT-INVALIDATE}
      data Logl: sw-calibration-access=READ-ONLY, type=boolean
    MotCurrEolCalSt1: invalidation-policy{data-element=MotCurrEolCalSt1/Val, handle-invalid=DONT-INVALIDATE}
      data Val: sw-calibration-access=READ-ONLY, type=MotCurrEolCalSt1
    MotCurrEolCalSt2: invalidation-policy{data-element=MotCurrEolCalSt2/Val, handle-invalid=DONT-INVALIDATE}
      data Val: sw-calibration-access=READ-ONLY, type=MotCurrEolCalSt2
    SigQlfr1: invalidation-policy{data-element=SigQlfr1/Val, handle-invalid=DONT-INVALIDATE}
      data Val: sw-calibration-access=READ-ONLY, type=SigQlfr1
    StrtUpSt1: invalidation-policy{data-element=StrtUpSt1/Val, handle-invalid=DONT-INVALIDATE}
      data Val: sw-calibration-access=READ-ONLY, type=StrtUpSt1
    SysSt1: invalidation-policy{data-element=SysSt1/Val, handle-invalid=DONT-INVALIDATE}
      data Val: sw-calibration-access=READ-ONLY, type=SysSt1
    T1: invalidation-policy{data-element=T1/Val, handle-invalid=DONT-INVALIDATE}
      data Val: sw-calibration-access=READ-ONLY, type=T1
    T2: invalidation-policy{data-element=T2, handle-invalid=DONT-INVALIDATE}
      data T2: sw-calibration-access=READ-ONLY, type=T2
    T3: invalidation-policy{data-element=T3, handle-invalid=DONT-INVALIDATE}
      data T3: sw-calibration-access=READ-ONLY, type=T3
    T4: invalidation-policy{data-element=Element, handle-invalid=DONT-INVALIDATE}
      data Element: sw-calibration-access=READ-ONLY, type=T4
    Ti1: invalidation-policy{data-element=Ti1/Val, handle-invalid=DONT-INVALIDATE}
      data Val: sw-calibration-access=READ-ONLY, type=Ti1
    Ti3: invalidation-policy{data-element=Ti3/Val, handle-invalid=DONT-INVALIDATE}
      data Val: sw-calibration-access=READ-ONLY, type=Ti3
    Tq1: invalidation-policy{data-element=Tq1/Val, handle-invalid=DONT-INVALIDATE}
      data Val: sw-calibration-access=READ-ONLY, type=Tq1
    Tq2: invalidation-policy{data-element=Tq2/Val, handle-invalid=DONT-INVALIDATE}
      data Val: sw-calibration-access=READ-ONLY, type=Tq2
    Volt1: invalidation-policy{data-element=Volt1/Val, handle-invalid=DONT-INVALIDATE}
      data Val: sw-calibration-access=READ-ONLY, type=Volt1
    Volt2: invalidation-policy{data-element=Volt2/Val, handle-invalid=DONT-INVALIDATE}
      data Val: sw-calibration-access=READ-ONLY, type=Volt2
    Volt3: invalidation-policy{data-element=Volt3/Val, handle-invalid=DONT-INVALIDATE}
      data Val: sw-calibration-access=READ-ONLY, type=Volt3
