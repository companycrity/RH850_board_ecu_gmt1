AUTOSAR XML (schema 4-0-3)
standard types defined: float32_DataConstr, float64_DataConstr, sint16_DataConstr, sint32_DataConstr, sint8_DataConstr, uint16_DataConstr, uint32_DataConstr, uint8_DataConstr, boolean, float32, float64, sint16, sint32, sint8, uint16, uint32, uint8, Boolean, dtRef_const_VOID, dtRef_VOID
package /Nexteer/DataTypes
  43 x impl type:
    Ary1D_NtcFltInfoRec2_20: category=ARRAY, sw-calibration-access=READ-ONLY, type-emitter=RTE
      element Element: array-size=20, array-size-semantics=FIXED-SIZE, implementation-data-type=NtcFltInfoRec2
    Ary1D_NtcInfoRec4_DiagcMgr: category=ARRAY, type-emitter=DiagcMgr
      element Element: array-size=65535, array-size-semantics=VARIABLE-SIZE, implementation-data-type=NtcInfoRec4
    Ary1D_NtcInfoRec4_DiagcMgrProxyAppl0: category=ARRAY, type-emitter=DiagcMgr
      element Element: array-size=65535, array-size-semantics=VARIABLE-SIZE, implementation-data-type=NtcInfoRec4
    Ary1D_NtcInfoRec4_DiagcMgrProxyAppl1: category=ARRAY, type-emitter=DiagcMgr
      element Element: array-size=65535, array-size-semantics=VARIABLE-SIZE, implementation-data-type=NtcInfoRec4
    Ary1D_NtcInfoRec4_DiagcMgrProxyAppl10: category=ARRAY, type-emitter=DiagcMgr
      element Element: array-size=65535, array-size-semantics=VARIABLE-SIZE, implementation-data-type=NtcInfoRec4
    Ary1D_NtcInfoRec4_DiagcMgrProxyAppl2: category=ARRAY, type-emitter=DiagcMgr
      element Element: array-size=65535, array-size-semantics=VARIABLE-SIZE, implementation-data-type=NtcInfoRec4
    Ary1D_NtcInfoRec4_DiagcMgrProxyAppl3: category=ARRAY, type-emitter=DiagcMgr
      element Element: array-size=65535, array-size-semantics=VARIABLE-SIZE, implementation-data-type=NtcInfoRec4
    Ary1D_NtcInfoRec4_DiagcMgrProxyAppl4: category=ARRAY, type-emitter=DiagcMgr
      element Element: array-size=65535, array-size-semantics=VARIABLE-SIZE, implementation-data-type=NtcInfoRec4
    Ary1D_NtcInfoRec4_DiagcMgrProxyAppl5: category=ARRAY, type-emitter=DiagcMgr
      element Element: array-size=65535, array-size-semantics=VARIABLE-SIZE, implementation-data-type=NtcInfoRec4
    Ary1D_NtcInfoRec4_DiagcMgrProxyAppl6: category=ARRAY, type-emitter=DiagcMgr
      element Element: array-size=65535, array-size-semantics=VARIABLE-SIZE, implementation-data-type=NtcInfoRec4
    Ary1D_NtcInfoRec4_DiagcMgrProxyAppl7: category=ARRAY, type-emitter=DiagcMgr
      element Element: array-size=65535, array-size-semantics=VARIABLE-SIZE, implementation-data-type=NtcInfoRec4
    Ary1D_NtcInfoRec4_DiagcMgrProxyAppl8: category=ARRAY, type-emitter=DiagcMgr
      element Element: array-size=65535, array-size-semantics=VARIABLE-SIZE, implementation-data-type=NtcInfoRec4
    Ary1D_NtcInfoRec4_DiagcMgrProxyAppl9: category=ARRAY, type-emitter=DiagcMgr
      element Element: array-size=65535, array-size-semantics=VARIABLE-SIZE, implementation-data-type=NtcInfoRec4
    Ary1D_ReadFltInfoRec1_20: category=ARRAY, sw-calibration-access=READ-ONLY, type-emitter=RTE
      element Element: array-size=20, array-size-semantics=FIXED-SIZE, implementation-data-type=ReadFltInfoRec1
    Ary1D_s16_DiagcMgrProxyAppl0: category=ARRAY, type-emitter=DiagcMgr
      element Element: array-size=65535, array-size-semantics=VARIABLE-SIZE, implementation-data-type=sint16
    Ary1D_s16_DiagcMgrProxyAppl1: category=ARRAY, type-emitter=DiagcMgr
      element Element: array-size=65535, array-size-semantics=VARIABLE-SIZE, implementation-data-type=sint16
    Ary1D_s16_DiagcMgrProxyAppl10: category=ARRAY, type-emitter=DiagcMgr
      element Element: array-size=65535, array-size-semantics=VARIABLE-SIZE, implementation-data-type=sint16
    Ary1D_s16_DiagcMgrProxyAppl2: category=ARRAY, type-emitter=DiagcMgr
      element Element: array-size=65535, array-size-semantics=VARIABLE-SIZE, implementation-data-type=sint16
    Ary1D_s16_DiagcMgrProxyAppl3: category=ARRAY, type-emitter=DiagcMgr
      element Element: array-size=65535, array-size-semantics=VARIABLE-SIZE, implementation-data-type=sint16
    Ary1D_s16_DiagcMgrProxyAppl4: category=ARRAY, type-emitter=DiagcMgr
      element Element: array-size=65535, array-size-semantics=VARIABLE-SIZE, implementation-data-type=sint16
    Ary1D_s16_DiagcMgrProxyAppl5: category=ARRAY, type-emitter=DiagcMgr
      element Element: array-size=65535, array-size-semantics=VARIABLE-SIZE, implementation-data-type=sint16
    Ary1D_s16_DiagcMgrProxyAppl6: category=ARRAY, type-emitter=DiagcMgr
      element Element: array-size=65535, array-size-semantics=VARIABLE-SIZE, implementation-data-type=sint16
    Ary1D_s16_DiagcMgrProxyAppl7: category=ARRAY, type-emitter=DiagcMgr
      element Element: array-size=65535, array-size-semantics=VARIABLE-SIZE, implementation-data-type=sint16
    Ary1D_s16_DiagcMgrProxyAppl8: category=ARRAY, type-emitter=DiagcMgr
      element Element: array-size=65535, array-size-semantics=VARIABLE-SIZE, implementation-data-type=sint16
    Ary1D_s16_DiagcMgrProxyAppl9: category=ARRAY, type-emitter=DiagcMgr
      element Element: array-size=65535, array-size-semantics=VARIABLE-SIZE, implementation-data-type=sint16
    Ary1D_SnpshtDataRec1_8: category=ARRAY, sw-calibration-access=READ-ONLY, type-emitter=RTE
      element Element: array-size=8, array-size-semantics=FIXED-SIZE, implementation-data-type=SnpshtDataRec1
    Ary1D_u08_DiagcMgr1: category=ARRAY, type-emitter=DiagcMgr
      element Element: array-size=65535, array-size-semantics=VARIABLE-SIZE, implementation-data-type=uint8
    Ary1D_u32_512: category=ARRAY, sw-calibration-access=READ-ONLY, type-emitter=RTE
      element Element: array-size=512, array-size-semantics=FIXED-SIZE, implementation-data-type=uint32
    DiagcDataRec1: category=STRUCTURE, sw-calibration-access=READ-ONLY, type-emitter=RTE
      element DiagcSts: implementation-data-type=uint16
      element ActvRampRate: implementation-data-type=float32
      element ActvMotTqCmdSca: implementation-data-type=float32
    MfgEnaSt1: compu {0=MFGENAST_PRDNMOD, 1=MFGENAST_MFGMOD, 2=MFGENAST_TESTMOD}, implementation-data-type=uint8, type-emitter=RTE
    NtcFltInfoRec2: category=STRUCTURE, sw-calibration-access=READ-ONLY, type-emitter=RTE
      element NtcNr: implementation-data-type=NtcNrWithResd1
      element AgiCntr: implementation-data-type=uint8
      element Sts: implementation-data-type=uint8
    NtcInfoRec4: category=STRUCTURE, sw-calibration-access=READ-ONLY, type-emitter=DiagcMgr
      element NtcStInfo: implementation-data-type=uint8
      element Sts: implementation-data-type=uint8
      element AgiCntr: implementation-data-type=uint8
    NtcNr1: compu {1..511=NTCNR_0X001..NTCNR_0X1FF}, implementation-data-type=uint16, type-emitter=RTE
    NtcNrWithResd1: compu {0=NTCNR_RESD, 1..511=NTCNR_0X001..NTCNR_0X1FF}, implementation-data-type=uint16, type-emitter=RTE
    NtcSts1: compu {0=NTCSTS_PASSD, 1=NTCSTS_FAILD, 2=NTCSTS_PREPASSD, 3=NTCSTS_PREFAILD}, implementation-data-type=uint8, type-emitter=RTE
    ReadFltInfoRec1: category=STRUCTURE, sw-calibration-access=READ-ONLY, type-emitter=RTE
      4 x element, all with category=TYPE_REFERENCE:
        NtcNr: implementation-data-type=NtcNrWithResd1
        AgiCntr: implementation-data-type=uint8
        Sts: implementation-data-type=uint8
        NtcStInfo: implementation-data-type=uint8
    s5p10: implementation-data-type=sint16, type-emitter=RTE
    s8p7: implementation-data-type=sint16, type-emitter=RTE
    SigQlfr1: compu {0=SIGQLFR_NORES, 1=SIGQLFR_PASSD, 2=SIGQLFR_FAILD}, implementation-data-type=uint8, type-emitter=RTE
    SnpshtDataRec1: category=STRUCTURE, sw-calibration-access=READ-ONLY, type-emitter=RTE
      10 x element, all with category=TYPE_REFERENCE:
        MicroDiagcData: implementation-data-type=uint32
        HwTq: implementation-data-type=s5p10
        MotTq: implementation-data-type=s5p10
        IgnCntr: implementation-data-type=uint32
        BrdgVltg: implementation-data-type=u6p10
        EcuT: implementation-data-type=s8p7
        NtcNr: implementation-data-type=uint16
        NtcStInfo: implementation-data-type=uint8
        SysSt: implementation-data-type=SysSt1
        VehSpd: implementation-data-type=u9p7
    SysSt1: compu {0=SYSST_DI, 1=SYSST_OFF, 2=SYSST_ENA, 3=SYSST_WRMININ}, implementation-data-type=uint8, type-emitter=RTE
    u6p10: implementation-data-type=uint16, type-emitter=RTE
    u9p7: implementation-data-type=uint16, type-emitter=RTE
package /Nexteer/NvMProxy_swc/DataTypes
  impl type NvM_RequestResultType: category=VALUE, base-type=NvM_RequestResultType, compu {0=NVM_REQ_OK, 1=NVM_REQ_NOT_OK, 2=NVM_REQ_PENDING, 3=NVM_REQ_INTEGRITY_FAILED, 4=NVM_REQ_BLOCK_SKIPPED, 5=NVM_REQ_NV_INVALIDATED, 6=NVM_REQ_CANCELED, 7=NVM_REQ_REDUNDANCY_FAILED, 8=NVM_REQ_RESTORED_FROM_ROM}
package /Nexteer/NvMProxy_swc/DataTypes/BaseTypes
  base type NvM_RequestResultType: category=FIXED_LENGTH, base-type-size=8, base-type-encoding=NONE, native-declaration=uint8
package /Nexteer/Units
  39 x unit, all with factor-si-to-unit=1, offset-si-to-unit=0:
    Ampr: display-name=Amp
    AmprPerVolt: display-name=Amp/V
    AmprSqd: display-name=Amp^2
    Cnt: display-name=Cnt
    DegCgrd: display-name=degC
    DegCgrdPerVolt: display-name=degC/Volt
    FixdPt
    Henry: display-name=H
    HwDeg: display-name=HwDeg
    HwDegPerSec: display-name=HwDeg/s
    HwNwtMtr: display-name=HwNm
    HwRadPerSec: display-name=HwRad/s
    Hz: display-name=Hz
    Kph: display-name=kph
    KphPerSec: display-name=kph/s
    KphPerSecSqd: display-name=kph/s^2
    MicroSec: display-name=uS
    MotDeg: display-name=MotDeg
    MotDegPerHwDeg: display-name=MotDeg/HwDeg
    MotNwtMtr: display-name=MotNm
    MotNwtMtrPerMotRadPerSec: display-name=MotNm/MotRad/S
    MotRad: display-name=MotRad
    MotRadPerSec: display-name=MotRad/s
    MotRev: display-name=MotRev
    MotRevElec: display-name=MotRevElec
    MtrPerSecSqd: display-name=m/s^2
    NanoSec: display-name=nS
    Ohm: display-name=ohm
    OhmPerDegCgrd: display-name=ohm/degC
    Sec: display-name=sec
    Uls: display-name=Uls
    UlsPerSec: display-name=Uls/S
    VehDegPerSec: display-name=VehDeg/S
    VehDegPerSecSqd: display-name=VehDeg/S^2
    Volt: display-name=V
    VoltNanoSec: display-name=VnS
    VoltPerMotRadPerSec: display-name=V/MotRad/Sec
    VoltPerMotRadPerSecPerDegCgrd: display-name=V/MotRad/S/degC
    VoltPerVoltNanoSec
