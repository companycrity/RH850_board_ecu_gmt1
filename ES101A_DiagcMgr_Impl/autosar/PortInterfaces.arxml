AUTOSAR XML (schema 4-0-3)
package /Nexteer/Calibrations
  parameter interface Ary1D_u32_512_CalPortIf1
    parameter data prototype Ary1D: sw-calibration-access=READ-WRITE, type=Ary1D_u32_512
package /Nexteer/NvMProxy_swc/Interfaces
  client server interface NvMService_AC3_SRBS: is-service=true
    6 x operation, all with possible-error=NvMService_AC3_SRBS/E_NOT_OK:
      EraseBlock
      GetErrorStatus
        arg ErrorStatus: type=NvM_RequestResultType, direction=OUT
      InvalidateNvBlock
      ReadBlock
        arg DstPtr: type=dtRef_VOID, direction=IN
      SetRamBlockStatus
        arg RamBlockStatus: type=Boolean, direction=IN
      WriteBlock
        arg SrcPtr: type=dtRef_const_VOID, direction=IN
    error E_NOT_OK: error-code=1
package /Nexteer/PortInterfaces
  18 x client server interface:
    ClrAllDiagc_PortIf1
      operation Oper
    ClrSnpshtData_PortIf1
      operation Oper
    DiagcMgrIninCore_PortIf2
      operation Oper
        5 x arg:
          ApplIdx_Arg: type=uint8, direction=IN
          NtcInfoArySize_Arg: type=uint8, direction=IN
          NtcInfoAry_Arg: type=Ary1D_NtcInfoRec4_DiagcMgr, direction=INOUT
          DiagcData_Arg: type=DiagcDataRec1, direction=OUT
          ProxySetNtcData_Arg: type=DiagcDataRec1, direction=OUT
    FltInj_logl_PortIf1
      operation Oper
        arg SigPah_Arg: type=boolean, direction=INOUT
        arg LocnKey_Arg: type=uint16, direction=IN
    GetDiagcDataApplX_PortIf1
      operation Oper
        arg DiagcData_Arg: type=DiagcDataRec1, direction=OUT
    GetNtcActv_PortIf1
      operation Oper: possible-error=GetNtcActv_PortIf1/E_NOT_OK
        arg NtcNr_Arg: type=NtcNr1, direction=IN
        arg NtcActv_Arg: type=boolean, direction=OUT
      error E_NOT_OK: error-code=1
    GetNtcActvCore_PortIf1
      operation Oper
        arg NtcNr_Arg: type=NtcNr1, direction=IN
        arg NtcActv_Arg: type=boolean, direction=OUT
    GetNtcDebCntrApplX_PortIf1
      operation Oper
        arg DebCntrIdx_Arg: type=uint8, direction=IN
        arg DebCntr_Arg: type=sint16, direction=OUT
    GetNtcInfoApplX_PortIf2
      operation Oper
        arg NtcInfoIdx_Arg: type=uint8, direction=IN
        arg NtcInfo_Arg: type=NtcInfoRec4, direction=OUT
    GetNtcQlfrSts_PortIf1
      operation Oper: possible-error=GetNtcQlfrSts_PortIf1/E_NOT_OK
        arg NtcNr_Arg: type=NtcNr1, direction=IN
        arg NtcQlfr_Arg: type=SigQlfr1, direction=OUT
      error E_NOT_OK: error-code=1
    GetNtcQlfrStsCore_PortIf1
      operation Oper
        arg NtcNr_Arg: type=NtcNr1, direction=IN
        arg NtcQlfr_Arg: type=SigQlfr1, direction=OUT
    GetNtcSts_PortIf1
      operation Oper: possible-error=GetNtcSts_PortIf1/E_NOT_OK
        arg NtcNr_Arg: type=NtcNr1, direction=IN
        arg NtcInfoSts_Arg: type=uint8, direction=OUT
      error E_NOT_OK: error-code=1
    GetNtcStsCore_PortIf1
      operation Oper
        arg NtcNr_Arg: type=NtcNr1, direction=IN
        arg NtcInfoSts_Arg: type=uint8, direction=OUT
    ReadNtcFltAry_PortIf1
      operation Oper
        arg DiagcMgrReadFltInfo_Arg: type=Ary1D_ReadFltInfoRec1_20, direction=OUT
    ReadNtcInfoAndDebCntr_PortIf1
      operation Oper
        arg NtcNr_Arg: type=NtcNr1, direction=IN
        arg NtcInfo_Arg: type=NtcInfoRec4, direction=OUT
        arg DebCntr_Arg: type=sint16, direction=OUT
    ReadSnpshtData_PortIf1
      operation Oper
        arg ReadSnpshtDataAry_Arg: type=Ary1D_SnpshtDataRec1_8, direction=OUT
    SetNtcSts_PortIf1
      operation Oper: possible-error=SetNtcSts_PortIf1/E_NOT_OK
        4 x arg, all with direction=IN:
          NtcNr_Arg: type=NtcNr1
          NtcStInfo_Arg: type=uint8
          NtcSts_Arg: type=NtcSts1
          DebStep_Arg: type=uint16
      error E_NOT_OK: error-code=1
    SetNtcStsCore_PortIf1
      operation Oper: possible-error=SetNtcStsCore_PortIf1/E_NOT_OK
        8 x arg:
          NtcNr_Arg: type=NtcNr1, direction=IN
          NtcStInfo_Arg: type=uint8, direction=IN
          NtcSts_Arg: type=NtcSts1, direction=IN
          DebStep_Arg: type=uint16, direction=IN
          DiagcData_Arg: type=DiagcDataRec1, direction=INOUT
          ProxySetNtcData_Arg: type=DiagcDataRec1, direction=INOUT
          NtcInfo_Arg: type=NtcInfoRec4, direction=INOUT
          NtcInfoDebCntr_Arg: type=sint16, direction=INOUT
      error E_NOT_OK: error-code=1
  6 x sender receiver interface:
    boolean_PortIf1: invalidation-policy{data-element=Logl, handle-invalid=DONT-INVALIDATE}
      data Logl: sw-calibration-access=READ-ONLY, type=boolean
    float32_PortIf1: invalidation-policy{data-element=float32_PortIf1/Val, handle-invalid=DONT-INVALIDATE}
      data Val: sw-calibration-access=READ-ONLY, type=float32
    MfgEnaSt1_PortIf1: invalidation-policy{data-element=MfgEnaSt1_PortIf1/Val, handle-invalid=DONT-INVALIDATE}
      data Val: sw-calibration-access=READ-ONLY, type=MfgEnaSt1
    SysSt1_PortIf1: invalidation-policy{data-element=SysSt1_PortIf1/Val, handle-invalid=DONT-INVALIDATE}
      data Val: sw-calibration-access=READ-ONLY, type=SysSt1
    uint32_PortIf1: invalidation-policy{data-element=uint32_PortIf1/Val, handle-invalid=DONT-INVALIDATE}
      data Val: sw-calibration-access=READ-ONLY, type=uint32
    uint8_PortIf1: invalidation-policy{data-element=uint8_PortIf1/Val, handle-invalid=DONT-INVALIDATE}
      data Val: sw-calibration-access=READ-ONLY, type=uint8
