AUTOSAR XML (schema 4-0-3)
package /ActiveEcuC
  ecuc value collection ActiveEcuC: ecuc-values=[Rte, DiagcMgr, Os, Dem, Dem]
  module config Rte: implementation-config-variant=VARIANT-PRE-COMPILE, module-description=Rte_Impl
    RteBswGeneral: RteSchMVersionInfoApi=false, RteUseComShadowSignalApi=false
    RteGeneration:
      RteCalibrationSupport = NONE
      RteCodeVendorId = 30
      RteDevErrorDetect = false
      RteDevErrorDetectUninit = false
      RteGenerationMode = COMPATIBILITY_MODE
      RteIocInteractionReturnValue = RTE_IOC
      RteMeasurementSupport = false
      RteOptimizationMode = MEMORY
      RteValueRangeCheckEnabled = false
      RteVfbTraceEnabled = false
      RteEnforceIoc = false
      RteXcpEventSupport = false
    RteInitializationBehavior: RteInitializationStrategy=RTE_INITIALIZATION_STRATEGY_AT_RTE_START_AND_PARTITION_RESTART, RteSectionInitializationPolicy=
    RteOsInteraction
    Rte (RteBswModuleInstance): RteBswImplementationRef=Rte_Impl, RteBswModuleConfigurationRef=Rte
  module config DiagcMgr: implementation-config-variant=VARIANT-PRE-COMPILE, module-description=DiagcMgr_Impl
    118 x NTCNR:
      NTCNR_0X001: Debounce=false, NTCOsApplicationRef=Appl9
      NTCNR_0X002: Debounce=false, NTCOsApplicationRef=Appl10
      NTCNR_0X003: Debounce=false, NTCOsApplicationRef=Appl10
      NTCNR_0X006: Debounce=false, NTCOsApplicationRef=Appl10
      NTCNR_0X007: Debounce=false, NTCOsApplicationRef=Appl10
      NTCNR_0X00A: Debounce=false, NTCOsApplicationRef=Appl0
      NTCNR_0X03C: Debounce=false, NTCOsApplicationRef=Appl10
      NTCNR_0X193: Debounce=false, NTCOsApplicationRef=Appl6
      NTCNR_0X198: Debounce=false, NTCOsApplicationRef=Appl6
      NTCNR_0X199: Debounce=false, NTCOsApplicationRef=Appl6
      NTCNR_0X1A0: Debounce=true, NTCOsApplicationRef=Appl6
      NTCNR_0X1A1: Debounce=true, NTCOsApplicationRef=Appl6
      NTCNR_0X1FF: Debounce=false, NTCOsApplicationRef=Appl6
      NTCNR_0X008: Debounce=false, NTCOsApplicationRef=Appl10
      NTCNR_0X010: Debounce=true, NTCOsApplicationRef=Appl10
      NTCNR_0X012: Debounce=true, NTCOsApplicationRef=Appl10
      NTCNR_0X013: Debounce=true, NTCOsApplicationRef=Appl10
      NTCNR_0X{016..019}: Debounce=true, NTCOsApplicationRef=Appl10
      NTCNR_0X01A: Debounce=false, NTCOsApplicationRef=Appl10
      NTCNR_0X01B: Debounce=true, NTCOsApplicationRef=Appl10
      NTCNR_0X021: Debounce=true, NTCOsApplicationRef=Appl10
      NTCNR_0X022: Debounce=false, NTCOsApplicationRef=Appl10
      NTCNR_0X025: Debounce=false, NTCOsApplicationRef=Appl10
      NTCNR_0X026: Debounce=false, NTCOsApplicationRef=Appl10
      NTCNR_0X028: Debounce=false, NTCOsApplicationRef=Appl10
      NTCNR_0X029: Debounce=false, NTCOsApplicationRef=Appl10
      NTCNR_0X02A: Debounce=false, NTCOsApplicationRef=Appl10
      NTCNR_0X02C: Debounce=false, NTCOsApplicationRef=Appl10
      NTCNR_0X02D: Debounce=false, NTCOsApplicationRef=Appl10
      NTCNR_0X030: Debounce=false, NTCOsApplicationRef=Appl10
      NTCNR_0X031: Debounce=false, NTCOsApplicationRef=Appl10
      NTCNR_0X036: Debounce=false, NTCOsApplicationRef=Appl10
      NTCNR_0X{039..042}: Debounce=false, NTCOsApplicationRef=Appl10
      NTCNR_0X044: Debounce=false, NTCOsApplicationRef=Appl10
      NTCNR_0X045: Debounce=false, NTCOsApplicationRef=Appl10
      NTCNR_0X048: Debounce=false, NTCOsApplicationRef=Appl10
      NTCNR_0X049: Debounce=false, NTCOsApplicationRef=Appl10
      NTCNR_0X04A: Debounce=false, NTCOsApplicationRef=Appl10
      NTCNR_0X04C: Debounce=false, NTCOsApplicationRef=Appl10
      NTCNR_0X04D: Debounce=false, NTCOsApplicationRef=Appl10
      NTCNR_0X04E: Debounce=false, NTCOsApplicationRef=Appl10
      NTCNR_0X050: Debounce=false, NTCOsApplicationRef=Appl10
      NTCNR_0X054: Debounce=false, NTCOsApplicationRef=Appl10
      NTCNR_0X05D: Debounce=false, NTCOsApplicationRef=Appl10
      NTCNR_0X060: Debounce=false, NTCOsApplicationRef=Appl10
      NTCNR_0X064: Debounce=false, NTCOsApplicationRef=Appl10
      NTCNR_0X06D: Debounce=false, NTCOsApplicationRef=Appl10
      NTCNR_0X070: Debounce=false, NTCOsApplicationRef=Appl10
      NTCNR_0X071: Debounce=false, NTCOsApplicationRef=Appl10
      NTCNR_0X07B: Debounce=false, NTCOsApplicationRef=Appl10
      NTCNR_0X07C: Debounce=false, NTCOsApplicationRef=Appl10
      NTCNR_0X07D: Debounce=false, NTCOsApplicationRef=Appl10
      NTCNR_0X{080..082}: Debounce=false, NTCOsApplicationRef=Appl10
      NTCNR_0X092: Debounce=false, NTCOsApplicationRef=Appl10
      NTCNR_0X0A3: Debounce=false, NTCOsApplicationRef=Appl1
      NTCNR_0X0A4: Debounce=false, NTCOsApplicationRef=Appl2
      NTCNR_0X0AA: Debounce=false, NTCOsApplicationRef=Appl3
      NTCNR_0X0AB: Debounce=false, NTCOsApplicationRef=Appl4
      NTCNR_0X0AC: Debounce=false, NTCOsApplicationRef=Appl5
      NTCNR_0X0AD: Debounce=false, NTCOsApplicationRef=Appl7
      NTCNR_0X0AE: Debounce=false, NTCOsApplicationRef=Appl8
      NTCNR_0X0AF: Debounce=false, NTCOsApplicationRef=Appl9
      NTCNR_0X0B{0..2}: Debounce=false, NTCOsApplicationRef=Appl{0..2}
      NTCNR_0X0B5: Debounce=false, NTCOsApplicationRef=Appl3
      NTCNR_0X0BF: Debounce=false, NTCOsApplicationRef=Appl4
      NTCNR_0X0C4: Debounce=false, NTCOsApplicationRef=Appl5
      NTCNR_0X0E0: Debounce=false, NTCOsApplicationRef=Appl7
      NTCNR_0X0E1: Debounce=false, NTCOsApplicationRef=Appl8
      NTCNR_0X100: Debounce=false, NTCOsApplicationRef=Appl6
      NTCNR_0X110: Debounce=false, NTCOsApplicationRef=Appl6
      NTCNR_0X128: Debounce=false, NTCOsApplicationRef=Appl6
      NTCNR_0X129: Debounce=false, NTCOsApplicationRef=Appl6
      NTCNR_0X131: Debounce=false, NTCOsApplicationRef=Appl6
      NTCNR_0X138: Debounce=false, NTCOsApplicationRef=Appl6
      NTCNR_0X139: Debounce=false, NTCOsApplicationRef=Appl6
      NTCNR_0X141: Debounce=false, NTCOsApplicationRef=Appl6
      NTCNR_0X148: Debounce=false, NTCOsApplicationRef=Appl6
      NTCNR_0X149: Debounce=false, NTCOsApplicationRef=Appl6
      NTCNR_0X160: Debounce=false, NTCOsApplicationRef=Appl6
      NTCNR_0X161: Debounce=false, NTCOsApplicationRef=Appl6
      NTCNR_0X{168..171}: Debounce=false, NTCOsApplicationRef=Appl6
      NTCNR_0X178: Debounce=false, NTCOsApplicationRef=Appl6
      NTCNR_0X179: Debounce=false, NTCOsApplicationRef=Appl6
      NTCNR_0X17A: Debounce=false, NTCOsApplicationRef=Appl6
      NTCNR_0X17B: Debounce=false, NTCOsApplicationRef=Appl6
      NTCNR_0X188: Debounce=false, NTCOsApplicationRef=Appl6
      NTCNR_0X189: Debounce=false, NTCOsApplicationRef=Appl6
      NTCNR_0X191: Debounce=false, NTCOsApplicationRef=Appl6
      NTCNR_0X192: Debounce=false, NTCOsApplicationRef=Appl6
      NTCNR_0X1A9: Debounce=false, NTCOsApplicationRef=Appl6
      NTCNR_0X1B0: Debounce=false, NTCOsApplicationRef=Appl6
      NTCNR_0X1B1: Debounce=false, NTCOsApplicationRef=Appl6
      NTCNR_0X1B8: Debounce=false, NTCOsApplicationRef=Appl6
      NTCNR_0X1B9: Debounce=false, NTCOsApplicationRef=Appl6
      NTCNR_0X1C{1..3}: Debounce=false, NTCOsApplicationRef=Appl6
      NTCNR_0X1C8: Debounce=false, NTCOsApplicationRef=Appl6
      NTCNR_0X1C9: Debounce=false, NTCOsApplicationRef=Appl6
      NTCNR_0X1EC: Debounce=false, NTCOsApplicationRef=Appl6
      NTCNR_0X1ED: Debounce=false, NTCOsApplicationRef=Appl10
      NTCNR_0X1F2: Debounce=false, NTCOsApplicationRef=Appl10
      NTCNR_0X1F{6..8}: Debounce=false, NTCOsApplicationRef=Appl10
    DiagcMgrGeneral: DIAGCMGR_DEMCHK=STD_ON, DEMTOTNROFDTC=TblSize_m(Dem_C_DtcTable)
    DTC1 (DTCEnaCndn):
      Bit_15 = true
      Bit_14 = false
      Bit_13 = false
      Bit_12 = false
      Bit_11 = false
      Bit_10 = false
      Bit__9 = false
      Bit__8 = false
      Bit__7 = false
      Bit__6 = false
      Bit__5 = false
      Bit__4 = false
      Bit__3 = true
      Bit__2 = false
      Bit__1 = true
      Bit__0 = true
      DiagcMgrDTCIdx = 1
      DTC = TestDTC
    DTC2 (DTCEnaCndn):
      Bit_15 = false
      Bit_14 = false
      Bit_13 = false
      Bit_12 = false
      Bit_11 = false
      Bit_10 = false
      Bit__9 = false
      Bit__8 = false
      Bit__7 = false
      Bit__6 = false
      Bit__5 = false
      Bit__4 = true
      Bit__3 = false
      Bit__2 = false
      Bit__1 = false
      Bit__0 = false
      DiagcMgrDTCIdx = 2
      DTC = TestDTC1
  module config Os: implementation-config-variant=VARIANT-PRE-COMPILE, module-description=Os_Impl
    OsOS:
      OsStackMonitoring = false
      OsOSStackUsageMeasurement = AUTO
      OsStatus = EXTENDED
      OsUseGetServiceId = false
      OsUseParameterAccess = false
      OsUseResScheduler = false
      OsOSCallISRHooks = false
      OsOSSystemTimerNestable = false
      OsOSMemoryProtection = false
      OsOSEnumeratedUnhandledISRs = false
      OsOSORTIDebugSupport = false
      OsOSTypeHeaderInclude = true
      OsOSCpuFrequency = 160
      OsOSTimerClockDivider = 1
      OsOSUserConfigurationVersion = 1
      OsOSSystemStackSize = 200
      OsOSSystemTimerPriority = 15
      OsOSSystemTimerStackSize = 200
      OsOSTickTime = 1000
      OsOSSystemTimer = OSTM0
      OsOSOSInternalChecks = Additional
      OsOSCompiler = GHS
      OsOSORTIDebugLevel = ORTI_22_Additional
      OsOSSCHEDULE
        AUTO
      OsOSCC
        AUTO
      OsOSProtectionHookReaction
        Selected: OsOSSHUTDOWN=true
      OsOSTimingMeasurement
        TRUE: OsOSGlobalConfig=AsSelected
      OsHooks: OsErrorHook=true, OsPostTaskHook=false, OsPreTaskHook=false, OsShutdownHook=true, OsStartupHook=true, OsProtectionHook=true
    VectorCommonData: BswmdVersion=6.05.00
    OsImplementationInformation: OsVectorOilVersion=4.0, OsVectorImplementationName=RenesasRH850_P1M.i40, OsBswmdStyleVersion=2
    OSDEFAULTAPPMODE (OsAppMode)
    SystemTimer (OsCounter): OsCounterMaxAllowedValue=2147483647, OsCounterTicksPerBase=1, OsCounterMinCycle=1, OsSecondsPerTick=1234567890, OsCounterType=SOFTWARE
    11 x OsApplication, all with OsTrusted=false, OsAppGenerateStub=false:
      Appl10
        OsApplicationHooks: OsAppStartupHook=false, OsAppShutdownHook=false, OsAppErrorHook=false
      Appl6
        OsApplicationHooks: OsAppStartupHook=false, OsAppShutdownHook=false, OsAppErrorHook=false
      Appl0
        OsApplicationHooks: OsAppStartupHook=false, OsAppShutdownHook=false, OsAppErrorHook=false
      Appl1
        OsApplicationHooks: OsAppStartupHook=false, OsAppShutdownHook=false, OsAppErrorHook=false
      Appl2
        OsApplicationHooks: OsAppStartupHook=false, OsAppShutdownHook=false, OsAppErrorHook=false
      Appl3
        OsApplicationHooks: OsAppStartupHook=false, OsAppShutdownHook=false, OsAppErrorHook=false
      Appl4
        OsApplicationHooks: OsAppStartupHook=false, OsAppShutdownHook=false, OsAppErrorHook=false
      Appl5
        OsApplicationHooks: OsAppStartupHook=false, OsAppShutdownHook=false, OsAppErrorHook=false
      Appl7
        OsApplicationHooks: OsAppStartupHook=false, OsAppShutdownHook=false, OsAppErrorHook=false
      Appl8
        OsApplicationHooks: OsAppStartupHook=false, OsAppShutdownHook=false, OsAppErrorHook=false
      Appl9
        OsApplicationHooks: OsAppStartupHook=false, OsAppShutdownHook=false, OsAppErrorHook=false
  module config Dem: implementation-config-variant=VARIANT-PRE-COMPILE, module-description=Dem_Impl
    DemConfigSet
      TestEvent1 (DemEventParameter): DemEventId=1, DemEventKind=DEM_EVENT_KIND_SWC, DemDTCClassRef=TestDTC
        DemEventClass:
          DemAgingAllowed = true
          DemConsiderPtoStatus = false
          DemEventDestination = DEM_DTC_ORIGIN_PRIMARY_MEMORY
          DemEventOBDReadinessGroup = DEM_OBD_RDY_NONE
          DemEventPriority = 2
          DemFFPrestorageSupported = false
          DemAgingCycleCounterThreshold = 50
          DemOperationCycleRef = DemOperationCycle
          DemAgingCycleRef = DemOperationCycle
          DemDebounceAlgorithmClass
            DemDebounceMonitorInternal
              DemCallbackGetFDC
      TestDTC (DemDTCClass): DemDTCFunctionalUnit=255, DemImmediateNvStorage=false, DemUdsDTC=1193131
      TestDTC1 (DemDTCClass): DemDTCFunctionalUnit=255, DemImmediateNvStorage=false, DemUdsDTC=1193046
      TestEvent2 (DemEventParameter): DemEventId=2, DemEventKind=DEM_EVENT_KIND_SWC, DemDTCClassRef=TestDTC1
        DemEventClass:
          DemAgingAllowed = false
          DemConsiderPtoStatus = false
          DemEventDestination = DEM_DTC_ORIGIN_PRIMARY_MEMORY
          DemEventOBDReadinessGroup = DEM_OBD_RDY_NONE
          DemEventPriority = 2
          DemFFPrestorageSupported = false
          DemAgingCycleCounterThreshold = 50
          DemOperationCycleRef = DemOperationCycle
          DemAgingCycleRef = DemOperationCycle
          DemDebounceAlgorithmClass
            DemDebounceMonitorInternal
              DemCallbackGetFDC
      TestEvent3 (DemEventParameter): DemEventId=3, DemEventKind=DEM_EVENT_KIND_SWC
        DemEventClass:
          DemAgingAllowed = false
          DemConsiderPtoStatus = false
          DemEventDestination = DEM_DTC_ORIGIN_PRIMARY_MEMORY
          DemEventOBDReadinessGroup = DEM_OBD_RDY_NONE
          DemEventPriority = 2
          DemFFPrestorageSupported = false
          DemOperationCycleRef = DemOperationCycle
          DemDebounceAlgorithmClass
            DemDebounceMonitorInternal
              DemCallbackGetFDC
    DemGeneral:
      DemAgingCycleCounterProcessing = DEM_PROCESS_AGINGCTR_INTERN
      DemBswErrorBufferSize = 0
      DemClearDTCBehavior = DEM_CLRRESP_VOLATILE
      DemDTCSuppressionSupport = false
      DemDebounceCounterBasedSupport = true
      DemDebounceTimeBasedSupport = false
      DemDevErrorDetect = false
      DemDtcStatusAvailabilityMask = 255
      DemEnableConditionSupport = false
      DemEventCombinationSupport = DEM_EVCOMB_DISABLED
      DemEventDisplacementStrategy = DEM_DISPLACEMENT_LEGACY_403
      DemMaxNumberEventEntryMirror = 0
      DemMaxNumberEventEntryPermanent = 0
      DemMaxNumberEventEntryPrimary = 8
      DemMaxNumberEventEntrySecondary = 0
      DemMaxNumberPrestoredFF = 0
      DemOBDSupport = DEM_OBD_NO_OBD_SUPPORT
      DemOccurrenceCounterProcessing = DEM_PROCESS_OCCCTR_TF
      DemOperationCycleProcessing = DEM_PROCESS_OPCYC_STATE
      DemOperationCycleStatusStorage = false
      DemPTOSupport = false
      DemStatusBitHandlingTestFailedSinceLastClear = DEM_STATUS_BIT_NORMAL
      DemStatusBitStorageTestFailed = true
      DemStorageConditionSupport = false
      DemTaskTime = 0.01
      DemTriggerDcmReports = false
      DemTriggerDltReports = false
      DemTriggerFiMReports = false
      DemTriggerMonitorInitBeforeClearOk = true
      DemTypeOfDTCSupported = DEM_DTC_TRANSLATION_ISO14229_1
      DemTypeOfFreezeFrameRecordNumeration = DEM_FF_RECNUM_CALCULATED
      DemVersionInfoApi = false
      DemUseRte = true
      DemGeneralDiagnosticInfoSupport = true
      DemEventStorageTrigger = DEM_STORAGE_TRIGGER_FAILED
      DemPendingDtcProcessing = DEM_PROCESS_PDTC_STOREDONLY
      DemWarningIndicatorRequestedProcessing = DEM_PROCESS_WIR_STOREDONLY
      DemAgingBehavior = DEM_AGING_AT_PASSED
      DemSuppressionSupport = DEM_NO_SUPPRESSION
      DemMaxNumberEventEntryOBDFreezeFrame = 0
      DemAgingRetainEnvironmentalData = false
      DemEventDisplacementFallbackStrategy = DEM_FALLBACK_DISCARD_NEW_EVENT
      DemResetConfirmedBitOnOverflow = true
      DemOperationCycle: DemOperationCycleType=DEM_OPCYC_OTHER
      DemPostbuild: DemMaxSizeFreezeFrame=0
