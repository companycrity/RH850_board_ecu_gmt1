AUTOSAR XML (schema 4-0-3)
standard types defined: float32_DataConstr, float64_DataConstr, sint16_DataConstr, sint32_DataConstr, sint8_DataConstr, uint16_DataConstr, uint32_DataConstr, uint8_DataConstr, boolean, float32, float64, sint16, sint32, sint8, uint16, uint32, uint8
package /Nexteer/DataTypeMappingSets
  data type mapping set Nexteer
    data-type-maps:
      application-data-type=Tq2, implementation-data-type=float32
      application-data-type=Ti3, implementation-data-type=uint32
      application-data-type=Cnt8, implementation-data-type=uint32
      application-data-type=Gain1, implementation-data-type=float32
      application-data-type=Volt2, implementation-data-type=float32
      application-data-type=Tq1, implementation-data-type=float32
      application-data-type=Cnt5, implementation-data-type=uint16
      application-data-type=Cnt1, implementation-data-type=uint8
      application-data-type=T3, implementation-data-type=float32
      application-data-type=Volt3, implementation-data-type=float32
      application-data-type=T1, implementation-data-type=float32
      application-data-type=Ti1, implementation-data-type=uint32
      application-data-type=T2, implementation-data-type=float32
      application-data-type=Cnt3, implementation-data-type=uint16
      application-data-type=Ti4, implementation-data-type=uint32
      application-data-type=Volt5, implementation-data-type=float32
      application-data-type=Frq1, implementation-data-type=float32
      application-data-type=Uls1, implementation-data-type=float32
      application-data-type=Cnt7, implementation-data-type=uint8
      application-data-type=Cnt4, implementation-data-type=uint16
      application-data-type=Curr2, implementation-data-type=float32
      application-data-type=Ti2, implementation-data-type=uint32
      application-data-type=Volt6, implementation-data-type=float32
      application-data-type=Volt1, implementation-data-type=float32
      application-data-type=Curr1, implementation-data-type=float32
      application-data-type=Cnt6, implementation-data-type=uint8
      application-data-type=Cnt2, implementation-data-type=sint8
      application-data-type=Volt4, implementation-data-type=float32
      application-data-type=T4, implementation-data-type=float32
package /Nexteer/DataTypes
  29 x app type, all with category=VALUE, sw-calibration-access=READ-ONLY:
    Cnt1: range phys 1..4, unit=Cnt
    Cnt2: range phys -1..1, unit=Cnt
    Cnt3: range phys 0..1, unit=Cnt
    Cnt4: range phys 0..31, unit=Cnt
    Cnt5: range phys 0..32767, unit=Cnt
    Cnt6: range phys 0..63, unit=Cnt
    Cnt7: range phys 20..160, unit=Cnt
    Cnt8: range phys 0..1800, unit=Cnt
    Curr1: range phys -145..145, unit=Amp
    Curr2: range phys 0..50, unit=Amp
    Frq1: range phys 0.1..10, unit=Hz
    Gain1: range phys 0..200, unit=degC/Volt
    T1: range phys -50..150, unit=degC
    T2: range phys -50..200, unit=degC
    T3: range phys -50..300, unit=degC
    T4: range phys -100..150, unit=degC
    Ti1: range phys 0..25000, unit=nS
    Ti2: range phys 1..1000, unit=nS
    Ti3: range phys 0..71429, unit=nS
    Ti4: range phys 55555..71429, unit=nS
    Tq1: range phys -8.8..8.8, unit=MotNm
    Tq2: range phys -10..10, unit=HwNm
    Uls1: range phys 0.5..1, unit=Uls
    Volt1: range phys 6..26.5, unit=V
    Volt2: range phys 6..16, unit=V
    Volt3: range phys 0..5, unit=V
    Volt4: range phys 0..26.5, unit=V
    Volt5: range phys 0..16, unit=V
    Volt6: range phys 0..40, unit=V
  4 x impl type, all with category=TYPE_REFERENCE, type-emitter=RTE:
    NtcNr1: compu {1..511=NTCNR_0X001..NTCNR_0X1FF}, implementation-data-type=uint16
    NtcSts1: compu {0=NTCSTS_PASSD, 1=NTCSTS_FAILD, 2=NTCSTS_PREPASSD, 3=NTCSTS_PREFAILD}, implementation-data-type=uint8
    SigQlfr1: compu {0=SIGQLFR_NORES, 1=SIGQLFR_PASSD, 2=SIGQLFR_FAILD}, implementation-data-type=uint8
    SysSt1: compu {0=SYSST_DI, 1=SYSST_OFF, 2=SYSST_ENA, 3=SYSST_WRMININ}, implementation-data-type=uint8
package /Nexteer/DataTypes/CompuMethods
  compu method BattSwdVltgCorrlnSts1: 0=BSVCS_NOFLT, 1=BSVCS_BATTVLTGSWD2FLT, 2=BSVCS_BATTVLTGSWD1FLT, 3=BSVCS_BATTVLTGFLT, 4=BSVCS_NOCORRLN
  compu method MotCurrEolCalSt1: 1=MCECS_OFFSCMDHI, 2=MCECS_OFFSCMDLO, 3=MCECS_OFFSCMDZERO, 4=MCECS_OFFSCMDEND, 5=MCECS_GAINCMDAD, 6=MCECS_GAINCMDBE, 7=MCECS_GAINCMDCF, 8=MCECS_CMDSAFEST
  compu method MotCurrEolCalSt2: 0=MCECS_OFFSCMDSTRT, 1=MCECS_OFFSCMDHI, 2=MCECS_OFFSCMDLO, 3=MCECS_OFFSCMDZERO, 4=MCECS_OFFSCMDEND, 5=MCECS_GAINCMDAD, 6=MCECS_GAINCMDBE, 7=MCECS_GAINCMDCF, 8=MCECS_CMDSAFEST
  compu method StrtUpSt1: 1=STRTUPST_PWRDISCNCTATESTCMPL, 2=STRTUPST_PWRDISCNCTBTESTCMPL, 3=STRTUPST_TMPLMONININTESTCMPL, 4=STRTUPST_MOTDRVRININCMPL, 5=STRTUPST_CURRMEASWRMININTESTCMPL, 6=STRTUPST_WARMININCMPL, 7=STRTUPST_RUN, 8=STRTUPST_DISABLE
package /Nexteer/Units
  10 x unit, all with factor-si-to-unit=1, offset-si-to-unit=0:
    Ampr: display-name=Amp
    Cnt: display-name=Cnt
    DegCgrd: display-name=degC
    DegCgrdPerVolt: display-name=degC/Volt
    HwNwtMtr: display-name=HwNm
    Hz: display-name=Hz
    MotNwtMtr: display-name=MotNm
    NanoSec: display-name=nS
    Uls: display-name=Uls
    Volt: display-name=V
