AUTOSAR XML (schema 4-0-3)
package /Nexteer/Calibrations
  parameter interface Cnt2
    parameter data prototype Val: sw-calibration-access=READ-WRITE, type=uint16
  parameter interface Volt1
    parameter data prototype Val: sw-calibration-access=READ-WRITE, type=Volt1
  parameter interface Volt2
    parameter data prototype Val: sw-calibration-access=READ-WRITE, type=Volt3
package /Nexteer/PortInterfaces
  client server interface GetNtcQlfrSts1
    operation Oper: possible-error=GetNtcQlfrSts1/E_NOT_OK
      arg NtcNr: type=NtcNr1, direction=IN
      arg NtcQlfr: type=SigQlfr1, direction=OUT
    error E_NOT_OK: error-code=1
  client server interface SetNtcSts1
    operation Oper: possible-error=SetNtcSts1/E_NOT_OK
      4 x arg, all with direction=IN:
        NtcNr: type=NtcNr1
        NtcStInfo: type=uint8
        NtcSts: type=NtcSts1
        DebStep: type=uint16
    error E_NOT_OK: error-code=1
  4 x sender receiver interface:
    Cnt6: invalidation-policy{data-element=Cnt6/Val, handle-invalid=DONT-INVALIDATE}
      data Val: sw-calibration-access=READ-ONLY, type=uint8
    Logl1: invalidation-policy{data-element=Logl, handle-invalid=DONT-INVALIDATE}
      data Logl: sw-calibration-access=READ-ONLY, type=boolean
    SysSt1: invalidation-policy{data-element=SysSt1/Val, handle-invalid=DONT-INVALIDATE}
      data Val: sw-calibration-access=READ-ONLY, type=SysSt1
    Volt4: invalidation-policy{data-element=Volt4/Val, handle-invalid=DONT-INVALIDATE}
      data Val: sw-calibration-access=READ-ONLY, type=Volt6
