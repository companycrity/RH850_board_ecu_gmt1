AUTOSAR XML (schema 4-0-3)
package /Nexteer/Calibrations
  14 x parameter interface:
    Ag5
      parameter data prototype Val: sw-calibration-access=READ-WRITE, type=Ag16
    AgAry2D1
      parameter data prototype Ary2D: sw-calibration-access=READ-WRITE, type=AgAry2D1
    Rate2
      parameter data prototype Val: sw-calibration-access=READ-WRITE, type=Rate4
    SpdAry1D2
      parameter data prototype Ary1D: sw-calibration-access=READ-WRITE, type=SpdAry1D2
    TAry1D3
      parameter data prototype Ary1D: sw-calibration-access=READ-WRITE, type=TAry1D1
    TqAry2D6
      parameter data prototype Ary2D: sw-calibration-access=READ-WRITE, type=TqAry2D6
    TqAry2D7
      parameter data prototype Ary2D: sw-calibration-access=READ-WRITE, type=TqAry2D7
    UlsAry1D10
      parameter data prototype Ary1D: sw-calibration-access=READ-WRITE, type=UlsAry1D15
    UlsAry1D4
      parameter data prototype Ary1D: sw-calibration-access=READ-WRITE, type=UlsAry1D7
    UlsAry1D5
      parameter data prototype Ary1D: sw-calibration-access=READ-WRITE, type=UlsAry1D8
    UlsAry2D3
      parameter data prototype Ary2D: sw-calibration-access=READ-WRITE, type=UlsAry2D3
    UlsAry2D4
      parameter data prototype Ary2D: sw-calibration-access=READ-WRITE, type=UlsAry2D4
    Vel2
      parameter data prototype Val: sw-calibration-access=READ-WRITE, type=Vel5
    VelAry2D2
      parameter data prototype Ary2D: sw-calibration-access=READ-WRITE, type=VelAry2D2
package /Nexteer/PortInterfaces
  client server interface FltInj2
    operation Oper
      arg SigPah_Arg: type=Uls5, direction=INOUT
      arg LocnKey_Arg: type=Cnt16, direction=IN
  10 x sender receiver interface:
    Ag7: invalidation-policy{data-element=Ag7/Val, handle-invalid=DONT-INVALIDATE}
      data Val: sw-calibration-access=READ-ONLY, type=Ag15
    Ag8: invalidation-policy{data-element=Ag8/Val, handle-invalid=DONT-INVALIDATE}
      data Val: sw-calibration-access=READ-ONLY, type=Ag16
    boolean_PortIf1: invalidation-policy{data-element=boolean_PortIf1/Logl, handle-invalid=DONT-INVALIDATE}
      data Logl: sw-calibration-access=READ-ONLY, type=boolean
    Logl2: invalidation-policy{data-element=Logl2/Logl, handle-invalid=DONT-INVALIDATE}
      data Logl: sw-calibration-access=READ-ONLY, type=Logl1
    Spd1: invalidation-policy{data-element=Spd1/Val, handle-invalid=DONT-INVALIDATE}
      data Val: sw-calibration-access=READ-ONLY, type=Spd1
    T1: invalidation-policy{data-element=T1/Val, handle-invalid=DONT-INVALIDATE}
      data Val: sw-calibration-access=READ-ONLY, type=T1
    Tq1: invalidation-policy{data-element=Tq1/Val, handle-invalid=DONT-INVALIDATE}
      data Val: sw-calibration-access=READ-ONLY, type=Tq1
    Tq2: invalidation-policy{data-element=Tq2/Val, handle-invalid=DONT-INVALIDATE}
      data Val: sw-calibration-access=READ-ONLY, type=Tq2
    Uls2: invalidation-policy{data-element=Uls2/Val, handle-invalid=DONT-INVALIDATE}
      data Val: sw-calibration-access=READ-ONLY, type=Uls2
    Vel2: invalidation-policy{data-element=Vel2/Val, handle-invalid=DONT-INVALIDATE}
      data Val: sw-calibration-access=READ-ONLY, type=Vel3
