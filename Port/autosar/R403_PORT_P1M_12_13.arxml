[part 2 of 3: package /Renesas/EcucDefs_Port]
AUTOSAR XML (schema 4-0-3)
# COPYRIGHT
# Copyright(c) 2014-2016 Renesas Electronics Corporation
package /Renesas/EcucDefs_Port  (continued)
  module definition Port: refined-module-def=Port, variants post-build  (continued)
    container PortConfigSet: multiple-configuration-container=true  (continued)
      container PortGroup1  # This container contains the configuration (parameters) for Port Group 1.
        container PortPin1  # This container contains the configuration (parameters) for Port Pin 1.
          boolean PortPinDirectionChangeable: set at post-build, origin=Renesas_v1.0.0, default-value=false  # Parameter to indicate if the direction is changeable on a port pin during runtime. true: Port Pin direction changeable enabled. false: Port Pin direction changeable disabled.
          boolean PortPinDioAltModeChangeable: set at post-build, origin=Renesas_v1.0.0, default-value=false  # Parameter to indicate if the mode of a port pin is changeable between DIO and Alternate during runtime by API functions Port_SetToDioMode and Port_SetToAlternateMode. Including these APIs is controlled by PortSetToDioAltModeApi. true: Dio Alternate mode is changeable. false: Dio Alternate mode is not changeable.
          boolean PortPinModeChangeable: set at post-build, origin=Renesas_v1.0.0, default-value=false  # Parameter to indicate if the mode of a port pin is changeable during runtime by API function Port_SetPinMode. Including this API is controlled by PortSetPinModeApi. true: Port Pin mode is changeable. false: Port Pin mode is not changeable.
          enumeration PortPinLevelValue: {PORT_PIN_LEVEL_LOW, PORT_PIN_LEVEL_HIGH}, set at post-build, origin=Renesas_v1.0.0, default-value=PORT_PIN_LEVEL_LOW  # Parameter to indicate port pin level value for a port pin. PORT_PIN_LEVEL_LOW: Port pin Level is low. PORT_PIN_LEVEL_HIGH: Port pin Level is high.
          enumeration PortPinInitialMode: {TAUJ2I0_ALT1_IN, TAUJ2O0_ALT1_OUT, TAUJ1I0_ALT2_IN, TAUJ1O0_ALT2_OUT, TAUD2I12_ALT3_IN, TAUD2O12_ALT3_OUT, RLIN30RX_ALT4_IN, INTP3_ALT4_IN, CSIH2CSS0_ALT4_OUT, TAUD0I6_ALT5_IN, CSIH3RYI_ALT6_IN, DIO}, set at post-build, origin=Renesas_v1.0.0, default-value=DIO  # Mode of the port pin for use with Port_Init() function. <Input name>_ALT<Alternative instance>_IN: Provides alternative instance for selected input. <Output name>_ALT<Alternative instance>_OUT: Provides alternative instance for selected output.
          enumeration PortPinDirection: {PORT_PIN_OUT, PORT_PIN_IN}, set at post-build, origin=Renesas_v1.0.0, default-value=PORT_PIN_IN  # The initial direction of the pin (IN or OUT). If the direction is not changeable, the value configured here is fixed. The direction must match the pin mode. PORT_PIN_IN: Port pin direction set as input. PORT_PIN_OUT: Port pin direction set as output.
          boolean PortInputBufferControl: set at post-build, origin=Renesas_v1.0.0, default-value=false  # This parameter is used as one of the factors to enable/disable port pins input buffer in DIO Mode (PMC=0). true: Port pin's input buffer is ready to be enabled in DIO Mode. false: Port pin's input buffer is disabled in DIO Mode.
          boolean PortBiDirectionControl: set at post-build, origin=Renesas_v1.0.0, default-value=false  # This parameter forces port pins input buffer and output buffer at the same time. If activated, the effect is valid independently from any other port settings. true: Activate forced Bi-directional IO buffer of the port pin. false: Deactivate forced Bi-directional IO buffer of the port pin.
          boolean PortPullUpOption: set at post-build, origin=Renesas_v1.0.0, default-value=false  # This register switches on or off the port pins pull-up resistor. true: Port pin's pull-up resistor is enabled. false: Port pin's pull-up resistor is disabled.
          boolean PortPullDownOption: set at post-build, origin=Renesas_v1.0.0, default-value=false  # This parameter switches on or off the port pins pull-down resistor. true: Port pin's pull-down resistor is enabled. false: Port pin's pull-down resistor is disabled.
          enumeration PortOpenDrainControl_Expansion: {OpenDrain_PushPull, OpenDrain_N_Channel, OpenDrain_P_Channel}, set at post-build, origin=Renesas_v1.0.0, default-value=OpenDrain_PushPull  # This parameter selects port pins output buffer function in combination of PODC and PODCE . | OpenDrain_PushPull Specifies the OpenDrain_PushPull open drain type output circuit characteristics and updates both PODC and PODCE registers as 0 0 respectively. OpenDrain_N_Channel specifies the N-ch open drain type output circuit characteristics and updates the PODC and PODCE registers as 1 0 respectively. OpenDrain_P_Channel specifies the P-ch open drain type output circuit characteristics and updates the PODC and PODCE registers as 1 1 respectively.
          boolean PortOutputLevelInversion: set at post-build, origin=Renesas_v1.0.0, default-value=false  # This parameter specifies whether the output level from a pin is inverted or not.. true: Pin output level is inverted. false: Pin output level is not inverted.
          enumeration PortOutputDriveStrength: {SLOW, FAST, MIDDLE_0, MIDDLE_1}, set at post-build, origin=Renesas_v1.0.0, default-value=SLOW  # This parameter selects the port pins output drive strength as high strength or low strength type. This functionality is also referred to fast (high strength) and slow (low strength) behavior of output buffer. SLOW: Lower drive strength (slow mode) is selected for port pin's output buffer. FAST: Higher drive strength (fast mode) is selected for port pin's output buffer. MIDDLE_0: Lower drive strength (middle mode) is selected for port pin's output buffer. MIDDLE_1: Lower drive strength (middle mode) is selected for port pin's output buffer.
          enumeration PortInputSelection: {TYPE_1_SUPP_PISA, TYPE_2_SUPP_PISA}, set at post-build, origin=Renesas_v1.0.0, default-value=TYPE_1_SUPP_PISA  # This setting specifies the input buffer characteristics. TYPE_1_SUPP_PISA: TYPE 1 buffer is selected. TYPE_2_SUPP_PISA: TYPE 2 buffer is selected.
        container PortPin2  # This container contains the configuration (parameters) for Port Pin 2.
          boolean PortPinDirectionChangeable: set at post-build, origin=Renesas_v1.0.0, default-value=false  # Parameter to indicate if the direction is changeable on a port pin during runtime. true: Port Pin direction changeable enabled. false: Port Pin direction changeable disabled.
          boolean PortPinDioAltModeChangeable: set at post-build, origin=Renesas_v1.0.0, default-value=false  # Parameter to indicate if the mode of a port pin is changeable between DIO and Alternate during runtime by API functions Port_SetToDioMode and Port_SetToAlternateMode. Including these APIs is controlled by PortSetToDioAltModeApi. true: Dio Alternate mode is changeable. false: Dio Alternate mode is not changeable.
          boolean PortPinModeChangeable: set at post-build, origin=Renesas_v1.0.0, default-value=false  # Parameter to indicate if the mode of a port pin is changeable during runtime by API function Port_SetPinMode. Including this API is controlled by PortSetPinModeApi. true: Port Pin mode is changeable. false: Port Pin mode is not changeable.
          enumeration PortPinLevelValue: {PORT_PIN_LEVEL_LOW, PORT_PIN_LEVEL_HIGH}, set at post-build, origin=Renesas_v1.0.0, default-value=PORT_PIN_LEVEL_LOW  # Parameter to indicate port pin level value for a port pin. PORT_PIN_LEVEL_LOW: Port pin Level is low. PORT_PIN_LEVEL_HIGH: Port pin Level is high.
          enumeration PortPinInitialMode: {TAUJ2I1_ALT1_IN, TAUJ2O1_ALT1_OUT, TAUJ1I1_ALT2_IN, TAUJ1O1_ALT2_OUT, TAUD2I13_ALT3_IN, TAUD2O13_ALT3_OUT, CSIH2SI_ALT4_IN, TAUD0I8_ALT5_IN, CSIH3SI_ALT6_IN, DIO}, set at post-build, origin=Renesas_v1.0.0, default-value=DIO  # Mode of the port pin for use with Port_Init() function. <Input name>_ALT<Alternative instance>_IN: Provides alternative instance for selected input. <Output name>_ALT<Alternative instance>_OUT: Provides alternative instance for selected output.
          enumeration PortPinDirection: {PORT_PIN_OUT, PORT_PIN_IN}, set at post-build, origin=Renesas_v1.0.0, default-value=PORT_PIN_IN  # The initial direction of the pin (IN or OUT). If the direction is not changeable, the value configured here is fixed. The direction must match the pin mode. PORT_PIN_IN: Port pin direction set as input. PORT_PIN_OUT: Port pin direction set as output.
          boolean PortInputBufferControl: set at post-build, origin=Renesas_v1.0.0, default-value=false  # This parameter is used as one of the factors to enable/disable port pins input buffer in DIO Mode (PMC=0). true: Port pin's input buffer is ready to be enabled in DIO Mode. false: Port pin's input buffer is disabled in DIO Mode.
          boolean PortBiDirectionControl: set at post-build, origin=Renesas_v1.0.0, default-value=false  # This parameter forces port pins input buffer and output buffer at the same time. If activated, the effect is valid independently from any other port settings. true: Activate forced Bi-directional IO buffer of the port pin. false: Deactivate forced Bi-directional IO buffer of the port pin.
          boolean PortPullUpOption: set at post-build, origin=Renesas_v1.0.0, default-value=false  # This register switches on or off the port pins pull-up resistor. true: Port pin's pull-up resistor is enabled. false: Port pin's pull-up resistor is disabled.
          boolean PortPullDownOption: set at post-build, origin=Renesas_v1.0.0, default-value=false  # This parameter switches on or off the port pins pull-down resistor. true: Port pin's pull-down resistor is enabled. false: Port pin's pull-down resistor is disabled.
          enumeration PortOpenDrainControl_Expansion: {OpenDrain_PushPull, OpenDrain_N_Channel, OpenDrain_P_Channel}, set at post-build, origin=Renesas_v1.0.0, default-value=OpenDrain_PushPull  # This parameter selects port pins output buffer function in combination of PODC and PODCE . | OpenDrain_PushPull Specifies the OpenDrain_PushPull open drain type output circuit characteristics and updates both PODC and PODCE registers as 0 0 respectively. OpenDrain_N_Channel specifies the N-ch open drain type output circuit characteristics and updates the PODC and PODCE registers as 1 0 respectively. OpenDrain_P_Channel specifies the P-ch open drain type output circuit characteristics and updates the PODC and PODCE registers as 1 1 respectively.
          boolean PortOutputLevelInversion: set at post-build, origin=Renesas_v1.0.0, default-value=false  # This parameter specifies whether the output level from a pin is inverted or not.. true: Pin output level is inverted. false: Pin output level is not inverted.
          enumeration PortOutputDriveStrength: {SLOW, FAST, MIDDLE_0, MIDDLE_1}, set at post-build, origin=Renesas_v1.0.0, default-value=SLOW  # This parameter selects the port pins output drive strength as high strength or low strength type. This functionality is also referred to fast (high strength) and slow (low strength) behavior of output buffer. SLOW: Lower drive strength (slow mode) is selected for port pin's output buffer. FAST: Higher drive strength (fast mode) is selected for port pin's output buffer. MIDDLE_0: Lower drive strength (middle mode) is selected for port pin's output buffer. MIDDLE_1: Lower drive strength (middle mode) is selected for port pin's output buffer.
          enumeration PortInputSelection: {TYPE_1_SUPP_PISA, TYPE_2_SUPP_PISA}, set at post-build, origin=Renesas_v1.0.0, default-value=TYPE_1_SUPP_PISA  # This setting specifies the input buffer characteristics. TYPE_1_SUPP_PISA: TYPE 1 buffer is selected. TYPE_2_SUPP_PISA: TYPE 2 buffer is selected.
        container PortPin3  # This container contains the configuration (parameters) for Port Pin 3.
          boolean PortPinDirectionChangeable: set at post-build, origin=Renesas_v1.0.0, default-value=false  # Parameter to indicate if the direction is changeable on a port pin during runtime. true: Port Pin direction changeable enabled. false: Port Pin direction changeable disabled.
          boolean PortPinDioAltModeChangeable: set at post-build, origin=Renesas_v1.0.0, default-value=false  # Parameter to indicate if the mode of a port pin is changeable between DIO and Alternate during runtime by API functions Port_SetToDioMode and Port_SetToAlternateMode. Including these APIs is controlled by PortSetToDioAltModeApi. true: Dio Alternate mode is changeable. false: Dio Alternate mode is not changeable.
          boolean PortPinModeChangeable: set at post-build, origin=Renesas_v1.0.0, default-value=false  # Parameter to indicate if the mode of a port pin is changeable during runtime by API function Port_SetPinMode. Including this API is controlled by PortSetPinModeApi. true: Port Pin mode is changeable. false: Port Pin mode is not changeable.
          enumeration PortPinLevelValue: {PORT_PIN_LEVEL_LOW, PORT_PIN_LEVEL_HIGH}, set at post-build, origin=Renesas_v1.0.0, default-value=PORT_PIN_LEVEL_LOW  # Parameter to indicate port pin level value for a port pin. PORT_PIN_LEVEL_LOW: Port pin Level is low. PORT_PIN_LEVEL_HIGH: Port pin Level is high.
          enumeration PortPinInitialMode: {TAUJ2I2_ALT1_IN, TAUJ2O2_ALT1_OUT, TAUJ1I2_ALT2_IN, TAUJ1O2_ALT2_OUT, TAUD2I14_ALT3_IN, TAUD2O14_ALT3_OUT, CSIH2SO_ALT4_OUT, TAUD0I10_ALT5_IN, CSIH3SO_ALT6_OUT, DIO}, set at post-build, origin=Renesas_v1.0.0, default-value=DIO  # Mode of the port pin for use with Port_Init() function. <Input name>_ALT<Alternative instance>_IN: Provides alternative instance for selected input. <Output name>_ALT<Alternative instance>_OUT: Provides alternative instance for selected output.
          enumeration PortPinDirection: {PORT_PIN_OUT, PORT_PIN_IN}, set at post-build, origin=Renesas_v1.0.0, default-value=PORT_PIN_IN  # The initial direction of the pin (IN or OUT). If the direction is not changeable, the value configured here is fixed. The direction must match the pin mode. PORT_PIN_IN: Port pin direction set as input. PORT_PIN_OUT: Port pin direction set as output.
          boolean PortInputBufferControl: set at post-build, origin=Renesas_v1.0.0, default-value=false  # This parameter is used as one of the factors to enable/disable port pins input buffer in DIO Mode (PMC=0). true: Port pin's input buffer is ready to be enabled in DIO Mode. false: Port pin's input buffer is disabled in DIO Mode.
          boolean PortBiDirectionControl: set at post-build, origin=Renesas_v1.0.0, default-value=false  # This parameter forces port pins input buffer and output buffer at the same time. If activated, the effect is valid independently from any other port settings. true: Activate forced Bi-directional IO buffer of the port pin. false: Deactivate forced Bi-directional IO buffer of the port pin.
          boolean PortIpControl: set at post-build, origin=Renesas_v1.0.0, default-value=false  # This parameter is used to enable/disable the direct IO control of port pins direction true: Enables the direct IO control over port pins direction by the corresponding control signals from internal peripheral IPs. This register is valid only in Alternative Mode (PMC=1). false: Disables the direct IO control over port pins direction. PortIpControl should be set to True, when PortPinInitialMode is CSIH2SO_ALT4_OUT or CSIH3SO_ALT6_OUT.
          boolean PortPullUpOption: set at post-build, origin=Renesas_v1.0.0, default-value=false  # This register switches on or off the port pins pull-up resistor. true: Port pin's pull-up resistor is enabled. false: Port pin's pull-up resistor is disabled.
          boolean PortPullDownOption: set at post-build, origin=Renesas_v1.0.0, default-value=false  # This parameter switches on or off the port pins pull-down resistor. true: Port pin's pull-down resistor is enabled. false: Port pin's pull-down resistor is disabled.
          enumeration PortOpenDrainControl_Expansion: {OpenDrain_PushPull, OpenDrain_N_Channel, OpenDrain_P_Channel}, set at post-build, origin=Renesas_v1.0.0, default-value=OpenDrain_PushPull  # This parameter selects port pins output buffer function in combination of PODC and PODCE . | OpenDrain_PushPull Specifies the OpenDrain_PushPull open drain type output circuit characteristics and updates both PODC and PODCE registers as 0 0 respectively. OpenDrain_N_Channel specifies the N-ch open drain type output circuit characteristics and updates the PODC and PODCE registers as 1 0 respectively. OpenDrain_P_Channel specifies the P-ch open drain type output circuit characteristics and updates the PODC and PODCE registers as 1 1 respectively.
          boolean PortOutputLevelInversion: set at post-build, origin=Renesas_v1.0.0, default-value=false  # This parameter specifies whether the output level from a pin is inverted or not.. true: Pin output level is inverted. false: Pin output level is not inverted.
          enumeration PortOutputDriveStrength: {SLOW, FAST, MIDDLE_0, MIDDLE_1}, set at post-build, origin=Renesas_v1.0.0, default-value=SLOW  # This parameter selects the port pins output drive strength as high strength or low strength type. This functionality is also referred to fast (high strength) and slow (low strength) behavior of output buffer. SLOW: Lower drive strength (slow mode) is selected for port pin's output buffer. FAST: Higher drive strength (fast mode) is selected for port pin's output buffer. MIDDLE_0: Lower drive strength (middle mode) is selected for port pin's output buffer. MIDDLE_1: Lower drive strength (middle mode) is selected for port pin's output buffer.
          enumeration PortInputSelection: {TYPE_1_SUPP_PISA, TYPE_2_SUPP_PISA}, set at post-build, origin=Renesas_v1.0.0, default-value=TYPE_1_SUPP_PISA  # This setting specifies the input buffer characteristics. TYPE_1_SUPP_PISA: TYPE 1 buffer is selected. TYPE_2_SUPP_PISA: TYPE 2 buffer is selected.
        container PortPin4  # This container contains the configuration (parameters) for Port Pin 4.
          boolean PortPinDirectionChangeable: set at post-build, origin=Renesas_v1.0.0, default-value=false  # Parameter to indicate if the direction is changeable on a port pin during runtime. true: Port Pin direction changeable enabled. false: Port Pin direction changeable disabled.
          boolean PortPinDioAltModeChangeable: set at post-build, origin=Renesas_v1.0.0, default-value=false  # Parameter to indicate if the mode of a port pin is changeable between DIO and Alternate during runtime by API functions Port_SetToDioMode and Port_SetToAlternateMode. Including these APIs is controlled by PortSetToDioAltModeApi. true: Dio Alternate mode is changeable. false: Dio Alternate mode is not changeable.
          boolean PortPinModeChangeable: set at post-build, origin=Renesas_v1.0.0, default-value=false  # Parameter to indicate if the mode of a port pin is changeable during runtime by API function Port_SetPinMode. Including this API is controlled by PortSetPinModeApi. true: Port Pin mode is changeable. false: Port Pin mode is not changeable.
          enumeration PortPinLevelValue: {PORT_PIN_LEVEL_LOW, PORT_PIN_LEVEL_HIGH}, set at post-build, origin=Renesas_v1.0.0, default-value=PORT_PIN_LEVEL_LOW  # Parameter to indicate port pin level value for a port pin. PORT_PIN_LEVEL_LOW: Port pin Level is low. PORT_PIN_LEVEL_HIGH: Port pin Level is high.
          enumeration PortPinInitialMode: {TAUJ2I3_ALT1_IN, TAUJ2O3_ALT1_OUT, TAUJ1I3_ALT2_IN, TAUJ1O3_ALT2_OUT, TAUD2I15_ALT3_IN, TAUD2O15_ALT3_OUT, CSIH2SCI_ALT4_IN, CSIH2SCO_ALT4_OUT, CSIH3SCI_ALT6_IN, CSIH3SCO_ALT6_OUT, DIO}, set at post-build, origin=Renesas_v1.0.0, default-value=DIO  # Mode of the port pin for use with Port_Init() function. <Input name>_ALT<Alternative instance>_IN: Provides alternative instance for selected input. <Output name>_ALT<Alternative instance>_OUT: Provides alternative instance for selected output.
          enumeration PortPinDirection: {PORT_PIN_OUT, PORT_PIN_IN}, set at post-build, origin=Renesas_v1.0.0, default-value=PORT_PIN_IN  # The initial direction of the pin (IN or OUT). If the direction is not changeable, the value configured here is fixed. The direction must match the pin mode. PORT_PIN_IN: Port pin direction set as input. PORT_PIN_OUT: Port pin direction set as output.
          boolean PortInputBufferControl: set at post-build, origin=Renesas_v1.0.0, default-value=false  # This parameter is used as one of the factors to enable/disable port pins input buffer in DIO Mode (PMC=0). true: Port pin's input buffer is ready to be enabled in DIO Mode. false: Port pin's input buffer is disabled in DIO Mode.
          boolean PortBiDirectionControl: set at post-build, origin=Renesas_v1.0.0, default-value=false  # This parameter forces port pins input buffer and output buffer at the same time. If activated, the effect is valid independently from any other port settings. true: Activate forced Bi-directional IO buffer of the port pin. false: Deactivate forced Bi-directional IO buffer of the port pin.
          boolean PortIpControl: set at post-build, origin=Renesas_v1.0.0, default-value=false  # This parameter is used to enable/disable the direct IO control of port pins direction true: Enables the direct IO control over port pins direction by the corresponding control signals from internal peripheral IPs. This register is valid only in Alternative Mode (PMC=1). false: Disables the direct IO control over port pins direction. PortIpControl should be set to True, when PortPinInitialMode is CSIH2SCO_ALT4_OUT or CSIH3SCO_ALT6_OUT.
          boolean PortPullUpOption: set at post-build, origin=Renesas_v1.0.0, default-value=false  # This register switches on or off the port pins pull-up resistor. true: Port pin's pull-up resistor is enabled. false: Port pin's pull-up resistor is disabled.
          boolean PortPullDownOption: set at post-build, origin=Renesas_v1.0.0, default-value=false  # This parameter switches on or off the port pins pull-down resistor. true: Port pin's pull-down resistor is enabled. false: Port pin's pull-down resistor is disabled.
          enumeration PortOpenDrainControl_Expansion: {OpenDrain_PushPull, OpenDrain_N_Channel, OpenDrain_P_Channel}, set at post-build, origin=Renesas_v1.0.0, default-value=OpenDrain_PushPull  # This parameter selects port pins output buffer function in combination of PODC and PODCE . | OpenDrain_PushPull Specifies the OpenDrain_PushPull open drain type output circuit characteristics and updates both PODC and PODCE registers as 0 0 respectively. OpenDrain_N_Channel specifies the N-ch open drain type output circuit characteristics and updates the PODC and PODCE registers as 1 0 respectively. OpenDrain_P_Channel specifies the P-ch open drain type output circuit characteristics and updates the PODC and PODCE registers as 1 1 respectively.
          boolean PortOutputLevelInversion: set at post-build, origin=Renesas_v1.0.0, default-value=false  # This parameter specifies whether the output level from a pin is inverted or not.. true: Pin output level is inverted. false: Pin output level is not inverted.
          enumeration PortOutputDriveStrength: {SLOW, FAST, MIDDLE_0, MIDDLE_1}, set at post-build, origin=Renesas_v1.0.0, default-value=SLOW  # This parameter selects the port pins output drive strength as high strength or low strength type. This functionality is also referred to fast (high strength) and slow (low strength) behavior of output buffer. SLOW: Lower drive strength (slow mode) is selected for port pin's output buffer. FAST: Higher drive strength (fast mode) is selected for port pin's output buffer. MIDDLE_0: Lower drive strength (middle mode) is selected for port pin's output buffer. MIDDLE_1: Lower drive strength (middle mode) is selected for port pin's output buffer.
          enumeration PortInputSelection: {TYPE_1_SUPP_PISA, TYPE_2_SUPP_PISA}, set at post-build, origin=Renesas_v1.0.0, default-value=TYPE_1_SUPP_PISA  # This setting specifies the input buffer characteristics. TYPE_1_SUPP_PISA: TYPE 1 buffer is selected. TYPE_2_SUPP_PISA: TYPE 2 buffer is selected.
      container PortGroup2  # This container contains the configuration (parameters) for Port Group 2.
        container PortPin0  # This container contains the configuration (parameters) for Port Pin 0.
          boolean PortPinDirectionChangeable: set at post-build, origin=Renesas_v1.0.0, default-value=false  # Parameter to indicate if the direction is changeable on a port pin during runtime. true: Port Pin direction changeable enabled. false: Port Pin direction changeable disabled.
          boolean PortPinDioAltModeChangeable: set at post-build, origin=Renesas_v1.0.0, default-value=false  # Parameter to indicate if the mode of a port pin is changeable between DIO and Alternate during runtime by API functions Port_SetToDioMode and Port_SetToAlternateMode. Including these APIs is controlled by PortSetToDioAltModeApi. true: Dio Alternate mode is changeable. false: Dio Alternate mode is not changeable.
          boolean PortPinModeChangeable: set at post-build, origin=Renesas_v1.0.0, default-value=false  # Parameter to indicate if the mode of a port pin is changeable during runtime by API function Port_SetPinMode. Including this API is controlled by PortSetPinModeApi. true: Port Pin mode is changeable. false: Port Pin mode is not changeable.
          enumeration PortPinLevelValue: {PORT_PIN_LEVEL_LOW, PORT_PIN_LEVEL_HIGH}, set at post-build, origin=Renesas_v1.0.0, default-value=PORT_PIN_LEVEL_LOW  # Parameter to indicate port pin level value for a port pin. PORT_PIN_LEVEL_LOW: Port pin Level is low. PORT_PIN_LEVEL_HIGH: Port pin Level is high.
          enumeration PortPinInitialMode: {RSCAN0RX0_ALT1_IN_SUPP_PFC_PFCE_PMCSR, INTP5_ALT1_IN_SUPP_PFC_PFCE_PMCSR, CSIH2SI_ALT2_IN_SUPP_PFC_PFCE_PMCSR, TAUD2I11_ALT3_IN_SUPP_PFC_PFCE_PMCSR, TAUD2O11_ALT3_OUT_SUPP_PFC_PFCE_PMCSR, CSIH3CSS6_ALT4_OUT_SUPP_PFC_PFCE_PMCSR, DIO_SUPP_PFC_PFCE_PMCSR}, set at post-build, origin=Renesas_v1.0.0, default-value=DIO_SUPP_PFC_PFCE_PMCSR  # Mode of the port pin for use with Port_Init() function. <Input name>_ALT<Alternative instance>_IN: Provides alternative instance for selected input. <Output name>_ALT<Alternative instance>_OUT: Provides alternative instance for selected output.
          enumeration PortPinDirection: {PORT_PIN_OUT, PORT_PIN_IN}, set at post-build, origin=Renesas_v1.0.0, default-value=PORT_PIN_IN  # The initial direction of the pin (IN or OUT). If the direction is not changeable, the value configured here is fixed. The direction must match the pin mode. PORT_PIN_IN: Port pin direction set as input. PORT_PIN_OUT: Port pin direction set as output.
          boolean PortInputBufferControl: set at post-build, origin=Renesas_v1.0.0, default-value=false  # This parameter is used as one of the factors to enable/disable port pins input buffer in DIO Mode (PMC=0). true: Port pin's input buffer is ready to be enabled in DIO Mode. false: Port pin's input buffer is disabled in DIO Mode.
          boolean PortBiDirectionControl: set at post-build, origin=Renesas_v1.0.0, default-value=false  # This parameter forces port pins input buffer and output buffer at the same time. If activated, the effect is valid independently from any other port settings. true: Activate forced Bi-directional IO buffer of the port pin. false: Deactivate forced Bi-directional IO buffer of the port pin.
          boolean PortPullUpOption: set at post-build, origin=Renesas_v1.0.0, default-value=false  # This register switches on or off the port pins pull-up resistor. true: Port pin's pull-up resistor is enabled. false: Port pin's pull-up resistor is disabled.
          boolean PortPullDownOption: set at post-build, origin=Renesas_v1.0.0, default-value=false  # This parameter switches on or off the port pins pull-down resistor. true: Port pin's pull-down resistor is enabled. false: Port pin's pull-down resistor is disabled.
          enumeration PortOpenDrainControl_Expansion: {OpenDrain_PushPull, OpenDrain_N_Channel, OpenDrain_P_Channel}, set at post-build, origin=Renesas_v1.0.0, default-value=OpenDrain_PushPull  # This parameter selects port pins output buffer function in combination of PODC and PODCE . | OpenDrain_PushPull Specifies the OpenDrain_PushPull open drain type output circuit characteristics and updates both PODC and PODCE registers as 0 0 respectively. OpenDrain_N_Channel specifies the N-ch open drain type output circuit characteristics and updates the PODC and PODCE registers as 1 0 respectively. OpenDrain_P_Channel specifies the P-ch open drain type output circuit characteristics and updates the PODC and PODCE registers as 1 1 respectively.
          boolean PortOutputLevelInversion: set at post-build, origin=Renesas_v1.0.0, default-value=false  # This parameter specifies whether the output level from a pin is inverted or not.. true: Pin output level is inverted. false: Pin output level is not inverted.
          enumeration PortOutputDriveStrength: {SLOW, FAST, MIDDLE_0, MIDDLE_1}, set at post-build, origin=Renesas_v1.0.0, default-value=SLOW  # This parameter selects the port pins output drive strength as high strength or low strength type. This functionality is also referred to fast (high strength) and slow (low strength) behavior of output buffer. SLOW: Lower drive strength (slow mode) is selected for port pin's output buffer. FAST: Higher drive strength (fast mode) is selected for port pin's output buffer. MIDDLE_0: Lower drive strength (middle mode) is selected for port pin's output buffer. MIDDLE_1: Lower drive strength (middle mode) is selected for port pin's output buffer.
          enumeration PortInputSelection: {TYPE_1_SUPP_PISA, TYPE_2_SUPP_PISA}, set at post-build, origin=Renesas_v1.0.0, default-value=TYPE_1_SUPP_PISA  # This setting specifies the input buffer characteristics. TYPE_1_SUPP_PISA: TYPE 1 buffer is selected. TYPE_2_SUPP_PISA: TYPE 2 buffer is selected.
        container PortPin1  # This container contains the configuration (parameters) for Port Pin 1.
          boolean PortPinDirectionChangeable: set at post-build, origin=Renesas_v1.0.0, default-value=false  # Parameter to indicate if the direction is changeable on a port pin during runtime. true: Port Pin direction changeable enabled. false: Port Pin direction changeable disabled.
          boolean PortPinDioAltModeChangeable: set at post-build, origin=Renesas_v1.0.0, default-value=false  # Parameter to indicate if the mode of a port pin is changeable between DIO and Alternate during runtime by API functions Port_SetToDioMode and Port_SetToAlternateMode. Including these APIs is controlled by PortSetToDioAltModeApi. true: Dio Alternate mode is changeable. false: Dio Alternate mode is not changeable.
          boolean PortPinModeChangeable: set at post-build, origin=Renesas_v1.0.0, default-value=false  # Parameter to indicate if the mode of a port pin is changeable during runtime by API function Port_SetPinMode. Including this API is controlled by PortSetPinModeApi. true: Port Pin mode is changeable. false: Port Pin mode is not changeable.
          enumeration PortPinLevelValue: {PORT_PIN_LEVEL_LOW, PORT_PIN_LEVEL_HIGH}, set at post-build, origin=Renesas_v1.0.0, default-value=PORT_PIN_LEVEL_LOW  # Parameter to indicate port pin level value for a port pin. PORT_PIN_LEVEL_LOW: Port pin Level is low. PORT_PIN_LEVEL_HIGH: Port pin Level is high.
          enumeration PortPinInitialMode: {RSCAN0TX0_ALT1_OUT, CSIH2SO_ALT2_OUT, TAUD2I12_ALT3_IN, TAUD2O12_ALT3_OUT, CSIH3CSS7_ALT4_OUT, TSG30O7_ALT5_OUT, DIO}, set at post-build, origin=Renesas_v1.0.0, default-value=DIO  # Mode of the port pin for use with Port_Init() function. <Input name>_ALT<Alternative instance>_IN: Provides alternative instance for selected input. <Output name>_ALT<Alternative instance>_OUT: Provides alternative instance for selected output.
          enumeration PortPinDirection: {PORT_PIN_OUT, PORT_PIN_IN}, set at post-build, origin=Renesas_v1.0.0, default-value=PORT_PIN_IN  # The initial direction of the pin (IN or OUT). If the direction is not changeable, the value configured here is fixed. The direction must match the pin mode. PORT_PIN_IN: Port pin direction set as input. PORT_PIN_OUT: Port pin direction set as output.
          boolean PortInputBufferControl: set at post-build, origin=Renesas_v1.0.0, default-value=false  # This parameter is used as one of the factors to enable/disable port pins input buffer in DIO Mode (PMC=0). true: Port pin's input buffer is ready to be enabled in DIO Mode. false: Port pin's input buffer is disabled in DIO Mode.
          boolean PortBiDirectionControl: set at post-build, origin=Renesas_v1.0.0, default-value=false  # This parameter forces port pins input buffer and output buffer at the same time. If activated, the effect is valid independently from any other port settings. true: Activate forced Bi-directional IO buffer of the port pin. false: Deactivate forced Bi-directional IO buffer of the port pin.
          boolean PortIpControl: set at post-build, origin=Renesas_v1.0.0, default-value=false  # This parameter is used to enable/disable the direct IO control of port pins direction true: Enables the direct IO control over port pins direction by the corresponding control signals from internal peripheral IPs. This register is valid only in Alternative Mode (PMC=1). false: Disables the direct IO control over port pins direction. PortIpControl should be set to True, when PortPinInitialMode is CSIH2SO_ALT2_OUT.
          boolean PortPullUpOption: set at post-build, origin=Renesas_v1.0.0, default-value=false  # This register switches on or off the port pins pull-up resistor. true: Port pin's pull-up resistor is enabled. false: Port pin's pull-up resistor is disabled.
          boolean PortPullDownOption: set at post-build, origin=Renesas_v1.0.0, default-value=false  # This parameter switches on or off the port pins pull-down resistor. true: Port pin's pull-down resistor is enabled. false: Port pin's pull-down resistor is disabled.
          enumeration PortOpenDrainControl_Expansion: {OpenDrain_PushPull, OpenDrain_N_Channel, OpenDrain_P_Channel}, set at post-build, origin=Renesas_v1.0.0, default-value=OpenDrain_PushPull  # This parameter selects port pins output buffer function in combination of PODC and PODCE . | OpenDrain_PushPull Specifies the OpenDrain_PushPull open drain type output circuit characteristics and updates both PODC and PODCE registers as 0 0 respectively. OpenDrain_N_Channel specifies the N-ch open drain type output circuit characteristics and updates the PODC and PODCE registers as 1 0 respectively. OpenDrain_P_Channel specifies the P-ch open drain type output circuit characteristics and updates the PODC and PODCE registers as 1 1 respectively.
          boolean PortOutputLevelInversion: set at post-build, origin=Renesas_v1.0.0, default-value=false  # This parameter specifies whether the output level from a pin is inverted or not.. true: Pin output level is inverted. false: Pin output level is not inverted.
          enumeration PortOutputDriveStrength: {SLOW, FAST, MIDDLE_0, MIDDLE_1}, set at post-build, origin=Renesas_v1.0.0, default-value=SLOW  # This parameter selects the port pins output drive strength as high strength or low strength type. This functionality is also referred to fast (high strength) and slow (low strength) behavior of output buffer. SLOW: Lower drive strength (slow mode) is selected for port pin's output buffer. FAST: Higher drive strength (fast mode) is selected for port pin's output buffer. MIDDLE_0: Lower drive strength (middle mode) is selected for port pin's output buffer. MIDDLE_1: Lower drive strength (middle mode) is selected for port pin's output buffer.
          enumeration PortInputSelection: {TYPE_1_SUPP_PISA, TYPE_2_SUPP_PISA}, set at post-build, origin=Renesas_v1.0.0, default-value=TYPE_1_SUPP_PISA  # This setting specifies the input buffer characteristics. TYPE_1_SUPP_PISA: TYPE 1 buffer is selected. TYPE_2_SUPP_PISA: TYPE 2 buffer is selected.
        container PortPin2  # This container contains the configuration (parameters) for Port Pin 2.
          boolean PortPinDirectionChangeable: set at post-build, origin=Renesas_v1.0.0, default-value=false  # Parameter to indicate if the direction is changeable on a port pin during runtime. true: Port Pin direction changeable enabled. false: Port Pin direction changeable disabled.
          boolean PortPinDioAltModeChangeable: set at post-build, origin=Renesas_v1.0.0, default-value=false  # Parameter to indicate if the mode of a port pin is changeable between DIO and Alternate during runtime by API functions Port_SetToDioMode and Port_SetToAlternateMode. Including these APIs is controlled by PortSetToDioAltModeApi. true: Dio Alternate mode is changeable. false: Dio Alternate mode is not changeable.
          boolean PortPinModeChangeable: set at post-build, origin=Renesas_v1.0.0, default-value=false  # Parameter to indicate if the mode of a port pin is changeable during runtime by API function Port_SetPinMode. Including this API is controlled by PortSetPinModeApi. true: Port Pin mode is changeable. false: Port Pin mode is not changeable.
          enumeration PortPinLevelValue: {PORT_PIN_LEVEL_LOW, PORT_PIN_LEVEL_HIGH}, set at post-build, origin=Renesas_v1.0.0, default-value=PORT_PIN_LEVEL_LOW  # Parameter to indicate port pin level value for a port pin. PORT_PIN_LEVEL_LOW: Port pin Level is low. PORT_PIN_LEVEL_HIGH: Port pin Level is high.
          enumeration PortPinInitialMode: {RSCAN0RX1_ALT1_IN, INTP6_ALT1_IN, CSIH2SCI_ALT2_IN, CSIH2SCO_ALT2_OUT, TAUD2I13_ALT3_IN, TAUD2O13_ALT3_OUT, TPB0O_ALT4_OUT, TSG30O0_ALT5_OUT, CSIH0CSS5_ALT6_OUT, DIO}, set at post-build, origin=Renesas_v1.0.0, default-value=DIO  # Mode of the port pin for use with Port_Init() function. <Input name>_ALT<Alternative instance>_IN: Provides alternative instance for selected input. <Output name>_ALT<Alternative instance>_OUT: Provides alternative instance for selected output.
          enumeration PortPinDirection: {PORT_PIN_OUT, PORT_PIN_IN}, set at post-build, origin=Renesas_v1.0.0, default-value=PORT_PIN_IN  # The initial direction of the pin (IN or OUT). If the direction is not changeable, the value configured here is fixed. The direction must match the pin mode. PORT_PIN_IN: Port pin direction set as input. PORT_PIN_OUT: Port pin direction set as output.
          boolean PortInputBufferControl: set at post-build, origin=Renesas_v1.0.0, default-value=false  # This parameter is used as one of the factors to enable/disable port pins input buffer in DIO Mode (PMC=0). true: Port pin's input buffer is ready to be enabled in DIO Mode. false: Port pin's input buffer is disabled in DIO Mode.
          boolean PortBiDirectionControl: set at post-build, origin=Renesas_v1.0.0, default-value=false  # This parameter forces port pins input buffer and output buffer at the same time. If activated, the effect is valid independently from any other port settings. true: Activate forced Bi-directional IO buffer of the port pin. false: Deactivate forced Bi-directional IO buffer of the port pin.
          boolean PortIpControl: set at post-build, origin=Renesas_v1.0.0, default-value=false  # This parameter is used to enable/disable the direct IO control of port pins direction true: Enables the direct IO control over port pins direction by the corresponding control signals from internal peripheral IPs. This register is valid only in Alternative Mode (PMC=1). false: Disables the direct IO control over port pins direction. PortIpControl should be set to True, when PortPinInitialMode is CSIH2SCO_ALT2_OUT.
          boolean PortPullUpOption: set at post-build, origin=Renesas_v1.0.0, default-value=false  # This register switches on or off the port pins pull-up resistor. true: Port pin's pull-up resistor is enabled. false: Port pin's pull-up resistor is disabled.
          boolean PortPullDownOption: set at post-build, origin=Renesas_v1.0.0, default-value=false  # This parameter switches on or off the port pins pull-down resistor. true: Port pin's pull-down resistor is enabled. false: Port pin's pull-down resistor is disabled.
          enumeration PortOpenDrainControl_Expansion: {OpenDrain_PushPull, OpenDrain_N_Channel, OpenDrain_P_Channel}, set at post-build, origin=Renesas_v1.0.0, default-value=OpenDrain_PushPull  # This parameter selects port pins output buffer function in combination of PODC and PODCE . | OpenDrain_PushPull Specifies the OpenDrain_PushPull open drain type output circuit characteristics and updates both PODC and PODCE registers as 0 0 respectively. OpenDrain_N_Channel specifies the N-ch open drain type output circuit characteristics and updates the PODC and PODCE registers as 1 0 respectively. OpenDrain_P_Channel specifies the P-ch open drain type output circuit characteristics and updates the PODC and PODCE registers as 1 1 respectively.
          boolean PortOutputLevelInversion: set at post-build, origin=Renesas_v1.0.0, default-value=false  # This parameter specifies whether the output level from a pin is inverted or not.. true: Pin output level is inverted. false: Pin output level is not inverted.
          enumeration PortOutputDriveStrength: {SLOW, FAST, MIDDLE_0, MIDDLE_1}, set at post-build, origin=Renesas_v1.0.0, default-value=SLOW  # This parameter selects the port pins output drive strength as high strength or low strength type. This functionality is also referred to fast (high strength) and slow (low strength) behavior of output buffer. SLOW: Lower drive strength (slow mode) is selected for port pin's output buffer. FAST: Higher drive strength (fast mode) is selected for port pin's output buffer. MIDDLE_0: Lower drive strength (middle mode) is selected for port pin's output buffer. MIDDLE_1: Lower drive strength (middle mode) is selected for port pin's output buffer.
          enumeration PortInputSelection: {TYPE_1_SUPP_PISA, TYPE_2_SUPP_PISA}, set at post-build, origin=Renesas_v1.0.0, default-value=TYPE_1_SUPP_PISA  # This setting specifies the input buffer characteristics. TYPE_1_SUPP_PISA: TYPE 1 buffer is selected. TYPE_2_SUPP_PISA: TYPE 2 buffer is selected.
        container PortPin3  # This container contains the configuration (parameters) for Port Pin 3.
          boolean PortPinDirectionChangeable: set at post-build, origin=Renesas_v1.0.0, default-value=false  # Parameter to indicate if the direction is changeable on a port pin during runtime. true: Port Pin direction changeable enabled. false: Port Pin direction changeable disabled.
          boolean PortPinDioAltModeChangeable: set at post-build, origin=Renesas_v1.0.0, default-value=false  # Parameter to indicate if the mode of a port pin is changeable between DIO and Alternate during runtime by API functions Port_SetToDioMode and Port_SetToAlternateMode. Including these APIs is controlled by PortSetToDioAltModeApi. true: Dio Alternate mode is changeable. false: Dio Alternate mode is not changeable.
          boolean PortPinModeChangeable: set at post-build, origin=Renesas_v1.0.0, default-value=false  # Parameter to indicate if the mode of a port pin is changeable during runtime by API function Port_SetPinMode. Including this API is controlled by PortSetPinModeApi. true: Port Pin mode is changeable. false: Port Pin mode is not changeable.
          enumeration PortPinLevelValue: {PORT_PIN_LEVEL_LOW, PORT_PIN_LEVEL_HIGH}, set at post-build, origin=Renesas_v1.0.0, default-value=PORT_PIN_LEVEL_LOW  # Parameter to indicate port pin level value for a port pin. PORT_PIN_LEVEL_LOW: Port pin Level is low. PORT_PIN_LEVEL_HIGH: Port pin Level is high.
          enumeration PortPinInitialMode: {RSCAN0TX1_ALT1_OUT, CSIH2RYI_ALT2_IN, CSIH2CSS0_ALT2_OUT, TAUD2I14_ALT3_IN, TAUD2O14_ALT3_OUT, TPB1O_ALT4_OUT, TSG30O1_ALT5_OUT, DIO}, set at post-build, origin=Renesas_v1.0.0, default-value=DIO  # Mode of the port pin for use with Port_Init() function. <Input name>_ALT<Alternative instance>_IN: Provides alternative instance for selected input. <Output name>_ALT<Alternative instance>_OUT: Provides alternative instance for selected output.
          enumeration PortPinDirection: {PORT_PIN_OUT, PORT_PIN_IN}, set at post-build, origin=Renesas_v1.0.0, default-value=PORT_PIN_IN  # The initial direction of the pin (IN or OUT). If the direction is not changeable, the value configured here is fixed. The direction must match the pin mode. PORT_PIN_IN: Port pin direction set as input. PORT_PIN_OUT: Port pin direction set as output.
          boolean PortInputBufferControl: set at post-build, origin=Renesas_v1.0.0, default-value=false  # This parameter is used as one of the factors to enable/disable port pins input buffer in DIO Mode (PMC=0). true: Port pin's input buffer is ready to be enabled in DIO Mode. false: Port pin's input buffer is disabled in DIO Mode.
          boolean PortBiDirectionControl: set at post-build, origin=Renesas_v1.0.0, default-value=false  # This parameter forces port pins input buffer and output buffer at the same time. If activated, the effect is valid independently from any other port settings. true: Activate forced Bi-directional IO buffer of the port pin. false: Deactivate forced Bi-directional IO buffer of the port pin.
          boolean PortIpControl: set at post-build, origin=Renesas_v1.0.0, default-value=false  # This parameter is used to enable/disable the direct IO control of port pins direction true: Enables the direct IO control over port pins direction by the corresponding control signals from internal peripheral IPs. This register is valid only in Alternative Mode (PMC=1). false: Disables the direct IO control over port pins direction. PortIpControl should be set to True, when PortPinInitialMode is TSG30O1_ALT5_OUT.
          boolean PortPullUpOption: set at post-build, origin=Renesas_v1.0.0, default-value=false  # This register switches on or off the port pins pull-up resistor. true: Port pin's pull-up resistor is enabled. false: Port pin's pull-up resistor is disabled.
          boolean PortPullDownOption: set at post-build, origin=Renesas_v1.0.0, default-value=false  # This parameter switches on or off the port pins pull-down resistor. true: Port pin's pull-down resistor is enabled. false: Port pin's pull-down resistor is disabled.
          enumeration PortOpenDrainControl_Expansion: {OpenDrain_PushPull, OpenDrain_N_Channel, OpenDrain_P_Channel}, set at post-build, origin=Renesas_v1.0.0, default-value=OpenDrain_PushPull  # This parameter selects port pins output buffer function in combination of PODC and PODCE . | OpenDrain_PushPull Specifies the OpenDrain_PushPull open drain type output circuit characteristics and updates both PODC and PODCE registers as 0 0 respectively. OpenDrain_N_Channel specifies the N-ch open drain type output circuit characteristics and updates the PODC and PODCE registers as 1 0 respectively. OpenDrain_P_Channel specifies the P-ch open drain type output circuit characteristics and updates the PODC and PODCE registers as 1 1 respectively.
          boolean PortOutputLevelInversion: set at post-build, origin=Renesas_v1.0.0, default-value=false  # This parameter specifies whether the output level from a pin is inverted or not.. true: Pin output level is inverted. false: Pin output level is not inverted.
          enumeration PortOutputDriveStrength: {SLOW, FAST, MIDDLE_0, MIDDLE_1}, set at post-build, origin=Renesas_v1.0.0, default-value=SLOW  # This parameter selects the port pins output drive strength as high strength or low strength type. This functionality is also referred to fast (high strength) and slow (low strength) behavior of output buffer. SLOW: Lower drive strength (slow mode) is selected for port pin's output buffer. FAST: Higher drive strength (fast mode) is selected for port pin's output buffer. MIDDLE_0: Lower drive strength (middle mode) is selected for port pin's output buffer. MIDDLE_1: Lower drive strength (middle mode) is selected for port pin's output buffer.
        container PortPin4  # This container contains the configuration (parameters) for Port Pin 4.
          boolean PortPinDirectionChangeable: set at post-build, origin=Renesas_v1.0.0, default-value=false  # Parameter to indicate if the direction is changeable on a port pin during runtime. true: Port Pin direction changeable enabled. false: Port Pin direction changeable disabled.
          boolean PortPinDioAltModeChangeable: set at post-build, origin=Renesas_v1.0.0, default-value=false  # Parameter to indicate if the mode of a port pin is changeable between DIO and Alternate during runtime by API functions Port_SetToDioMode and Port_SetToAlternateMode. Including these APIs is controlled by PortSetToDioAltModeApi. true: Dio Alternate mode is changeable. false: Dio Alternate mode is not changeable.
          boolean PortPinModeChangeable: set at post-build, origin=Renesas_v1.0.0, default-value=false  # Parameter to indicate if the mode of a port pin is changeable during runtime by API function Port_SetPinMode. Including this API is controlled by PortSetPinModeApi. true: Port Pin mode is changeable. false: Port Pin mode is not changeable.
          enumeration PortPinLevelValue: {PORT_PIN_LEVEL_LOW, PORT_PIN_LEVEL_HIGH}, set at post-build, origin=Renesas_v1.0.0, default-value=PORT_PIN_LEVEL_LOW  # Parameter to indicate port pin level value for a port pin. PORT_PIN_LEVEL_LOW: Port pin Level is low. PORT_PIN_LEVEL_HIGH: Port pin Level is high.
          enumeration PortPinInitialMode: {CSIH2RYO_ALT1_OUT, CSIH0CSS2_ALT2_OUT, RLIN31TX_ALT3_OUT, TAUJ1I3_ALT4_IN, TAUJ1O3_ALT4_OUT, CSIH0SI_ALT5_IN, TAUD2I11_ALT6_IN, TAUD2O11_ALT6_OUT, DIO}, set at post-build, origin=Renesas_v1.0.0, default-value=DIO  # Mode of the port pin for use with Port_Init() function. <Input name>_ALT<Alternative instance>_IN: Provides alternative instance for selected input. <Output name>_ALT<Alternative instance>_OUT: Provides alternative instance for selected output.
          enumeration PortPinDirection: {PORT_PIN_OUT, PORT_PIN_IN}, set at post-build, origin=Renesas_v1.0.0, default-value=PORT_PIN_IN  # The initial direction of the pin (IN or OUT). If the direction is not changeable, the value configured here is fixed. The direction must match the pin mode. PORT_PIN_IN: Port pin direction set as input. PORT_PIN_OUT: Port pin direction set as output.
          boolean PortInputBufferControl: set at post-build, origin=Renesas_v1.0.0, default-value=false  # This parameter is used as one of the factors to enable/disable port pins input buffer in DIO Mode (PMC=0). true: Port pin's input buffer is ready to be enabled in DIO Mode. false: Port pin's input buffer is disabled in DIO Mode.
          boolean PortBiDirectionControl: set at post-build, origin=Renesas_v1.0.0, default-value=false  # This parameter forces port pins input buffer and output buffer at the same time. If activated, the effect is valid independently from any other port settings. true: Activate forced Bi-directional IO buffer of the port pin. false: Deactivate forced Bi-directional IO buffer of the port pin.
          boolean PortPullUpOption: set at post-build, origin=Renesas_v1.0.0, default-value=false  # This register switches on or off the port pins pull-up resistor. true: Port pin's pull-up resistor is enabled. false: Port pin's pull-up resistor is disabled.
          boolean PortPullDownOption: set at post-build, origin=Renesas_v1.0.0, default-value=false  # This parameter switches on or off the port pins pull-down resistor. true: Port pin's pull-down resistor is enabled. false: Port pin's pull-down resistor is disabled.
          enumeration PortOpenDrainControl_Expansion: {OpenDrain_PushPull, OpenDrain_N_Channel, OpenDrain_P_Channel}, set at post-build, origin=Renesas_v1.0.0, default-value=OpenDrain_PushPull  # This parameter selects port pins output buffer function in combination of PODC and PODCE . | OpenDrain_PushPull Specifies the OpenDrain_PushPull open drain type output circuit characteristics and updates both PODC and PODCE registers as 0 0 respectively. OpenDrain_N_Channel specifies the N-ch open drain type output circuit characteristics and updates the PODC and PODCE registers as 1 0 respectively. OpenDrain_P_Channel specifies the P-ch open drain type output circuit characteristics and updates the PODC and PODCE registers as 1 1 respectively.
          boolean PortOutputLevelInversion: set at post-build, origin=Renesas_v1.0.0, default-value=false  # This parameter specifies whether the output level from a pin is inverted or not.. true: Pin output level is inverted. false: Pin output level is not inverted.
          enumeration PortOutputDriveStrength: {SLOW, FAST, MIDDLE_0, MIDDLE_1}, set at post-build, origin=Renesas_v1.0.0, default-value=SLOW  # This parameter selects the port pins output drive strength as high strength or low strength type. This functionality is also referred to fast (high strength) and slow (low strength) behavior of output buffer. SLOW: Lower drive strength (slow mode) is selected for port pin's output buffer. FAST: Higher drive strength (fast mode) is selected for port pin's output buffer. MIDDLE_0: Lower drive strength (middle mode) is selected for port pin's output buffer. MIDDLE_1: Lower drive strength (middle mode) is selected for port pin's output buffer.
        container PortPin5  # This container contains the configuration (parameters) for Port Pin 5.
          boolean PortPinDirectionChangeable: set at post-build, origin=Renesas_v1.0.0, default-value=false  # Parameter to indicate if the direction is changeable on a port pin during runtime. true: Port Pin direction changeable enabled. false: Port Pin direction changeable disabled.
          boolean PortPinDioAltModeChangeable: set at post-build, origin=Renesas_v1.0.0, default-value=false  # Parameter to indicate if the mode of a port pin is changeable between DIO and Alternate during runtime by API functions Port_SetToDioMode and Port_SetToAlternateMode. Including these APIs is controlled by PortSetToDioAltModeApi. true: Dio Alternate mode is changeable. false: Dio Alternate mode is not changeable.
          boolean PortPinModeChangeable: set at post-build, origin=Renesas_v1.0.0, default-value=false  # Parameter to indicate if the mode of a port pin is changeable during runtime by API function Port_SetPinMode. Including this API is controlled by PortSetPinModeApi. true: Port Pin mode is changeable. false: Port Pin mode is not changeable.
          enumeration PortPinLevelValue: {PORT_PIN_LEVEL_LOW, PORT_PIN_LEVEL_HIGH}, set at post-build, origin=Renesas_v1.0.0, default-value=PORT_PIN_LEVEL_LOW  # Parameter to indicate port pin level value for a port pin. PORT_PIN_LEVEL_LOW: Port pin Level is low. PORT_PIN_LEVEL_HIGH: Port pin Level is high.
          enumeration PortPinInitialMode: {SCI30RX_ALT1_IN, INTP0_ALT1_IN, CSIH0CSS3_ALT2_OUT, RLIN31RX_ALT3_IN, INTP4_ALT3_IN, CSIH3SO_ALT4_OUT, TSG30O2_ALT5_OUT, CSIH0SO_ALT6_OUT, DIO}, set at post-build, origin=Renesas_v1.0.0, default-value=DIO  # Mode of the port pin for use with Port_Init() function. <Input name>_ALT<Alternative instance>_IN: Provides alternative instance for selected input. <Output name>_ALT<Alternative instance>_OUT: Provides alternative instance for selected output.
          enumeration PortPinDirection: {PORT_PIN_OUT, PORT_PIN_IN}, set at post-build, origin=Renesas_v1.0.0, default-value=PORT_PIN_IN  # The initial direction of the pin (IN or OUT). If the direction is not changeable, the value configured here is fixed. The direction must match the pin mode. PORT_PIN_IN: Port pin direction set as input. PORT_PIN_OUT: Port pin direction set as output.
          boolean PortInputBufferControl: set at post-build, origin=Renesas_v1.0.0, default-value=false  # This parameter is used as one of the factors to enable/disable port pins input buffer in DIO Mode (PMC=0). true: Port pin's input buffer is ready to be enabled in DIO Mode. false: Port pin's input buffer is disabled in DIO Mode.
          boolean PortBiDirectionControl: set at post-build, origin=Renesas_v1.0.0, default-value=false  # This parameter forces port pins input buffer and output buffer at the same time. If activated, the effect is valid independently from any other port settings. true: Activate forced Bi-directional IO buffer of the port pin. false: Deactivate forced Bi-directional IO buffer of the port pin.
          boolean PortIpControl: set at post-build, origin=Renesas_v1.0.0, default-value=false  # This parameter is used to enable/disable the direct IO control of port pins direction true: Enables the direct IO control over port pins direction by the corresponding control signals from internal peripheral IPs. This register is valid only in Alternative Mode (PMC=1). false: Disables the direct IO control over port pins direction. PortIpControl should be set to True, when PortPinInitialMode is CSIH3SO_ALT4_OUT or TSG30O2_ALT5_OUT or CSIH0SO_ALT6_OUT.
          boolean PortPullUpOption: set at post-build, origin=Renesas_v1.0.0, default-value=false  # This register switches on or off the port pins pull-up resistor. true: Port pin's pull-up resistor is enabled. false: Port pin's pull-up resistor is disabled.
          boolean PortPullDownOption: set at post-build, origin=Renesas_v1.0.0, default-value=false  # This parameter switches on or off the port pins pull-down resistor. true: Port pin's pull-down resistor is enabled. false: Port pin's pull-down resistor is disabled.
          enumeration PortOpenDrainControl_Expansion: {OpenDrain_PushPull, OpenDrain_N_Channel, OpenDrain_P_Channel}, set at post-build, origin=Renesas_v1.0.0, default-value=OpenDrain_PushPull  # This parameter selects port pins output buffer function in combination of PODC and PODCE . | OpenDrain_PushPull Specifies the OpenDrain_PushPull open drain type output circuit characteristics and updates both PODC and PODCE registers as 0 0 respectively. OpenDrain_N_Channel specifies the N-ch open drain type output circuit characteristics and updates the PODC and PODCE registers as 1 0 respectively. OpenDrain_P_Channel specifies the P-ch open drain type output circuit characteristics and updates the PODC and PODCE registers as 1 1 respectively.
          boolean PortOutputLevelInversion: set at post-build, origin=Renesas_v1.0.0, default-value=false  # This parameter specifies whether the output level from a pin is inverted or not.. true: Pin output level is inverted. false: Pin output level is not inverted.
          enumeration PortOutputDriveStrength: {SLOW, FAST, MIDDLE_0, MIDDLE_1}, set at post-build, origin=Renesas_v1.0.0, default-value=SLOW  # This parameter selects the port pins output drive strength as high strength or low strength type. This functionality is also referred to fast (high strength) and slow (low strength) behavior of output buffer. SLOW: Lower drive strength (slow mode) is selected for port pin's output buffer. FAST: Higher drive strength (fast mode) is selected for port pin's output buffer. MIDDLE_0: Lower drive strength (middle mode) is selected for port pin's output buffer. MIDDLE_1: Lower drive strength (middle mode) is selected for port pin's output buffer.
          enumeration PortInputSelection: {TYPE_1_SUPP_PISA, TYPE_2_SUPP_PISA}, set at post-build, origin=Renesas_v1.0.0, default-value=TYPE_1_SUPP_PISA  # This setting specifies the input buffer characteristics. TYPE_1_SUPP_PISA: TYPE 1 buffer is selected. TYPE_2_SUPP_PISA: TYPE 2 buffer is selected.
        container PortPin6  # This container contains the configuration (parameters) for Port Pin 6.
          boolean PortPinDirectionChangeable: set at post-build, origin=Renesas_v1.0.0, default-value=false  # Parameter to indicate if the direction is changeable on a port pin during runtime. true: Port Pin direction changeable enabled. false: Port Pin direction changeable disabled.
          boolean PortPinDioAltModeChangeable: set at post-build, origin=Renesas_v1.0.0, default-value=false  # Parameter to indicate if the mode of a port pin is changeable between DIO and Alternate during runtime by API functions Port_SetToDioMode and Port_SetToAlternateMode. Including these APIs is controlled by PortSetToDioAltModeApi. true: Dio Alternate mode is changeable. false: Dio Alternate mode is not changeable.
          boolean PortPinModeChangeable: set at post-build, origin=Renesas_v1.0.0, default-value=false  # Parameter to indicate if the mode of a port pin is changeable during runtime by API function Port_SetPinMode. Including this API is controlled by PortSetPinModeApi. true: Port Pin mode is changeable. false: Port Pin mode is not changeable.
          enumeration PortPinLevelValue: {PORT_PIN_LEVEL_LOW, PORT_PIN_LEVEL_HIGH}, set at post-build, origin=Renesas_v1.0.0, default-value=PORT_PIN_LEVEL_LOW  # Parameter to indicate port pin level value for a port pin. PORT_PIN_LEVEL_LOW: Port pin Level is low. PORT_PIN_LEVEL_HIGH: Port pin Level is high.
          enumeration PortPinInitialMode: {SCI30TX_ALT1_OUT, OSTM1O_ALT2_OUT, CSIH0SCI_ALT3_IN, CSIH0SCO_ALT3_OUT, CSIH3SI_ALT4_IN, CSIH0CSS4_ALT4_OUT, TSG30O3_ALT5_OUT, TAUD1I0_ALT6_IN, TAUD1O0_ALT6_OUT, DIO}, set at post-build, origin=Renesas_v1.0.0, default-value=DIO  # Mode of the port pin for use with Port_Init() function. <Input name>_ALT<Alternative instance>_IN: Provides alternative instance for selected input. <Output name>_ALT<Alternative instance>_OUT: Provides alternative instance for selected output.
          enumeration PortPinDirection: {PORT_PIN_OUT, PORT_PIN_IN}, set at post-build, origin=Renesas_v1.0.0, default-value=PORT_PIN_IN  # The initial direction of the pin (IN or OUT). If the direction is not changeable, the value configured here is fixed. The direction must match the pin mode. PORT_PIN_IN: Port pin direction set as input. PORT_PIN_OUT: Port pin direction set as output.
          boolean PortInputBufferControl: set at post-build, origin=Renesas_v1.0.0, default-value=false  # This parameter is used as one of the factors to enable/disable port pins input buffer in DIO Mode (PMC=0). true: Port pin's input buffer is ready to be enabled in DIO Mode. false: Port pin's input buffer is disabled in DIO Mode.
          boolean PortBiDirectionControl: set at post-build, origin=Renesas_v1.0.0, default-value=false  # This parameter forces port pins input buffer and output buffer at the same time. If activated, the effect is valid independently from any other port settings. true: Activate forced Bi-directional IO buffer of the port pin. false: Deactivate forced Bi-directional IO buffer of the port pin.
          boolean PortIpControl: set at post-build, origin=Renesas_v1.0.0, default-value=false  # This parameter is used to enable/disable the direct IO control of port pins direction true: Enables the direct IO control over port pins direction by the corresponding control signals from internal peripheral IPs. This register is valid only in Alternative Mode (PMC=1). false: Disables the direct IO control over port pins direction. PortIpControl should be set to True, when PortPinInitialMode is CSIH0SCO_ALT3_OUT or TSG30O3_ALT5_OUT.
          boolean PortPullUpOption: set at post-build, origin=Renesas_v1.0.0, default-value=false  # This register switches on or off the port pins pull-up resistor. true: Port pin's pull-up resistor is enabled. false: Port pin's pull-up resistor is disabled.
          boolean PortPullDownOption: set at post-build, origin=Renesas_v1.0.0, default-value=false  # This parameter switches on or off the port pins pull-down resistor. true: Port pin's pull-down resistor is enabled. false: Port pin's pull-down resistor is disabled.
          enumeration PortOpenDrainControl_Expansion: {OpenDrain_PushPull, OpenDrain_N_Channel, OpenDrain_P_Channel}, set at post-build, origin=Renesas_v1.0.0, default-value=OpenDrain_PushPull  # This parameter selects port pins output buffer function in combination of PODC and PODCE . | OpenDrain_PushPull Specifies the OpenDrain_PushPull open drain type output circuit characteristics and updates both PODC and PODCE registers as 0 0 respectively. OpenDrain_N_Channel specifies the N-ch open drain type output circuit characteristics and updates the PODC and PODCE registers as 1 0 respectively. OpenDrain_P_Channel specifies the P-ch open drain type output circuit characteristics and updates the PODC and PODCE registers as 1 1 respectively.
          boolean PortOutputLevelInversion: set at post-build, origin=Renesas_v1.0.0, default-value=false  # This parameter specifies whether the output level from a pin is inverted or not.. true: Pin output level is inverted. false: Pin output level is not inverted.
          enumeration PortOutputDriveStrength: {SLOW, FAST, MIDDLE_0, MIDDLE_1}, set at post-build, origin=Renesas_v1.0.0, default-value=SLOW  # This parameter selects the port pins output drive strength as high strength or low strength type. This functionality is also referred to fast (high strength) and slow (low strength) behavior of output buffer. SLOW: Lower drive strength (slow mode) is selected for port pin's output buffer. FAST: Higher drive strength (fast mode) is selected for port pin's output buffer. MIDDLE_0: Lower drive strength (middle mode) is selected for port pin's output buffer. MIDDLE_1: Lower drive strength (middle mode) is selected for port pin's output buffer.
        container PortPin7  # This container contains the configuration (parameters) for Port Pin 7.
          boolean PortPinDirectionChangeable: set at post-build, origin=Renesas_v1.0.0, default-value=false  # Parameter to indicate if the direction is changeable on a port pin during runtime. true: Port Pin direction changeable enabled. false: Port Pin direction changeable disabled.
          boolean PortPinDioAltModeChangeable: set at post-build, origin=Renesas_v1.0.0, default-value=false  # Parameter to indicate if the mode of a port pin is changeable between DIO and Alternate during runtime by API functions Port_SetToDioMode and Port_SetToAlternateMode. Including these APIs is controlled by PortSetToDioAltModeApi. true: Dio Alternate mode is changeable. false: Dio Alternate mode is not changeable.
          boolean PortPinModeChangeable: set at post-build, origin=Renesas_v1.0.0, default-value=false  # Parameter to indicate if the mode of a port pin is changeable during runtime by API function Port_SetPinMode. Including this API is controlled by PortSetPinModeApi. true: Port Pin mode is changeable. false: Port Pin mode is not changeable.
          enumeration PortPinLevelValue: {PORT_PIN_LEVEL_LOW, PORT_PIN_LEVEL_HIGH}, set at post-build, origin=Renesas_v1.0.0, default-value=PORT_PIN_LEVEL_LOW  # Parameter to indicate port pin level value for a port pin. PORT_PIN_LEVEL_LOW: Port pin Level is low. PORT_PIN_LEVEL_HIGH: Port pin Level is high.
          enumeration PortPinInitialMode: {SCI30SCI_ALT1_IN, SCI30SCO_ALT1_OUT, CSIH0CSS5_ALT2_OUT, CSIH1SI_ALT3_IN, CSIH3SCI_ALT4_IN, CSIH3SCO_ALT4_OUT, TSG30O4_ALT5_OUT, TAUD1I1_ALT6_IN, TAUD1O1_ALT6_OUT, DIO}, set at post-build, origin=Renesas_v1.0.0, default-value=DIO  # Mode of the port pin for use with Port_Init() function. <Input name>_ALT<Alternative instance>_IN: Provides alternative instance for selected input. <Output name>_ALT<Alternative instance>_OUT: Provides alternative instance for selected output.
          enumeration PortPinDirection: {PORT_PIN_OUT, PORT_PIN_IN}, set at post-build, origin=Renesas_v1.0.0, default-value=PORT_PIN_IN  # The initial direction of the pin (IN or OUT). If the direction is not changeable, the value configured here is fixed. The direction must match the pin mode. PORT_PIN_IN: Port pin direction set as input. PORT_PIN_OUT: Port pin direction set as output.
          boolean PortInputBufferControl: set at post-build, origin=Renesas_v1.0.0, default-value=false  # This parameter is used as one of the factors to enable/disable port pins input buffer in DIO Mode (PMC=0). true: Port pin's input buffer is ready to be enabled in DIO Mode. false: Port pin's input buffer is disabled in DIO Mode.
          boolean PortBiDirectionControl: set at post-build, origin=Renesas_v1.0.0, default-value=false  # This parameter forces port pins input buffer and output buffer at the same time. If activated, the effect is valid independently from any other port settings. true: Activate forced Bi-directional IO buffer of the port pin. false: Deactivate forced Bi-directional IO buffer of the port pin.
          boolean PortIpControl: set at post-build, origin=Renesas_v1.0.0, default-value=false  # This parameter is used to enable/disable the direct IO control of port pins direction true: Enables the direct IO control over port pins direction by the corresponding control signals from internal peripheral IPs. This register is valid only in Alternative Mode (PMC=1). false: Disables the direct IO control over port pins direction. PortIpControl should be set to True, when PortPinInitialMode is CSIH3SCO_ALT4_OUT or TSG30O4_ALT5_OUT.
          boolean PortPullUpOption: set at post-build, origin=Renesas_v1.0.0, default-value=false  # This register switches on or off the port pins pull-up resistor. true: Port pin's pull-up resistor is enabled. false: Port pin's pull-up resistor is disabled.
          boolean PortPullDownOption: set at post-build, origin=Renesas_v1.0.0, default-value=false  # This parameter switches on or off the port pins pull-down resistor. true: Port pin's pull-down resistor is enabled. false: Port pin's pull-down resistor is disabled.
          enumeration PortOpenDrainControl_Expansion: {OpenDrain_PushPull, OpenDrain_N_Channel, OpenDrain_P_Channel}, set at post-build, origin=Renesas_v1.0.0, default-value=OpenDrain_PushPull  # This parameter selects port pins output buffer function in combination of PODC and PODCE . | OpenDrain_PushPull Specifies the OpenDrain_PushPull open drain type output circuit characteristics and updates both PODC and PODCE registers as 0 0 respectively. OpenDrain_N_Channel specifies the N-ch open drain type output circuit characteristics and updates the PODC and PODCE registers as 1 0 respectively. OpenDrain_P_Channel specifies the P-ch open drain type output circuit characteristics and updates the PODC and PODCE registers as 1 1 respectively.
          boolean PortOutputLevelInversion: set at post-build, origin=Renesas_v1.0.0, default-value=false  # This parameter specifies whether the output level from a pin is inverted or not.. true: Pin output level is inverted. false: Pin output level is not inverted.
          enumeration PortOutputDriveStrength: {SLOW, FAST, MIDDLE_0, MIDDLE_1}, set at post-build, origin=Renesas_v1.0.0, default-value=SLOW  # This parameter selects the port pins output drive strength as high strength or low strength type. This functionality is also referred to fast (high strength) and slow (low strength) behavior of output buffer. SLOW: Lower drive strength (slow mode) is selected for port pin's output buffer. FAST: Higher drive strength (fast mode) is selected for port pin's output buffer. MIDDLE_0: Lower drive strength (middle mode) is selected for port pin's output buffer. MIDDLE_1: Lower drive strength (middle mode) is selected for port pin's output buffer.
          enumeration PortInputSelection: {TYPE_1_SUPP_PISA, TYPE_2_SUPP_PISA}, set at post-build, origin=Renesas_v1.0.0, default-value=TYPE_1_SUPP_PISA  # This setting specifies the input buffer characteristics. TYPE_1_SUPP_PISA: TYPE 1 buffer is selected. TYPE_2_SUPP_PISA: TYPE 2 buffer is selected.
        container PortPin8  # This container contains the configuration (parameters) for Port Pin 8.
          boolean PortPinDirectionChangeable: set at post-build, origin=Renesas_v1.0.0, default-value=false  # Parameter to indicate if the direction is changeable on a port pin during runtime. true: Port Pin direction changeable enabled. false: Port Pin direction changeable disabled.
          boolean PortPinDioAltModeChangeable: set at post-build, origin=Renesas_v1.0.0, default-value=false  # Parameter to indicate if the mode of a port pin is changeable between DIO and Alternate during runtime by API functions Port_SetToDioMode and Port_SetToAlternateMode. Including these APIs is controlled by PortSetToDioAltModeApi. true: Dio Alternate mode is changeable. false: Dio Alternate mode is not changeable.
          boolean PortPinModeChangeable: set at post-build, origin=Renesas_v1.0.0, default-value=false  # Parameter to indicate if the mode of a port pin is changeable during runtime by API function Port_SetPinMode. Including this API is controlled by PortSetPinModeApi. true: Port Pin mode is changeable. false: Port Pin mode is not changeable.
          enumeration PortPinLevelValue: {PORT_PIN_LEVEL_LOW, PORT_PIN_LEVEL_HIGH}, set at post-build, origin=Renesas_v1.0.0, default-value=PORT_PIN_LEVEL_LOW  # Parameter to indicate port pin level value for a port pin. PORT_PIN_LEVEL_LOW: Port pin Level is low. PORT_PIN_LEVEL_HIGH: Port pin Level is high.
          enumeration PortPinInitialMode: {SCI31RX_ALT1_IN, INTP1_ALT1_IN, CSIH3RYO_ALT1_OUT, CSIH0CSS6_ALT2_OUT, CSIH1SO_ALT3_OUT, CSIH3RYI_ALT4_IN, CSIH3CSS0_ALT4_OUT, TSG30O5_ALT5_OUT, TAUD1I2_ALT6_IN, TAUD1O2_ALT6_OUT, DIO}, set at post-build, origin=Renesas_v1.0.0, default-value=DIO  # Mode of the port pin for use with Port_Init() function. <Input name>_ALT<Alternative instance>_IN: Provides alternative instance for selected input. <Output name>_ALT<Alternative instance>_OUT: Provides alternative instance for selected output.
          enumeration PortPinDirection: {PORT_PIN_OUT, PORT_PIN_IN}, set at post-build, origin=Renesas_v1.0.0, default-value=PORT_PIN_IN  # The initial direction of the pin (IN or OUT). If the direction is not changeable, the value configured here is fixed. The direction must match the pin mode. PORT_PIN_IN: Port pin direction set as input. PORT_PIN_OUT: Port pin direction set as output.
          boolean PortInputBufferControl: set at post-build, origin=Renesas_v1.0.0, default-value=false  # This parameter is used as one of the factors to enable/disable port pins input buffer in DIO Mode (PMC=0). true: Port pin's input buffer is ready to be enabled in DIO Mode. false: Port pin's input buffer is disabled in DIO Mode.
          boolean PortBiDirectionControl: set at post-build, origin=Renesas_v1.0.0, default-value=false  # This parameter forces port pins input buffer and output buffer at the same time. If activated, the effect is valid independently from any other port settings. true: Activate forced Bi-directional IO buffer of the port pin. false: Deactivate forced Bi-directional IO buffer of the port pin.
          boolean PortIpControl: set at post-build, origin=Renesas_v1.0.0, default-value=false  # This parameter is used to enable/disable the direct IO control of port pins direction true: Enables the direct IO control over port pins direction by the corresponding control signals from internal peripheral IPs. This register is valid only in Alternative Mode (PMC=1). false: Disables the direct IO control over port pins direction. PortIpControl should be set to True, when PortPinInitialMode is CSIH1SO_ALT3_OUT or TSG30O5_ALT5_OUT.
          boolean PortPullUpOption: set at post-build, origin=Renesas_v1.0.0, default-value=false  # This register switches on or off the port pins pull-up resistor. true: Port pin's pull-up resistor is enabled. false: Port pin's pull-up resistor is disabled.
          boolean PortPullDownOption: set at post-build, origin=Renesas_v1.0.0, default-value=false  # This parameter switches on or off the port pins pull-down resistor. true: Port pin's pull-down resistor is enabled. false: Port pin's pull-down resistor is disabled.
          enumeration PortOpenDrainControl_Expansion: {OpenDrain_PushPull, OpenDrain_N_Channel, OpenDrain_P_Channel}, set at post-build, origin=Renesas_v1.0.0, default-value=OpenDrain_PushPull  # This parameter selects port pins output buffer function in combination of PODC and PODCE . | OpenDrain_PushPull Specifies the OpenDrain_PushPull open drain type output circuit characteristics and updates both PODC and PODCE registers as 0 0 respectively. OpenDrain_N_Channel specifies the N-ch open drain type output circuit characteristics and updates the PODC and PODCE registers as 1 0 respectively. OpenDrain_P_Channel specifies the P-ch open drain type output circuit characteristics and updates the PODC and PODCE registers as 1 1 respectively.
          boolean PortOutputLevelInversion: set at post-build, origin=Renesas_v1.0.0, default-value=false  # This parameter specifies whether the output level from a pin is inverted or not.. true: Pin output level is inverted. false: Pin output level is not inverted.
          enumeration PortOutputDriveStrength: {SLOW, FAST, MIDDLE_0, MIDDLE_1}, set at post-build, origin=Renesas_v1.0.0, default-value=SLOW  # This parameter selects the port pins output drive strength as high strength or low strength type. This functionality is also referred to fast (high strength) and slow (low strength) behavior of output buffer. SLOW: Lower drive strength (slow mode) is selected for port pin's output buffer. FAST: Higher drive strength (fast mode) is selected for port pin's output buffer. MIDDLE_0: Lower drive strength (middle mode) is selected for port pin's output buffer. MIDDLE_1: Lower drive strength (middle mode) is selected for port pin's output buffer.
        container PortPin9  # This container contains the configuration (parameters) for Port Pin 9.
          boolean PortPinDirectionChangeable: set at post-build, origin=Renesas_v1.0.0, default-value=false  # Parameter to indicate if the direction is changeable on a port pin during runtime. true: Port Pin direction changeable enabled. false: Port Pin direction changeable disabled.
          boolean PortPinDioAltModeChangeable: set at post-build, origin=Renesas_v1.0.0, default-value=false  # Parameter to indicate if the mode of a port pin is changeable between DIO and Alternate during runtime by API functions Port_SetToDioMode and Port_SetToAlternateMode. Including these APIs is controlled by PortSetToDioAltModeApi. true: Dio Alternate mode is changeable. false: Dio Alternate mode is not changeable.
          boolean PortPinModeChangeable: set at post-build, origin=Renesas_v1.0.0, default-value=false  # Parameter to indicate if the mode of a port pin is changeable during runtime by API function Port_SetPinMode. Including this API is controlled by PortSetPinModeApi. true: Port Pin mode is changeable. false: Port Pin mode is not changeable.
          enumeration PortPinLevelValue: {PORT_PIN_LEVEL_LOW, PORT_PIN_LEVEL_HIGH}, set at post-build, origin=Renesas_v1.0.0, default-value=PORT_PIN_LEVEL_LOW  # Parameter to indicate port pin level value for a port pin. PORT_PIN_LEVEL_LOW: Port pin Level is low. PORT_PIN_LEVEL_HIGH: Port pin Level is high.
          enumeration PortPinInitialMode: {SCI31TX_ALT1_OUT, CSIH0CSS7_ALT2_OUT, CSIH1SCI_ALT3_IN, CSIH1SCO_ALT3_OUT, CSIH3CSS1_ALT4_OUT, TSG30O6_ALT5_OUT, TAUD1I3_ALT6_IN, TAUD1O3_ALT6_OUT, DIO}, set at post-build, origin=Renesas_v1.0.0, default-value=DIO  # Mode of the port pin for use with Port_Init() function. <Input name>_ALT<Alternative instance>_IN: Provides alternative instance for selected input. <Output name>_ALT<Alternative instance>_OUT: Provides alternative instance for selected output.
          enumeration PortPinDirection: {PORT_PIN_OUT, PORT_PIN_IN}, set at post-build, origin=Renesas_v1.0.0, default-value=PORT_PIN_IN  # The initial direction of the pin (IN or OUT). If the direction is not changeable, the value configured here is fixed. The direction must match the pin mode. PORT_PIN_IN: Port pin direction set as input. PORT_PIN_OUT: Port pin direction set as output.
          boolean PortInputBufferControl: set at post-build, origin=Renesas_v1.0.0, default-value=false  # This parameter is used as one of the factors to enable/disable port pins input buffer in DIO Mode (PMC=0). true: Port pin's input buffer is ready to be enabled in DIO Mode. false: Port pin's input buffer is disabled in DIO Mode.
          boolean PortBiDirectionControl: set at post-build, origin=Renesas_v1.0.0, default-value=false  # This parameter forces port pins input buffer and output buffer at the same time. If activated, the effect is valid independently from any other port settings. true: Activate forced Bi-directional IO buffer of the port pin. false: Deactivate forced Bi-directional IO buffer of the port pin.
          boolean PortIpControl: set at post-build, origin=Renesas_v1.0.0, default-value=false  # This parameter is used to enable/disable the direct IO control of port pins direction true: Enables the direct IO control over port pins direction by the corresponding control signals from internal peripheral IPs. This register is valid only in Alternative Mode (PMC=1). false: Disables the direct IO control over port pins direction. PortIpControl should be set to True, when PortPinInitialMode is CSIH1SCO_ALT3_OUT or TSG30O6_ALT5_OUT.
          boolean PortPullUpOption: set at post-build, origin=Renesas_v1.0.0, default-value=false  # This register switches on or off the port pins pull-up resistor. true: Port pin's pull-up resistor is enabled. false: Port pin's pull-up resistor is disabled.
          boolean PortPullDownOption: set at post-build, origin=Renesas_v1.0.0, default-value=false  # This parameter switches on or off the port pins pull-down resistor. true: Port pin's pull-down resistor is enabled. false: Port pin's pull-down resistor is disabled.
          enumeration PortOpenDrainControl_Expansion: {OpenDrain_PushPull, OpenDrain_N_Channel, OpenDrain_P_Channel}, set at post-build, origin=Renesas_v1.0.0, default-value=OpenDrain_PushPull  # This parameter selects port pins output buffer function in combination of PODC and PODCE . | OpenDrain_PushPull Specifies the OpenDrain_PushPull open drain type output circuit characteristics and updates both PODC and PODCE registers as 0 0 respectively. OpenDrain_N_Channel specifies the N-ch open drain type output circuit characteristics and updates the PODC and PODCE registers as 1 0 respectively. OpenDrain_P_Channel specifies the P-ch open drain type output circuit characteristics and updates the PODC and PODCE registers as 1 1 respectively.
          boolean PortOutputLevelInversion: set at post-build, origin=Renesas_v1.0.0, default-value=false  # This parameter specifies whether the output level from a pin is inverted or not.. true: Pin output level is inverted. false: Pin output level is not inverted.
          enumeration PortOutputDriveStrength: {SLOW, FAST, MIDDLE_0, MIDDLE_1}, set at post-build, origin=Renesas_v1.0.0, default-value=SLOW  # This parameter selects the port pins output drive strength as high strength or low strength type. This functionality is also referred to fast (high strength) and slow (low strength) behavior of output buffer. SLOW: Lower drive strength (slow mode) is selected for port pin's output buffer. FAST: Higher drive strength (fast mode) is selected for port pin's output buffer. MIDDLE_0: Lower drive strength (middle mode) is selected for port pin's output buffer. MIDDLE_1: Lower drive strength (middle mode) is selected for port pin's output buffer.
      container PortGroup3  # This container contains the configuration (parameters) for Port Group 8.
        container PortPin3  # This container contains the configuration (parameters) for Port Pin 3.
          boolean PortPinDirectionChangeable: set at post-build, origin=Renesas_v1.0.0, default-value=false  # Parameter to indicate if the direction is changeable on a port pin during runtime. true: Port Pin direction changeable enabled. false: Port Pin direction changeable disabled.
          boolean PortPinDioAltModeChangeable: set at post-build, origin=Renesas_v1.0.0, default-value=false  # Parameter to indicate if the mode of a port pin is changeable between DIO and Alternate during runtime by API functions Port_SetToDioMode and Port_SetToAlternateMode. Including these APIs is controlled by PortSetToDioAltModeApi. true: Dio Alternate mode is changeable. false: Dio Alternate mode is not changeable.
          boolean PortPinModeChangeable: set at post-build, origin=Renesas_v1.0.0, default-value=false  # Parameter to indicate if the mode of a port pin is changeable during runtime by API function Port_SetPinMode. Including this API is controlled by PortSetPinModeApi. true: Port Pin mode is changeable. false: Port Pin mode is not changeable.
          enumeration PortPinLevelValue: {PORT_PIN_LEVEL_LOW, PORT_PIN_LEVEL_HIGH}, set at post-build, origin=Renesas_v1.0.0, default-value=PORT_PIN_LEVEL_LOW  # Parameter to indicate port pin level value for a port pin. PORT_PIN_LEVEL_LOW: Port pin Level is low. PORT_PIN_LEVEL_HIGH: Port pin Level is high.
          enumeration PortPinInitialMode: {CSIH0RYI_ALT1_IN, SCI32TX_ALT1_OUT, TAUD1I0_ALT2_IN, CSIH2CSS1_ALT2_OUT, CSIH3SSIZ_ALT4_IN, CSIH3CSS4_ALT4_OUT, TAUD1O0_ALT5_OUT, TAUD1O1_ALT6_OUT, DIO}, set at post-build, origin=Renesas_v1.0.0, default-value=DIO  # Mode of the port pin for use with Port_Init() function. <Input name>_ALT<Alternative instance>_IN: Provides alternative instance for selected input. <Output name>_ALT<Alternative instance>_OUT: Provides alternative instance for selected output.
          enumeration PortPinDirection: {PORT_PIN_OUT, PORT_PIN_IN}, set at post-build, origin=Renesas_v1.0.0, default-value=PORT_PIN_IN  # The initial direction of the pin (IN or OUT). If the direction is not changeable, the value configured here is fixed. The direction must match the pin mode. PORT_PIN_IN: Port pin direction set as input. PORT_PIN_OUT: Port pin direction set as output.
          boolean PortInputBufferControl: set at post-build, origin=Renesas_v1.0.0, default-value=false  # This parameter is used as one of the factors to enable/disable port pins input buffer in DIO Mode (PMC=0). true: Port pin's input buffer is ready to be enabled in DIO Mode. false: Port pin's input buffer is disabled in DIO Mode.
          boolean PortBiDirectionControl: set at post-build, origin=Renesas_v1.0.0, default-value=false  # This parameter forces port pins input buffer and output buffer at the same time. If activated, the effect is valid independently from any other port settings. true: Activate forced Bi-directional IO buffer of the port pin. false: Deactivate forced Bi-directional IO buffer of the port pin.
          boolean PortPullUpOption: set at post-build, origin=Renesas_v1.0.0, default-value=false  # This register switches on or off the port pins pull-up resistor. true: Port pin's pull-up resistor is enabled. false: Port pin's pull-up resistor is disabled.
          boolean PortPullDownOption: set at post-build, origin=Renesas_v1.0.0, default-value=false  # This parameter switches on or off the port pins pull-down resistor. true: Port pin's pull-down resistor is enabled. false: Port pin's pull-down resistor is disabled.
          enumeration PortOpenDrainControl_Expansion: {OpenDrain_PushPull, OpenDrain_N_Channel, OpenDrain_P_Channel}, set at post-build, origin=Renesas_v1.0.0, default-value=OpenDrain_PushPull  # This parameter selects port pins output buffer function in combination of PODC and PODCE . | OpenDrain_PushPull Specifies the OpenDrain_PushPull open drain type output circuit characteristics and updates both PODC and PODCE registers as 0 0 respectively. OpenDrain_N_Channel specifies the N-ch open drain type output circuit characteristics and updates the PODC and PODCE registers as 1 0 respectively. OpenDrain_P_Channel specifies the P-ch open drain type output circuit characteristics and updates the PODC and PODCE registers as 1 1 respectively.
          boolean PortOutputLevelInversion: set at post-build, origin=Renesas_v1.0.0, default-value=false  # This parameter specifies whether the output level from a pin is inverted or not.. true: Pin output level is inverted. false: Pin output level is not inverted.
          enumeration PortOutputDriveStrength: {SLOW, FAST, MIDDLE_0, MIDDLE_1}, set at post-build, origin=Renesas_v1.0.0, default-value=SLOW  # This parameter selects the port pins output drive strength as high strength or low strength type. This functionality is also referred to fast (high strength) and slow (low strength) behavior of output buffer. SLOW: Lower drive strength (slow mode) is selected for port pin's output buffer. FAST: Higher drive strength (fast mode) is selected for port pin's output buffer. MIDDLE_0: Lower drive strength (middle mode) is selected for port pin's output buffer. MIDDLE_1: Lower drive strength (middle mode) is selected for port pin's output buffer.
        container PortPin4  # This container contains the configuration (parameters) for Port Pin 4.
          boolean PortPinDirectionChangeable: set at post-build, origin=Renesas_v1.0.0, default-value=false  # Parameter to indicate if the direction is changeable on a port pin during runtime. true: Port Pin direction changeable enabled. false: Port Pin direction changeable disabled.
          boolean PortPinDioAltModeChangeable: set at post-build, origin=Renesas_v1.0.0, default-value=false  # Parameter to indicate if the mode of a port pin is changeable between DIO and Alternate during runtime by API functions Port_SetToDioMode and Port_SetToAlternateMode. Including these APIs is controlled by PortSetToDioAltModeApi. true: Dio Alternate mode is changeable. false: Dio Alternate mode is not changeable.
          boolean PortPinModeChangeable: set at post-build, origin=Renesas_v1.0.0, default-value=false  # Parameter to indicate if the mode of a port pin is changeable during runtime by API function Port_SetPinMode. Including this API is controlled by PortSetPinModeApi. true: Port Pin mode is changeable. false: Port Pin mode is not changeable.
          enumeration PortPinLevelValue: {PORT_PIN_LEVEL_LOW, PORT_PIN_LEVEL_HIGH}, set at post-build, origin=Renesas_v1.0.0, default-value=PORT_PIN_LEVEL_LOW  # Parameter to indicate port pin level value for a port pin. PORT_PIN_LEVEL_LOW: Port pin Level is low. PORT_PIN_LEVEL_HIGH: Port pin Level is high.
          enumeration PortPinInitialMode: {SCI32RX_ALT1_IN, INTP2_ALT1_IN, TAUD1I2_ALT2_IN, CSIH2CSS2_ALT2_OUT, RLIN30RX_ALT3_IN, INTP3_ALT3_IN, CSIG0RYO_ALT3_OUT, CSIH3CSS3_ALT4_OUT, TAUD1O2_ALT5_OUT, TAUD1O3_ALT6_OUT, DIO}, set at post-build, origin=Renesas_v1.0.0, default-value=DIO  # Mode of the port pin for use with Port_Init() function. <Input name>_ALT<Alternative instance>_IN: Provides alternative instance for selected input. <Output name>_ALT<Alternative instance>_OUT: Provides alternative instance for selected output.
          enumeration PortPinDirection: {PORT_PIN_OUT, PORT_PIN_IN}, set at post-build, origin=Renesas_v1.0.0, default-value=PORT_PIN_IN  # The initial direction of the pin (IN or OUT). If the direction is not changeable, the value configured here is fixed. The direction must match the pin mode. PORT_PIN_IN: Port pin direction set as input. PORT_PIN_OUT: Port pin direction set as output.
          boolean PortInputBufferControl: set at post-build, origin=Renesas_v1.0.0, default-value=false  # This parameter is used as one of the factors to enable/disable port pins input buffer in DIO Mode (PMC=0). true: Port pin's input buffer is ready to be enabled in DIO Mode. false: Port pin's input buffer is disabled in DIO Mode.
          boolean PortBiDirectionControl: set at post-build, origin=Renesas_v1.0.0, default-value=false  # This parameter forces port pins input buffer and output buffer at the same time. If activated, the effect is valid independently from any other port settings. true: Activate forced Bi-directional IO buffer of the port pin. false: Deactivate forced Bi-directional IO buffer of the port pin.
          boolean PortPullUpOption: set at post-build, origin=Renesas_v1.0.0, default-value=false  # This register switches on or off the port pins pull-up resistor. true: Port pin's pull-up resistor is enabled. false: Port pin's pull-up resistor is disabled.
          boolean PortPullDownOption: set at post-build, origin=Renesas_v1.0.0, default-value=false  # This parameter switches on or off the port pins pull-down resistor. true: Port pin's pull-down resistor is enabled. false: Port pin's pull-down resistor is disabled.
          enumeration PortOpenDrainControl_Expansion: {OpenDrain_PushPull, OpenDrain_N_Channel, OpenDrain_P_Channel}, set at post-build, origin=Renesas_v1.0.0, default-value=OpenDrain_PushPull  # This parameter selects port pins output buffer function in combination of PODC and PODCE . | OpenDrain_PushPull Specifies the OpenDrain_PushPull open drain type output circuit characteristics and updates both PODC and PODCE registers as 0 0 respectively. OpenDrain_N_Channel specifies the N-ch open drain type output circuit characteristics and updates the PODC and PODCE registers as 1 0 respectively. OpenDrain_P_Channel specifies the P-ch open drain type output circuit characteristics and updates the PODC and PODCE registers as 1 1 respectively.
          boolean PortOutputLevelInversion: set at post-build, origin=Renesas_v1.0.0, default-value=false  # This parameter specifies whether the output level from a pin is inverted or not.. true: Pin output level is inverted. false: Pin output level is not inverted.
          enumeration PortOutputDriveStrength: {SLOW, FAST, MIDDLE_0, MIDDLE_1}, set at post-build, origin=Renesas_v1.0.0, default-value=SLOW  # This parameter selects the port pins output drive strength as high strength or low strength type. This functionality is also referred to fast (high strength) and slow (low strength) behavior of output buffer. SLOW: Lower drive strength (slow mode) is selected for port pin's output buffer. FAST: Higher drive strength (fast mode) is selected for port pin's output buffer. MIDDLE_0: Lower drive strength (middle mode) is selected for port pin's output buffer. MIDDLE_1: Lower drive strength (middle mode) is selected for port pin's output buffer.
        container PortPin5  # This container contains the configuration (parameters) for Port Pin 5.
          boolean PortPinDirectionChangeable: set at post-build, origin=Renesas_v1.0.0, default-value=false  # Parameter to indicate if the direction is changeable on a port pin during runtime. true: Port Pin direction changeable enabled. false: Port Pin direction changeable disabled.
          boolean PortPinDioAltModeChangeable: set at post-build, origin=Renesas_v1.0.0, default-value=false  # Parameter to indicate if the mode of a port pin is changeable between DIO and Alternate during runtime by API functions Port_SetToDioMode and Port_SetToAlternateMode. Including these APIs is controlled by PortSetToDioAltModeApi. true: Dio Alternate mode is changeable. false: Dio Alternate mode is not changeable.
          boolean PortPinModeChangeable: set at post-build, origin=Renesas_v1.0.0, default-value=false  # Parameter to indicate if the mode of a port pin is changeable during runtime by API function Port_SetPinMode. Including this API is controlled by PortSetPinModeApi. true: Port Pin mode is changeable. false: Port Pin mode is not changeable.
          enumeration PortPinLevelValue: {PORT_PIN_LEVEL_LOW, PORT_PIN_LEVEL_HIGH}, set at post-build, origin=Renesas_v1.0.0, default-value=PORT_PIN_LEVEL_LOW  # Parameter to indicate port pin level value for a port pin. PORT_PIN_LEVEL_LOW: Port pin Level is low. PORT_PIN_LEVEL_HIGH: Port pin Level is high.
          enumeration PortPinInitialMode: {SCI31SCI_ALT1_IN, SCI31SCO_ALT1_OUT, TAUD0I0_ALT2_IN, CSIH2CSS3_ALT2_OUT, CSIG0RYI_ALT3_IN, RLIN30TX_ALT3_OUT, CSIH3CSS2_ALT4_OUT, TAUD0O0_ALT5_OUT, TAUD0O1_ALT6_OUT, DIO}, set at post-build, origin=Renesas_v1.0.0, default-value=DIO  # Mode of the port pin for use with Port_Init() function. <Input name>_ALT<Alternative instance>_IN: Provides alternative instance for selected input. <Output name>_ALT<Alternative instance>_OUT: Provides alternative instance for selected output.
          enumeration PortPinDirection: {PORT_PIN_OUT, PORT_PIN_IN}, set at post-build, origin=Renesas_v1.0.0, default-value=PORT_PIN_IN  # The initial direction of the pin (IN or OUT). If the direction is not changeable, the value configured here is fixed. The direction must match the pin mode. PORT_PIN_IN: Port pin direction set as input. PORT_PIN_OUT: Port pin direction set as output.
          boolean PortInputBufferControl: set at post-build, origin=Renesas_v1.0.0, default-value=false  # This parameter is used as one of the factors to enable/disable port pins input buffer in DIO Mode (PMC=0). true: Port pin's input buffer is ready to be enabled in DIO Mode. false: Port pin's input buffer is disabled in DIO Mode.
          boolean PortBiDirectionControl: set at post-build, origin=Renesas_v1.0.0, default-value=false  # This parameter forces port pins input buffer and output buffer at the same time. If activated, the effect is valid independently from any other port settings. true: Activate forced Bi-directional IO buffer of the port pin. false: Deactivate forced Bi-directional IO buffer of the port pin.
          boolean PortPullUpOption: set at post-build, origin=Renesas_v1.0.0, default-value=false  # This register switches on or off the port pins pull-up resistor. true: Port pin's pull-up resistor is enabled. false: Port pin's pull-up resistor is disabled.
          boolean PortPullDownOption: set at post-build, origin=Renesas_v1.0.0, default-value=false  # This parameter switches on or off the port pins pull-down resistor. true: Port pin's pull-down resistor is enabled. false: Port pin's pull-down resistor is disabled.
          enumeration PortOpenDrainControl_Expansion: {OpenDrain_PushPull, OpenDrain_N_Channel, OpenDrain_P_Channel}, set at post-build, origin=Renesas_v1.0.0, default-value=OpenDrain_PushPull  # This parameter selects port pins output buffer function in combination of PODC and PODCE . | OpenDrain_PushPull Specifies the OpenDrain_PushPull open drain type output circuit characteristics and updates both PODC and PODCE registers as 0 0 respectively. OpenDrain_N_Channel specifies the N-ch open drain type output circuit characteristics and updates the PODC and PODCE registers as 1 0 respectively. OpenDrain_P_Channel specifies the P-ch open drain type output circuit characteristics and updates the PODC and PODCE registers as 1 1 respectively.
          boolean PortOutputLevelInversion: set at post-build, origin=Renesas_v1.0.0, default-value=false  # This parameter specifies whether the output level from a pin is inverted or not.. true: Pin output level is inverted. false: Pin output level is not inverted.
          enumeration PortOutputDriveStrength: {SLOW, FAST, MIDDLE_0, MIDDLE_1}, set at post-build, origin=Renesas_v1.0.0, default-value=SLOW  # This parameter selects the port pins output drive strength as high strength or low strength type. This functionality is also referred to fast (high strength) and slow (low strength) behavior of output buffer. SLOW: Lower drive strength (slow mode) is selected for port pin's output buffer. FAST: Higher drive strength (fast mode) is selected for port pin's output buffer. MIDDLE_0: Lower drive strength (middle mode) is selected for port pin's output buffer. MIDDLE_1: Lower drive strength (middle mode) is selected for port pin's output buffer.
        container PortPin6  # This container contains the configuration (parameters) for Port Pin 6.
          boolean PortPinDirectionChangeable: set at post-build, origin=Renesas_v1.0.0, default-value=false  # Parameter to indicate if the direction is changeable on a port pin during runtime. true: Port Pin direction changeable enabled. false: Port Pin direction changeable disabled.
          boolean PortPinDioAltModeChangeable: set at post-build, origin=Renesas_v1.0.0, default-value=false  # Parameter to indicate if the mode of a port pin is changeable between DIO and Alternate during runtime by API functions Port_SetToDioMode and Port_SetToAlternateMode. Including these APIs is controlled by PortSetToDioAltModeApi. true: Dio Alternate mode is changeable. false: Dio Alternate mode is not changeable.
          boolean PortPinModeChangeable: set at post-build, origin=Renesas_v1.0.0, default-value=false  # Parameter to indicate if the mode of a port pin is changeable during runtime by API function Port_SetPinMode. Including this API is controlled by PortSetPinModeApi. true: Port Pin mode is changeable. false: Port Pin mode is not changeable.
          enumeration PortPinLevelValue: {PORT_PIN_LEVEL_LOW, PORT_PIN_LEVEL_HIGH}, set at post-build, origin=Renesas_v1.0.0, default-value=PORT_PIN_LEVEL_LOW  # Parameter to indicate port pin level value for a port pin. PORT_PIN_LEVEL_LOW: Port pin Level is low. PORT_PIN_LEVEL_HIGH: Port pin Level is high.
          enumeration PortPinInitialMode: {CSIH0SI_ALT1_IN, TSG31O0_ALT2_OUT, TAUD0O2_ALT4_OUT, CSIH3RYI_ALT5_IN, CSIH2CSS4_ALT5_OUT, TAUD0O3_ALT6_OUT, DIO}, set at post-build, origin=Renesas_v1.0.0, default-value=DIO  # Mode of the port pin for use with Port_Init() function. <Input name>_ALT<Alternative instance>_IN: Provides alternative instance for selected input. <Output name>_ALT<Alternative instance>_OUT: Provides alternative instance for selected output.
          enumeration PortPinDirection: {PORT_PIN_OUT, PORT_PIN_IN}, set at post-build, origin=Renesas_v1.0.0, default-value=PORT_PIN_IN  # The initial direction of the pin (IN or OUT). If the direction is not changeable, the value configured here is fixed. The direction must match the pin mode. PORT_PIN_IN: Port pin direction set as input. PORT_PIN_OUT: Port pin direction set as output.
          boolean PortInputBufferControl: set at post-build, origin=Renesas_v1.0.0, default-value=false  # This parameter is used as one of the factors to enable/disable port pins input buffer in DIO Mode (PMC=0). true: Port pin's input buffer is ready to be enabled in DIO Mode. false: Port pin's input buffer is disabled in DIO Mode.
          boolean PortBiDirectionControl: set at post-build, origin=Renesas_v1.0.0, default-value=false  # This parameter forces port pins input buffer and output buffer at the same time. If activated, the effect is valid independently from any other port settings. true: Activate forced Bi-directional IO buffer of the port pin. false: Deactivate forced Bi-directional IO buffer of the port pin.
          boolean PortPullUpOption: set at post-build, origin=Renesas_v1.0.0, default-value=false  # This register switches on or off the port pins pull-up resistor. true: Port pin's pull-up resistor is enabled. false: Port pin's pull-up resistor is disabled.
          boolean PortPullDownOption: set at post-build, origin=Renesas_v1.0.0, default-value=false  # This parameter switches on or off the port pins pull-down resistor. true: Port pin's pull-down resistor is enabled. false: Port pin's pull-down resistor is disabled.
          enumeration PortOpenDrainControl_Expansion: {OpenDrain_PushPull, OpenDrain_N_Channel, OpenDrain_P_Channel}, set at post-build, origin=Renesas_v1.0.0, default-value=OpenDrain_PushPull  # This parameter selects port pins output buffer function in combination of PODC and PODCE . | OpenDrain_PushPull Specifies the OpenDrain_PushPull open drain type output circuit characteristics and updates both PODC and PODCE registers as 0 0 respectively. OpenDrain_N_Channel specifies the N-ch open drain type output circuit characteristics and updates the PODC and PODCE registers as 1 0 respectively. OpenDrain_P_Channel specifies the P-ch open drain type output circuit characteristics and updates the PODC and PODCE registers as 1 1 respectively.
          boolean PortOutputLevelInversion: set at post-build, origin=Renesas_v1.0.0, default-value=false  # This parameter specifies whether the output level from a pin is inverted or not.. true: Pin output level is inverted. false: Pin output level is not inverted.
          enumeration PortOutputDriveStrength: {SLOW, FAST, MIDDLE_0, MIDDLE_1}, set at post-build, origin=Renesas_v1.0.0, default-value=SLOW  # This parameter selects the port pins output drive strength as high strength or low strength type. This functionality is also referred to fast (high strength) and slow (low strength) behavior of output buffer. SLOW: Lower drive strength (slow mode) is selected for port pin's output buffer. FAST: Higher drive strength (fast mode) is selected for port pin's output buffer. MIDDLE_0: Lower drive strength (middle mode) is selected for port pin's output buffer. MIDDLE_1: Lower drive strength (middle mode) is selected for port pin's output buffer.
        container PortPin7  # This container contains the configuration (parameters) for Port Pin 7.
          boolean PortPinDirectionChangeable: set at post-build, origin=Renesas_v1.0.0, default-value=false  # Parameter to indicate if the direction is changeable on a port pin during runtime. true: Port Pin direction changeable enabled. false: Port Pin direction changeable disabled.
          boolean PortPinDioAltModeChangeable: set at post-build, origin=Renesas_v1.0.0, default-value=false  # Parameter to indicate if the mode of a port pin is changeable between DIO and Alternate during runtime by API functions Port_SetToDioMode and Port_SetToAlternateMode. Including these APIs is controlled by PortSetToDioAltModeApi. true: Dio Alternate mode is changeable. false: Dio Alternate mode is not changeable.
          boolean PortPinModeChangeable: set at post-build, origin=Renesas_v1.0.0, default-value=false  # Parameter to indicate if the mode of a port pin is changeable during runtime by API function Port_SetPinMode. Including this API is controlled by PortSetPinModeApi. true: Port Pin mode is changeable. false: Port Pin mode is not changeable.
          enumeration PortPinLevelValue: {PORT_PIN_LEVEL_LOW, PORT_PIN_LEVEL_HIGH}, set at post-build, origin=Renesas_v1.0.0, default-value=PORT_PIN_LEVEL_LOW  # Parameter to indicate port pin level value for a port pin. PORT_PIN_LEVEL_LOW: Port pin Level is low. PORT_PIN_LEVEL_HIGH: Port pin Level is high.
          enumeration PortPinInitialMode: {CSIH0SO_ALT1_OUT, TSG31O1_ALT2_OUT, RSCAN0RX0_ALT3_IN, INTP5_ALT3_IN, SCI30RX_ALT4_IN, INTP0_ALT4_IN, CSIH2RYI_ALT5_IN, CSIH2CSS5_ALT5_OUT, TAUD0O5_ALT6_OUT, DIO}, set at post-build, origin=Renesas_v1.0.0, default-value=DIO  # Mode of the port pin for use with Port_Init() function. <Input name>_ALT<Alternative instance>_IN: Provides alternative instance for selected input. <Output name>_ALT<Alternative instance>_OUT: Provides alternative instance for selected output.
          enumeration PortPinDirection: {PORT_PIN_OUT, PORT_PIN_IN}, set at post-build, origin=Renesas_v1.0.0, default-value=PORT_PIN_IN  # The initial direction of the pin (IN or OUT). If the direction is not changeable, the value configured here is fixed. The direction must match the pin mode. PORT_PIN_IN: Port pin direction set as input. PORT_PIN_OUT: Port pin direction set as output.
          boolean PortInputBufferControl: set at post-build, origin=Renesas_v1.0.0, default-value=false  # This parameter is used as one of the factors to enable/disable port pins input buffer in DIO Mode (PMC=0). true: Port pin's input buffer is ready to be enabled in DIO Mode. false: Port pin's input buffer is disabled in DIO Mode.
          boolean PortBiDirectionControl: set at post-build, origin=Renesas_v1.0.0, default-value=false  # This parameter forces port pins input buffer and output buffer at the same time. If activated, the effect is valid independently from any other port settings. true: Activate forced Bi-directional IO buffer of the port pin. false: Deactivate forced Bi-directional IO buffer of the port pin.
          boolean PortIpControl: set at post-build, origin=Renesas_v1.0.0, default-value=false  # This parameter is used to enable/disable the direct IO control of port pins direction true: Enables the direct IO control over port pins direction by the corresponding control signals from internal peripheral IPs. This register is valid only in Alternative Mode (PMC=1). false: Disables the direct IO control over port pins direction. PortIpControl should be set to True, when PortPinInitialMode is CSIH0SO_ALT1_OUT or TSG31O1_ALT2_OUT.
          boolean PortPullUpOption: set at post-build, origin=Renesas_v1.0.0, default-value=false  # This register switches on or off the port pins pull-up resistor. true: Port pin's pull-up resistor is enabled. false: Port pin's pull-up resistor is disabled.
          boolean PortPullDownOption: set at post-build, origin=Renesas_v1.0.0, default-value=false  # This parameter switches on or off the port pins pull-down resistor. true: Port pin's pull-down resistor is enabled. false: Port pin's pull-down resistor is disabled.
          enumeration PortOpenDrainControl_Expansion: {OpenDrain_PushPull, OpenDrain_N_Channel, OpenDrain_P_Channel}, set at post-build, origin=Renesas_v1.0.0, default-value=OpenDrain_PushPull  # This parameter selects port pins output buffer function in combination of PODC and PODCE . | OpenDrain_PushPull Specifies the OpenDrain_PushPull open drain type output circuit characteristics and updates both PODC and PODCE registers as 0 0 respectively. OpenDrain_N_Channel specifies the N-ch open drain type output circuit characteristics and updates the PODC and PODCE registers as 1 0 respectively. OpenDrain_P_Channel specifies the P-ch open drain type output circuit characteristics and updates the PODC and PODCE registers as 1 1 respectively.
          boolean PortOutputLevelInversion: set at post-build, origin=Renesas_v1.0.0, default-value=false  # This parameter specifies whether the output level from a pin is inverted or not.. true: Pin output level is inverted. false: Pin output level is not inverted.
          enumeration PortOutputDriveStrength: {SLOW, FAST, MIDDLE_0, MIDDLE_1}, set at post-build, origin=Renesas_v1.0.0, default-value=SLOW  # This parameter selects the port pins output drive strength as high strength or low strength type. This functionality is also referred to fast (high strength) and slow (low strength) behavior of output buffer. SLOW: Lower drive strength (slow mode) is selected for port pin's output buffer. FAST: Higher drive strength (fast mode) is selected for port pin's output buffer. MIDDLE_0: Lower drive strength (middle mode) is selected for port pin's output buffer. MIDDLE_1: Lower drive strength (middle mode) is selected for port pin's output buffer.
        container PortPin8  # This container contains the configuration (parameters) for Port Pin 8.
          boolean PortPinDirectionChangeable: set at post-build, origin=Renesas_v1.0.0, default-value=false  # Parameter to indicate if the direction is changeable on a port pin during runtime. true: Port Pin direction changeable enabled. false: Port Pin direction changeable disabled.
          boolean PortPinDioAltModeChangeable: set at post-build, origin=Renesas_v1.0.0, default-value=false  # Parameter to indicate if the mode of a port pin is changeable between DIO and Alternate during runtime by API functions Port_SetToDioMode and Port_SetToAlternateMode. Including these APIs is controlled by PortSetToDioAltModeApi. true: Dio Alternate mode is changeable. false: Dio Alternate mode is not changeable.
          boolean PortPinModeChangeable: set at post-build, origin=Renesas_v1.0.0, default-value=false  # Parameter to indicate if the mode of a port pin is changeable during runtime by API function Port_SetPinMode. Including this API is controlled by PortSetPinModeApi. true: Port Pin mode is changeable. false: Port Pin mode is not changeable.
          enumeration PortPinLevelValue: {PORT_PIN_LEVEL_LOW, PORT_PIN_LEVEL_HIGH}, set at post-build, origin=Renesas_v1.0.0, default-value=PORT_PIN_LEVEL_LOW  # Parameter to indicate port pin level value for a port pin. PORT_PIN_LEVEL_LOW: Port pin Level is low. PORT_PIN_LEVEL_HIGH: Port pin Level is high.
          enumeration PortPinInitialMode: {CSIH0SCI_ALT1_IN, CSIH0SCO_ALT1_OUT, TSG31O2_ALT2_OUT, RSCAN0TX0_ALT3_OUT, TPB1O_ALT4_OUT, CSIH0SSIZ_ALT5_IN, CSIH2CSS6_ALT5_OUT, TAUD0O7_ALT6_OUT, DIO}, set at post-build, origin=Renesas_v1.0.0, default-value=DIO  # Mode of the port pin for use with Port_Init() function. <Input name>_ALT<Alternative instance>_IN: Provides alternative instance for selected input. <Output name>_ALT<Alternative instance>_OUT: Provides alternative instance for selected output.
          enumeration PortPinDirection: {PORT_PIN_OUT, PORT_PIN_IN}, set at post-build, origin=Renesas_v1.0.0, default-value=PORT_PIN_IN  # The initial direction of the pin (IN or OUT). If the direction is not changeable, the value configured here is fixed. The direction must match the pin mode. PORT_PIN_IN: Port pin direction set as input. PORT_PIN_OUT: Port pin direction set as output.
          boolean PortInputBufferControl: set at post-build, origin=Renesas_v1.0.0, default-value=false  # This parameter is used as one of the factors to enable/disable port pins input buffer in DIO Mode (PMC=0). true: Port pin's input buffer is ready to be enabled in DIO Mode. false: Port pin's input buffer is disabled in DIO Mode.
          boolean PortBiDirectionControl: set at post-build, origin=Renesas_v1.0.0, default-value=false  # This parameter forces port pins input buffer and output buffer at the same time. If activated, the effect is valid independently from any other port settings. true: Activate forced Bi-directional IO buffer of the port pin. false: Deactivate forced Bi-directional IO buffer of the port pin.
          boolean PortIpControl: set at post-build, origin=Renesas_v1.0.0, default-value=false  # This parameter is used to enable/disable the direct IO control of port pins direction true: Enables the direct IO control over port pins direction by the corresponding control signals from internal peripheral IPs. This register is valid only in Alternative Mode (PMC=1). false: Disables the direct IO control over port pins direction. PortIpControl should be set to True, when PortPinInitialMode is CSIH0SCO_ALT1_OUT or TSG31O2_ALT2_OUT.
          boolean PortPullUpOption: set at post-build, origin=Renesas_v1.0.0, default-value=false  # This register switches on or off the port pins pull-up resistor. true: Port pin's pull-up resistor is enabled. false: Port pin's pull-up resistor is disabled.
          boolean PortPullDownOption: set at post-build, origin=Renesas_v1.0.0, default-value=false  # This parameter switches on or off the port pins pull-down resistor. true: Port pin's pull-down resistor is enabled. false: Port pin's pull-down resistor is disabled.
          enumeration PortOpenDrainControl_Expansion: {OpenDrain_PushPull, OpenDrain_N_Channel, OpenDrain_P_Channel}, set at post-build, origin=Renesas_v1.0.0, default-value=OpenDrain_PushPull  # This parameter selects port pins output buffer function in combination of PODC and PODCE . | OpenDrain_PushPull Specifies the OpenDrain_PushPull open drain type output circuit characteristics and updates both PODC and PODCE registers as 0 0 respectively. OpenDrain_N_Channel specifies the N-ch open drain type output circuit characteristics and updates the PODC and PODCE registers as 1 0 respectively. OpenDrain_P_Channel specifies the P-ch open drain type output circuit characteristics and updates the PODC and PODCE registers as 1 1 respectively.
          boolean PortOutputLevelInversion: set at post-build, origin=Renesas_v1.0.0, default-value=false  # This parameter specifies whether the output level from a pin is inverted or not.. true: Pin output level is inverted. false: Pin output level is not inverted.
          enumeration PortOutputDriveStrength: {SLOW, FAST, MIDDLE_0, MIDDLE_1}, set at post-build, origin=Renesas_v1.0.0, default-value=SLOW  # This parameter selects the port pins output drive strength as high strength or low strength type. This functionality is also referred to fast (high strength) and slow (low strength) behavior of output buffer. SLOW: Lower drive strength (slow mode) is selected for port pin's output buffer. FAST: Higher drive strength (fast mode) is selected for port pin's output buffer. MIDDLE_0: Lower drive strength (middle mode) is selected for port pin's output buffer. MIDDLE_1: Lower drive strength (middle mode) is selected for port pin's output buffer.
        container PortPin9  # This container contains the configuration (parameters) for Port Pin 9.
          boolean PortPinDirectionChangeable: set at post-build, origin=Renesas_v1.0.0, default-value=false  # Parameter to indicate if the direction is changeable on a port pin during runtime. true: Port Pin direction changeable enabled. false: Port Pin direction changeable disabled.
          boolean PortPinDioAltModeChangeable: set at post-build, origin=Renesas_v1.0.0, default-value=false  # Parameter to indicate if the mode of a port pin is changeable between DIO and Alternate during runtime by API functions Port_SetToDioMode and Port_SetToAlternateMode. Including these APIs is controlled by PortSetToDioAltModeApi. true: Dio Alternate mode is changeable. false: Dio Alternate mode is not changeable.
          boolean PortPinModeChangeable: set at post-build, origin=Renesas_v1.0.0, default-value=false  # Parameter to indicate if the mode of a port pin is changeable during runtime by API function Port_SetPinMode. Including this API is controlled by PortSetPinModeApi. true: Port Pin mode is changeable. false: Port Pin mode is not changeable.
          enumeration PortPinLevelValue: {PORT_PIN_LEVEL_LOW, PORT_PIN_LEVEL_HIGH}, set at post-build, origin=Renesas_v1.0.0, default-value=PORT_PIN_LEVEL_LOW  # Parameter to indicate port pin level value for a port pin. PORT_PIN_LEVEL_LOW: Port pin Level is low. PORT_PIN_LEVEL_HIGH: Port pin Level is high.
          enumeration PortPinInitialMode: {SCI32SCI_ALT1_IN, SCI32SCO_ALT1_OUT, TSG31O3_ALT2_OUT, CSIH3CSS5_ALT4_OUT, CSIH0RYI_ALT5_IN, CSIH2CSS7_ALT5_OUT, TAUD0O9_ALT6_OUT, DIO}, set at post-build, origin=Renesas_v1.0.0, default-value=DIO  # Mode of the port pin for use with Port_Init() function. <Input name>_ALT<Alternative instance>_IN: Provides alternative instance for selected input. <Output name>_ALT<Alternative instance>_OUT: Provides alternative instance for selected output.
          enumeration PortPinDirection: {PORT_PIN_OUT, PORT_PIN_IN}, set at post-build, origin=Renesas_v1.0.0, default-value=PORT_PIN_IN  # The initial direction of the pin (IN or OUT). If the direction is not changeable, the value configured here is fixed. The direction must match the pin mode. PORT_PIN_IN: Port pin direction set as input. PORT_PIN_OUT: Port pin direction set as output.
          boolean PortInputBufferControl: set at post-build, origin=Renesas_v1.0.0, default-value=false  # This parameter is used as one of the factors to enable/disable port pins input buffer in DIO Mode (PMC=0). true: Port pin's input buffer is ready to be enabled in DIO Mode. false: Port pin's input buffer is disabled in DIO Mode.
          boolean PortBiDirectionControl: set at post-build, origin=Renesas_v1.0.0, default-value=false  # This parameter forces port pins input buffer and output buffer at the same time. If activated, the effect is valid independently from any other port settings. true: Activate forced Bi-directional IO buffer of the port pin. false: Deactivate forced Bi-directional IO buffer of the port pin.
          boolean PortIpControl: set at post-build, origin=Renesas_v1.0.0, default-value=false  # This parameter is used to enable/disable the direct IO control of port pins direction true: Enables the direct IO control over port pins direction by the corresponding control signals from internal peripheral IPs. This register is valid only in Alternative Mode (PMC=1). false: Disables the direct IO control over port pins direction. PortIpControl should be set to True, when PortPinInitialMode is TSG31O3_ALT2_OUT.
          boolean PortPullUpOption: set at post-build, origin=Renesas_v1.0.0, default-value=false  # This register switches on or off the port pins pull-up resistor. true: Port pin's pull-up resistor is enabled. false: Port pin's pull-up resistor is disabled.
          boolean PortPullDownOption: set at post-build, origin=Renesas_v1.0.0, default-value=false  # This parameter switches on or off the port pins pull-down resistor. true: Port pin's pull-down resistor is enabled. false: Port pin's pull-down resistor is disabled.
          enumeration PortOpenDrainControl_Expansion: {OpenDrain_PushPull, OpenDrain_N_Channel, OpenDrain_P_Channel}, set at post-build, origin=Renesas_v1.0.0, default-value=OpenDrain_PushPull  # This parameter selects port pins output buffer function in combination of PODC and PODCE . | OpenDrain_PushPull Specifies the OpenDrain_PushPull open drain type output circuit characteristics and updates both PODC and PODCE registers as 0 0 respectively. OpenDrain_N_Channel specifies the N-ch open drain type output circuit characteristics and updates the PODC and PODCE registers as 1 0 respectively. OpenDrain_P_Channel specifies the P-ch open drain type output circuit characteristics and updates the PODC and PODCE registers as 1 1 respectively.
          boolean PortOutputLevelInversion: set at post-build, origin=Renesas_v1.0.0, default-value=false  # This parameter specifies whether the output level from a pin is inverted or not.. true: Pin output level is inverted. false: Pin output level is not inverted.
          enumeration PortOutputDriveStrength: {SLOW, FAST, MIDDLE_0, MIDDLE_1}, set at post-build, origin=Renesas_v1.0.0, default-value=SLOW  # This parameter selects the port pins output drive strength as high strength or low strength type. This functionality is also referred to fast (high strength) and slow (low strength) behavior of output buffer. SLOW: Lower drive strength (slow mode) is selected for port pin's output buffer. FAST: Higher drive strength (fast mode) is selected for port pin's output buffer. MIDDLE_0: Lower drive strength (middle mode) is selected for port pin's output buffer. MIDDLE_1: Lower drive strength (middle mode) is selected for port pin's output buffer.
        container PortPin10  # This container contains the configuration (parameters) for Port Pin 10.
          boolean PortPinDirectionChangeable: set at post-build, origin=Renesas_v1.0.0, default-value=false  # Parameter to indicate if the direction is changeable on a port pin during runtime. true: Port Pin direction changeable enabled. false: Port Pin direction changeable disabled.
          boolean PortPinDioAltModeChangeable: set at post-build, origin=Renesas_v1.0.0, default-value=false  # Parameter to indicate if the mode of a port pin is changeable between DIO and Alternate during runtime by API functions Port_SetToDioMode and Port_SetToAlternateMode. Including these APIs is controlled by PortSetToDioAltModeApi. true: Dio Alternate mode is changeable. false: Dio Alternate mode is not changeable.
          boolean PortPinModeChangeable: set at post-build, origin=Renesas_v1.0.0, default-value=false  # Parameter to indicate if the mode of a port pin is changeable during runtime by API function Port_SetPinMode. Including this API is controlled by PortSetPinModeApi. true: Port Pin mode is changeable. false: Port Pin mode is not changeable.
          enumeration PortPinLevelValue: {PORT_PIN_LEVEL_LOW, PORT_PIN_LEVEL_HIGH}, set at post-build, origin=Renesas_v1.0.0, default-value=PORT_PIN_LEVEL_LOW  # Parameter to indicate port pin level value for a port pin. PORT_PIN_LEVEL_LOW: Port pin Level is low. PORT_PIN_LEVEL_HIGH: Port pin Level is high.
          enumeration PortPinInitialMode: {TSG31O4_ALT2_OUT_SUPP_PFC_PFCAE_PMCSR, TAUD1I6_ALT5_IN_SUPP_PFC_PFCAE_PMCSR, TAUD0O11_ALT6_OUT_SUPP_PFC_PFCAE_PMCSR, DIO_SUPP_PFC_PFCAE_PMCSR}, set at post-build, origin=Renesas_v1.0.0, default-value=DIO_SUPP_PFC_PFCAE_PMCSR  # Mode of the port pin for use with Port_Init() function. <Input name>_ALT<Alternative instance>_IN: Provides alternative instance for selected input. <Output name>_ALT<Alternative instance>_OUT: Provides alternative instance for selected output.
          enumeration PortPinDirection: {PORT_PIN_OUT, PORT_PIN_IN}, set at post-build, origin=Renesas_v1.0.0, default-value=PORT_PIN_IN  # The initial direction of the pin (IN or OUT). If the direction is not changeable, the value configured here is fixed. The direction must match the pin mode. PORT_PIN_IN: Port pin direction set as input. PORT_PIN_OUT: Port pin direction set as output.
          boolean PortInputBufferControl: set at post-build, origin=Renesas_v1.0.0, default-value=false  # This parameter is used as one of the factors to enable/disable port pins input buffer in DIO Mode (PMC=0). true: Port pin's input buffer is ready to be enabled in DIO Mode. false: Port pin's input buffer is disabled in DIO Mode.
          boolean PortBiDirectionControl: set at post-build, origin=Renesas_v1.0.0, default-value=false  # This parameter forces port pins input buffer and output buffer at the same time. If activated, the effect is valid independently from any other port settings. true: Activate forced Bi-directional IO buffer of the port pin. false: Deactivate forced Bi-directional IO buffer of the port pin.
          boolean PortIpControl: set at post-build, origin=Renesas_v1.0.0, default-value=false  # This parameter is used to enable/disable the direct IO control of port pins direction true: Enables the direct IO control over port pins direction by the corresponding control signals from internal peripheral IPs. This register is valid only in Alternative Mode (PMC=1). false: Disables the direct IO control over port pins direction. PortIpControl should be set to True, when PortPinInitialMode is TSG31O4_ALT2_OUT_SUPP_PFC_PFCAE_PMCSR.
          boolean PortPullUpOption: set at post-build, origin=Renesas_v1.0.0, default-value=false  # This register switches on or off the port pins pull-up resistor. true: Port pin's pull-up resistor is enabled. false: Port pin's pull-up resistor is disabled.
          boolean PortPullDownOption: set at post-build, origin=Renesas_v1.0.0, default-value=false  # This parameter switches on or off the port pins pull-down resistor. true: Port pin's pull-down resistor is enabled. false: Port pin's pull-down resistor is disabled.
          enumeration PortOpenDrainControl_Expansion: {OpenDrain_PushPull, OpenDrain_N_Channel, OpenDrain_P_Channel}, set at post-build, origin=Renesas_v1.0.0, default-value=OpenDrain_PushPull  # This parameter selects port pins output buffer function in combination of PODC and PODCE . | OpenDrain_PushPull Specifies the OpenDrain_PushPull open drain type output circuit characteristics and updates both PODC and PODCE registers as 0 0 respectively. OpenDrain_N_Channel specifies the N-ch open drain type output circuit characteristics and updates the PODC and PODCE registers as 1 0 respectively. OpenDrain_P_Channel specifies the P-ch open drain type output circuit characteristics and updates the PODC and PODCE registers as 1 1 respectively.
          boolean PortOutputLevelInversion: set at post-build, origin=Renesas_v1.0.0, default-value=false  # This parameter specifies whether the output level from a pin is inverted or not.. true: Pin output level is inverted. false: Pin output level is not inverted.
          enumeration PortOutputDriveStrength: {SLOW, FAST, MIDDLE_0, MIDDLE_1}, set at post-build, origin=Renesas_v1.0.0, default-value=SLOW  # This parameter selects the port pins output drive strength as high strength or low strength type. This functionality is also referred to fast (high strength) and slow (low strength) behavior of output buffer. SLOW: Lower drive strength (slow mode) is selected for port pin's output buffer. FAST: Higher drive strength (fast mode) is selected for port pin's output buffer. MIDDLE_0: Lower drive strength (middle mode) is selected for port pin's output buffer. MIDDLE_1: Lower drive strength (middle mode) is selected for port pin's output buffer.
        container PortPin11  # This container contains the configuration (parameters) for Port Pin 11.
          boolean PortPinDirectionChangeable: set at post-build, origin=Renesas_v1.0.0, default-value=false  # Parameter to indicate if the direction is changeable on a port pin during runtime. true: Port Pin direction changeable enabled. false: Port Pin direction changeable disabled.
          boolean PortPinDioAltModeChangeable: set at post-build, origin=Renesas_v1.0.0, default-value=false  # Parameter to indicate if the mode of a port pin is changeable between DIO and Alternate during runtime by API functions Port_SetToDioMode and Port_SetToAlternateMode. Including these APIs is controlled by PortSetToDioAltModeApi. true: Dio Alternate mode is changeable. false: Dio Alternate mode is not changeable.
          boolean PortPinModeChangeable: set at post-build, origin=Renesas_v1.0.0, default-value=false  # Parameter to indicate if the mode of a port pin is changeable during runtime by API function Port_SetPinMode. Including this API is controlled by PortSetPinModeApi. true: Port Pin mode is changeable. false: Port Pin mode is not changeable.
          enumeration PortPinLevelValue: {PORT_PIN_LEVEL_LOW, PORT_PIN_LEVEL_HIGH}, set at post-build, origin=Renesas_v1.0.0, default-value=PORT_PIN_LEVEL_LOW  # Parameter to indicate port pin level value for a port pin. PORT_PIN_LEVEL_LOW: Port pin Level is low. PORT_PIN_LEVEL_HIGH: Port pin Level is high.
          enumeration PortPinInitialMode: {TAUJ0I3_ALT1_IN, TAUJ0O3_ALT1_OUT, SENT4SPCO_ALT2_OUT, ADCD0CNV4_ALT4_OUT, RLIN31TX_ALT6_OUT, DIO}, set at post-build, origin=Renesas_v1.0.0, default-value=DIO  # Mode of the port pin for use with Port_Init() function. <Input name>_ALT<Alternative instance>_IN: Provides alternative instance for selected input. <Output name>_ALT<Alternative instance>_OUT: Provides alternative instance for selected output.
          enumeration PortPinDirection: {PORT_PIN_OUT, PORT_PIN_IN}, set at post-build, origin=Renesas_v1.0.0, default-value=PORT_PIN_IN  # The initial direction of the pin (IN or OUT). If the direction is not changeable, the value configured here is fixed. The direction must match the pin mode. PORT_PIN_IN: Port pin direction set as input. PORT_PIN_OUT: Port pin direction set as output.
          boolean PortInputBufferControl: set at post-build, origin=Renesas_v1.0.0, default-value=false  # This parameter is used as one of the factors to enable/disable port pins input buffer in DIO Mode (PMC=0). true: Port pin's input buffer is ready to be enabled in DIO Mode. false: Port pin's input buffer is disabled in DIO Mode.
          boolean PortBiDirectionControl: set at post-build, origin=Renesas_v1.0.0, default-value=false  # This parameter forces port pins input buffer and output buffer at the same time. If activated, the effect is valid independently from any other port settings. true: Activate forced Bi-directional IO buffer of the port pin. false: Deactivate forced Bi-directional IO buffer of the port pin.
          boolean PortPullUpOption: set at post-build, origin=Renesas_v1.0.0, default-value=false  # This register switches on or off the port pins pull-up resistor. true: Port pin's pull-up resistor is enabled. false: Port pin's pull-up resistor is disabled.
          boolean PortPullDownOption: set at post-build, origin=Renesas_v1.0.0, default-value=false  # This parameter switches on or off the port pins pull-down resistor. true: Port pin's pull-down resistor is enabled. false: Port pin's pull-down resistor is disabled.
          enumeration PortOpenDrainControl_Expansion: {OpenDrain_PushPull, OpenDrain_N_Channel, OpenDrain_P_Channel}, set at post-build, origin=Renesas_v1.0.0, default-value=OpenDrain_PushPull  # This parameter selects port pins output buffer function in combination of PODC and PODCE . | OpenDrain_PushPull Specifies the OpenDrain_PushPull open drain type output circuit characteristics and updates both PODC and PODCE registers as 0 0 respectively. OpenDrain_N_Channel specifies the N-ch open drain type output circuit characteristics and updates the PODC and PODCE registers as 1 0 respectively. OpenDrain_P_Channel specifies the P-ch open drain type output circuit characteristics and updates the PODC and PODCE registers as 1 1 respectively.
          boolean PortOutputLevelInversion: set at post-build, origin=Renesas_v1.0.0, default-value=false  # This parameter specifies whether the output level from a pin is inverted or not.. true: Pin output level is inverted. false: Pin output level is not inverted.
          enumeration PortOutputDriveStrength: {SLOW, FAST, MIDDLE_0, MIDDLE_1}, set at post-build, origin=Renesas_v1.0.0, default-value=SLOW  # This parameter selects the port pins output drive strength as high strength or low strength type. This functionality is also referred to fast (high strength) and slow (low strength) behavior of output buffer. SLOW: Lower drive strength (slow mode) is selected for port pin's output buffer. FAST: Higher drive strength (fast mode) is selected for port pin's output buffer. MIDDLE_0: Lower drive strength (middle mode) is selected for port pin's output buffer. MIDDLE_1: Lower drive strength (middle mode) is selected for port pin's output buffer.
        container PortPin12  # This container contains the configuration (parameters) for Port Pin 12.
          boolean PortPinDirectionChangeable: set at post-build, origin=Renesas_v1.0.0, default-value=false  # Parameter to indicate if the direction is changeable on a port pin during runtime. true: Port Pin direction changeable enabled. false: Port Pin direction changeable disabled.
          boolean PortPinDioAltModeChangeable: set at post-build, origin=Renesas_v1.0.0, default-value=false  # Parameter to indicate if the mode of a port pin is changeable between DIO and Alternate during runtime by API functions Port_SetToDioMode and Port_SetToAlternateMode. Including these APIs is controlled by PortSetToDioAltModeApi. true: Dio Alternate mode is changeable. false: Dio Alternate mode is not changeable.
          boolean PortPinModeChangeable: set at post-build, origin=Renesas_v1.0.0, default-value=false  # Parameter to indicate if the mode of a port pin is changeable during runtime by API function Port_SetPinMode. Including this API is controlled by PortSetPinModeApi. true: Port Pin mode is changeable. false: Port Pin mode is not changeable.
          enumeration PortPinLevelValue: {PORT_PIN_LEVEL_LOW, PORT_PIN_LEVEL_HIGH}, set at post-build, origin=Renesas_v1.0.0, default-value=PORT_PIN_LEVEL_LOW  # Parameter to indicate port pin level value for a port pin. PORT_PIN_LEVEL_LOW: Port pin Level is low. PORT_PIN_LEVEL_HIGH: Port pin Level is high.
          enumeration PortPinInitialMode: {CSIH1RYO_ALT1_OUT, TSG31O5_ALT2_OUT, INTP6_ALT3_IN, RSCAN0RX1_ALT3_IN, SCI30TX_ALT4_OUT, TAUD1I8_ALT5_IN, CSIH0CSS0_ALT5_OUT, TAUD0O13_ALT6_OUT, DIO}, set at post-build, origin=Renesas_v1.0.0, default-value=DIO  # Mode of the port pin for use with Port_Init() function. <Input name>_ALT<Alternative instance>_IN: Provides alternative instance for selected input. <Output name>_ALT<Alternative instance>_OUT: Provides alternative instance for selected output.
          enumeration PortPinDirection: {PORT_PIN_OUT, PORT_PIN_IN}, set at post-build, origin=Renesas_v1.0.0, default-value=PORT_PIN_IN  # The initial direction of the pin (IN or OUT). If the direction is not changeable, the value configured here is fixed. The direction must match the pin mode. PORT_PIN_IN: Port pin direction set as input. PORT_PIN_OUT: Port pin direction set as output.
          boolean PortInputBufferControl: set at post-build, origin=Renesas_v1.0.0, default-value=false  # This parameter is used as one of the factors to enable/disable port pins input buffer in DIO Mode (PMC=0). true: Port pin's input buffer is ready to be enabled in DIO Mode. false: Port pin's input buffer is disabled in DIO Mode.
          boolean PortBiDirectionControl: set at post-build, origin=Renesas_v1.0.0, default-value=false  # This parameter forces port pins input buffer and output buffer at the same time. If activated, the effect is valid independently from any other port settings. true: Activate forced Bi-directional IO buffer of the port pin. false: Deactivate forced Bi-directional IO buffer of the port pin.
          boolean PortIpControl: set at post-build, origin=Renesas_v1.0.0, default-value=false  # This parameter is used to enable/disable the direct IO control of port pins direction true: Enables the direct IO control over port pins direction by the corresponding control signals from internal peripheral IPs. This register is valid only in Alternative Mode (PMC=1). false: Disables the direct IO control over port pins direction. PortIpControl should be set to True, when PortPinInitialMode is TSG31O5_ALT2_OUT.
          boolean PortPullUpOption: set at post-build, origin=Renesas_v1.0.0, default-value=false  # This register switches on or off the port pins pull-up resistor. true: Port pin's pull-up resistor is enabled. false: Port pin's pull-up resistor is disabled.
          boolean PortPullDownOption: set at post-build, origin=Renesas_v1.0.0, default-value=false  # This parameter switches on or off the port pins pull-down resistor. true: Port pin's pull-down resistor is enabled. false: Port pin's pull-down resistor is disabled.
          enumeration PortOpenDrainControl_Expansion: {OpenDrain_PushPull, OpenDrain_N_Channel, OpenDrain_P_Channel}, set at post-build, origin=Renesas_v1.0.0, default-value=OpenDrain_PushPull  # This parameter selects port pins output buffer function in combination of PODC and PODCE . | OpenDrain_PushPull Specifies the OpenDrain_PushPull open drain type output circuit characteristics and updates both PODC and PODCE registers as 0 0 respectively. OpenDrain_N_Channel specifies the N-ch open drain type output circuit characteristics and updates the PODC and PODCE registers as 1 0 respectively. OpenDrain_P_Channel specifies the P-ch open drain type output circuit characteristics and updates the PODC and PODCE registers as 1 1 respectively.
          boolean PortOutputLevelInversion: set at post-build, origin=Renesas_v1.0.0, default-value=false  # This parameter specifies whether the output level from a pin is inverted or not.. true: Pin output level is inverted. false: Pin output level is not inverted.
          enumeration PortOutputDriveStrength: {SLOW, FAST, MIDDLE_0, MIDDLE_1}, set at post-build, origin=Renesas_v1.0.0, default-value=SLOW  # This parameter selects the port pins output drive strength as high strength or low strength type. This functionality is also referred to fast (high strength) and slow (low strength) behavior of output buffer. SLOW: Lower drive strength (slow mode) is selected for port pin's output buffer. FAST: Higher drive strength (fast mode) is selected for port pin's output buffer. MIDDLE_0: Lower drive strength (middle mode) is selected for port pin's output buffer. MIDDLE_1: Lower drive strength (middle mode) is selected for port pin's output buffer.
        container PortPin13  # This container contains the configuration (parameters) for Port Pin 11.
          boolean PortPinDirectionChangeable: set at post-build, origin=Renesas_v1.0.0, default-value=false  # Parameter to indicate if the direction is changeable on a port pin during runtime. true: Port Pin direction changeable enabled. false: Port Pin direction changeable disabled.
          boolean PortPinDioAltModeChangeable: set at post-build, origin=Renesas_v1.0.0, default-value=false  # Parameter to indicate if the mode of a port pin is changeable between DIO and Alternate during runtime by API functions Port_SetToDioMode and Port_SetToAlternateMode. Including these APIs is controlled by PortSetToDioAltModeApi. true: Dio Alternate mode is changeable. false: Dio Alternate mode is not changeable.
          boolean PortPinModeChangeable: set at post-build, origin=Renesas_v1.0.0, default-value=false  # Parameter to indicate if the mode of a port pin is changeable during runtime by API function Port_SetPinMode. Including this API is controlled by PortSetPinModeApi. true: Port Pin mode is changeable. false: Port Pin mode is not changeable.
          enumeration PortPinLevelValue: {PORT_PIN_LEVEL_LOW, PORT_PIN_LEVEL_HIGH}, set at post-build, origin=Renesas_v1.0.0, default-value=PORT_PIN_LEVEL_LOW  # Parameter to indicate port pin level value for a port pin. PORT_PIN_LEVEL_LOW: Port pin Level is low. PORT_PIN_LEVEL_HIGH: Port pin Level is high.
          enumeration PortPinInitialMode: {CSIH1RYI_ALT1_IN, TSG31O6_ALT2_OUT, RSCAN0TX1_ALT3_OUT, SCI30SCI_ALT4_IN, SCI30SCO_ALT4_OUT, TAUD1I10_ALT5_IN, CSIH0CSS1_ALT5_OUT, TAUD0O15_ALT6_OUT, DIO}, set at post-build, origin=Renesas_v1.0.0, default-value=DIO  # Mode of the port pin for use with Port_Init() function. <Input name>_ALT<Alternative instance>_IN: Provides alternative instance for selected input. <Output name>_ALT<Alternative instance>_OUT: Provides alternative instance for selected output.
          enumeration PortPinDirection: {PORT_PIN_OUT, PORT_PIN_IN}, set at post-build, origin=Renesas_v1.0.0, default-value=PORT_PIN_IN  # The initial direction of the pin (IN or OUT). If the direction is not changeable, the value configured here is fixed. The direction must match the pin mode. PORT_PIN_IN: Port pin direction set as input. PORT_PIN_OUT: Port pin direction set as output.
          boolean PortInputBufferControl: set at post-build, origin=Renesas_v1.0.0, default-value=false  # This parameter is used as one of the factors to enable/disable port pins input buffer in DIO Mode (PMC=0). true: Port pin's input buffer is ready to be enabled in DIO Mode. false: Port pin's input buffer is disabled in DIO Mode.
          boolean PortBiDirectionControl: set at post-build, origin=Renesas_v1.0.0, default-value=false  # This parameter forces port pins input buffer and output buffer at the same time. If activated, the effect is valid independently from any other port settings. true: Activate forced Bi-directional IO buffer of the port pin. false: Deactivate forced Bi-directional IO buffer of the port pin.
          boolean PortIpControl: set at post-build, origin=Renesas_v1.0.0, default-value=false  # This parameter is used to enable/disable the direct IO control of port pins direction true: Enables the direct IO control over port pins direction by the corresponding control signals from internal peripheral IPs. This register is valid only in Alternative Mode (PMC=1). false: Disables the direct IO control over port pins direction. PortIpControl should be set to True, when PortPinInitialMode is TSG31O6_ALT2_OUT.
          boolean PortPullUpOption: set at post-build, origin=Renesas_v1.0.0, default-value=false  # This register switches on or off the port pins pull-up resistor. true: Port pin's pull-up resistor is enabled. false: Port pin's pull-up resistor is disabled.
          boolean PortPullDownOption: set at post-build, origin=Renesas_v1.0.0, default-value=false  # This parameter switches on or off the port pins pull-down resistor. true: Port pin's pull-down resistor is enabled. false: Port pin's pull-down resistor is disabled.
          enumeration PortOpenDrainControl_Expansion: {OpenDrain_PushPull, OpenDrain_N_Channel, OpenDrain_P_Channel}, set at post-build, origin=Renesas_v1.0.0, default-value=OpenDrain_PushPull  # This parameter selects port pins output buffer function in combination of PODC and PODCE . | OpenDrain_PushPull Specifies the OpenDrain_PushPull open drain type output circuit characteristics and updates both PODC and PODCE registers as 0 0 respectively. OpenDrain_N_Channel specifies the N-ch open drain type output circuit characteristics and updates the PODC and PODCE registers as 1 0 respectively. OpenDrain_P_Channel specifies the P-ch open drain type output circuit characteristics and updates the PODC and PODCE registers as 1 1 respectively.
          boolean PortOutputLevelInversion: set at post-build, origin=Renesas_v1.0.0, default-value=false  # This parameter specifies whether the output level from a pin is inverted or not.. true: Pin output level is inverted. false: Pin output level is not inverted.
          enumeration PortOutputDriveStrength: {SLOW, FAST, MIDDLE_0, MIDDLE_1}, set at post-build, origin=Renesas_v1.0.0, default-value=SLOW  # This parameter selects the port pins output drive strength as high strength or low strength type. This functionality is also referred to fast (high strength) and slow (low strength) behavior of output buffer. SLOW: Lower drive strength (slow mode) is selected for port pin's output buffer. FAST: Higher drive strength (fast mode) is selected for port pin's output buffer. MIDDLE_0: Lower drive strength (middle mode) is selected for port pin's output buffer. MIDDLE_1: Lower drive strength (middle mode) is selected for port pin's output buffer.
        container PortPin14  # This container contains the configuration (parameters) for Port Pin 12.
          boolean PortPinDirectionChangeable: set at post-build, origin=Renesas_v1.0.0, default-value=false  # Parameter to indicate if the direction is changeable on a port pin during runtime. true: Port Pin direction changeable enabled. false: Port Pin direction changeable disabled.
          boolean PortPinDioAltModeChangeable: set at post-build, origin=Renesas_v1.0.0, default-value=false  # Parameter to indicate if the mode of a port pin is changeable between DIO and Alternate during runtime by API functions Port_SetToDioMode and Port_SetToAlternateMode. Including these APIs is controlled by PortSetToDioAltModeApi. true: Dio Alternate mode is changeable. false: Dio Alternate mode is not changeable.
          boolean PortPinModeChangeable: set at post-build, origin=Renesas_v1.0.0, default-value=false  # Parameter to indicate if the mode of a port pin is changeable during runtime by API function Port_SetPinMode. Including this API is controlled by PortSetPinModeApi. true: Port Pin mode is changeable. false: Port Pin mode is not changeable.
          enumeration PortPinLevelValue: {PORT_PIN_LEVEL_LOW, PORT_PIN_LEVEL_HIGH}, set at post-build, origin=Renesas_v1.0.0, default-value=PORT_PIN_LEVEL_LOW  # Parameter to indicate port pin level value for a port pin. PORT_PIN_LEVEL_LOW: Port pin Level is low. PORT_PIN_LEVEL_HIGH: Port pin Level is high.
          enumeration PortPinInitialMode: {CSIH1SI_ALT1_IN, TAPA0ESO_ALT2_IN, INTP7_ALT2_IN, TPB1O_ALT2_OUT, EXTCLK0O_ALT3_OUT, NMI_ALT4_IN, TSG31O7_ALT6_OUT, DIO}, set at post-build, origin=Renesas_v1.0.0, default-value=DIO  # Mode of the port pin for use with Port_Init() function. <Input name>_ALT<Alternative instance>_IN: Provides alternative instance for selected input. <Output name>_ALT<Alternative instance>_OUT: Provides alternative instance for selected output.
          enumeration PortPinDirection: {PORT_PIN_OUT, PORT_PIN_IN}, set at post-build, origin=Renesas_v1.0.0, default-value=PORT_PIN_IN  # The initial direction of the pin (IN or OUT). If the direction is not changeable, the value configured here is fixed. The direction must match the pin mode. PORT_PIN_IN: Port pin direction set as input. PORT_PIN_OUT: Port pin direction set as output.
          boolean PortInputBufferControl: set at post-build, origin=Renesas_v1.0.0, default-value=false  # This parameter is used as one of the factors to enable/disable port pins input buffer in DIO Mode (PMC=0). true: Port pin's input buffer is ready to be enabled in DIO Mode. false: Port pin's input buffer is disabled in DIO Mode.
          boolean PortBiDirectionControl: set at post-build, origin=Renesas_v1.0.0, default-value=false  # This parameter forces port pins input buffer and output buffer at the same time. If activated, the effect is valid independently from any other port settings. true: Activate forced Bi-directional IO buffer of the port pin. false: Deactivate forced Bi-directional IO buffer of the port pin.
          boolean PortPullUpOption: set at post-build, origin=Renesas_v1.0.0, default-value=false  # This register switches on or off the port pins pull-up resistor. true: Port pin's pull-up resistor is enabled. false: Port pin's pull-up resistor is disabled.
          boolean PortPullDownOption: set at post-build, origin=Renesas_v1.0.0, default-value=false  # This parameter switches on or off the port pins pull-down resistor. true: Port pin's pull-down resistor is enabled. false: Port pin's pull-down resistor is disabled.
          enumeration PortOpenDrainControl_Expansion: {OpenDrain_PushPull, OpenDrain_N_Channel, OpenDrain_P_Channel}, set at post-build, origin=Renesas_v1.0.0, default-value=OpenDrain_PushPull  # This parameter selects port pins output buffer function in combination of PODC and PODCE . | OpenDrain_PushPull Specifies the OpenDrain_PushPull open drain type output circuit characteristics and updates both PODC and PODCE registers as 0 0 respectively. OpenDrain_N_Channel specifies the N-ch open drain type output circuit characteristics and updates the PODC and PODCE registers as 1 0 respectively. OpenDrain_P_Channel specifies the P-ch open drain type output circuit characteristics and updates the PODC and PODCE registers as 1 1 respectively.
          boolean PortOutputLevelInversion: set at post-build, origin=Renesas_v1.0.0, default-value=false  # This parameter specifies whether the output level from a pin is inverted or not.. true: Pin output level is inverted. false: Pin output level is not inverted.
          enumeration PortOutputDriveStrength: {SLOW, FAST, MIDDLE_0, MIDDLE_1}, set at post-build, origin=Renesas_v1.0.0, default-value=SLOW  # This parameter selects the port pins output drive strength as high strength or low strength type. This functionality is also referred to fast (high strength) and slow (low strength) behavior of output buffer. SLOW: Lower drive strength (slow mode) is selected for port pin's output buffer. FAST: Higher drive strength (fast mode) is selected for port pin's output buffer. MIDDLE_0: Lower drive strength (middle mode) is selected for port pin's output buffer. MIDDLE_1: Lower drive strength (middle mode) is selected for port pin's output buffer.
          enumeration PortInputSelection: {TYPE_1_SUPP_PISA, TYPE_2_SUPP_PISA}, set at post-build, origin=Renesas_v1.0.3, default-value=TYPE_1_SUPP_PISA  # This setting specifies the input buffer characteristics. TYPE_1_SUPP_PISA: TYPE 1 buffer is selected. TYPE_2_SUPP_PISA: TYPE 2 buffer is selected.
