AUTOSAR XML (schema 4-0-3)
package /Nexteer/PortInterfaces
  client server interface ChkForStrtUpTest_PortIf1
    operation Oper
      arg ExecStrtUpTest_Arg: type=boolean, direction=OUT
  client server interface SetNtcSts_PortIf1
    operation Oper: possible-error=E_NOT_OK
      4 x arg, all with direction=IN:
        NtcNr_Arg: type=NtcNr1
        NtcStInfo_Arg: type=uint8
        NtcSts_Arg: type=NtcSts1
        DebStep_Arg: type=uint16
    error E_NOT_OK: error-code=1
