AUTOSAR XML (schema 4-0-3)
standard types defined: float32_DataConstr, float64_DataConstr, sint16_DataConstr, sint32_DataConstr, sint8_DataConstr, uint16_DataConstr, uint32_DataConstr, uint8_DataConstr, boolean, float32, float64, sint16, sint32, sint8, uint16, uint32, uint8
package /Nexteer/DataTypes
  impl type GmFctDiArbnSts1: compu {0=GMFCTDIARBNSTS_WAIT, 1=GMFCTDIARBNSTS_INPROC, 2=GMFCTDIARBNSTS_PASSD, 3=GMFCTDIARBNSTS_SWBASDMTGTNFAIL, 4=GMFCTDIARBNSTS_TIMEOUTFAIL}, implementation-data-type=uint8, type-emitter=RTE
  impl type LoaSt1: compu {0=LOAST_NORM, 1=LOAST_LIMD, 2=LOAST_SWBASDMTGTN, 3=LOAST_FADEOUT, 4=LOAST_CTRLDSHTDWNREQD, 5=LOAST_IMDTSHTDWNREQD}, implementation-data-type=uint8, type-emitter=RTE
