AUTOSAR XML (schema 4-0-3)
standard types defined: float32_DataConstr, float64_DataConstr, sint16_DataConstr, sint32_DataConstr, sint8_DataConstr, uint16_DataConstr, uint32_DataConstr, uint8_DataConstr, boolean, float32, sint16, sint32, sint8, uint16, uint32, uint8
package /Nexteer/DataTypes
  6 x impl type, all with category=TYPE_REFERENCE, type-emitter=RTE:
    NtcNr1: compu {1..511=NTCNR_0X001..NTCNR_0X1FF}, implementation-data-type=uint16
    NtcSts1: compu {0=NTCSTS_PASSD, 1=NTCSTS_FAILD, 2=NTCSTS_PREPASSD, 3=NTCSTS_PREFAILD}, implementation-data-type=uint8
    SigQlfr1: compu {0=SIGQLFR_NORES, 1=SIGQLFR_PASSD, 2=SIGQLFR_FAILD}, implementation-data-type=uint8
    StHlthMonSig3: compu {0=STHLTHMONSIG_ECUTFILTD, 1=STHLTHMONSIG_ASSIDUETOVLTG, 2=STHLTHMONSIG_DIGTQSNSRA, 3=STHLTHMONSIG_DIGTQSNSRB, 4=STHLTHMONSIG_DIGTQIDPTSIG, 5=STHLTHMONSIG_DUTYCYC, 6=STHLTHMONSIG_EOTIMPCT, 7=STHLTHMONSIG_MOTPOS, 8=STHLTHMONSIG_MOTPOSABDIFF, 9=STHLTHMONSIG_MOTPOSACDIFF, 10=STHLTHMONSIG_MOTPOSBCDIFF, 11=STHLTHMONSIG_CURRMOTSUMABC, 12=STHLTHMONSIG_CURRMOTSUMDEF, 13=STHLTHMONSIG_MOTPOSPHASEA, 14=STHLTHMONSIG_MOTPOSPHASEB, 15=STHLTHMONSIG_MOTPOSPHASEC, 16=STHLTHMONSIG_MOTPOSPHASED, 17=STHLTHMONSIG_MOTPOSPHASEE, 18=STHLTHMONSIG_MOTPOSPHASEF, 19=STHLTHMONSIG_BITCORRN, 20=STHLTHMONSIG_FRICESTIMN, 21=STHLTHMONSIG_WHLIMBREJCTN}, implementation-data-type=uint8
    SysFricLrngOperMod1: compu {0=SYSFRICLRNGOPERMOD_CALIBRATION, 1=SYSFRICLRNGOPERMOD_NORMAL, 2=SYSFRICLRNGOPERMOD_CLEAR, 3=SYSFRICLRNGOPERMOD_IDLE, 4=SYSFRICLRNGOPERMOD_BASELINE}, implementation-data-type=uint8
    u0p16: implementation-data-type=uint16
