AUTOSAR XML (schema 4-0-3)
package /Nexteer/Calibrations
  7 x parameter interface:
    boolean_CalPortIf1
      parameter data prototype Logl: sw-calibration-access=READ-WRITE, type=boolean
    float32_CalPortIf1
      parameter data prototype Val: sw-calibration-access=READ-WRITE, type=float32
    Logl1
      parameter data prototype Logl: sw-calibration-access=READ-WRITE, type=Logl1
    R1
      parameter data prototype Val: sw-calibration-access=READ-WRITE, type=R1
    Rate1
      parameter data prototype Val: sw-calibration-access=READ-WRITE, type=Rate3
    Uls2
      parameter data prototype Val: sw-calibration-access=READ-WRITE, type=Uls7
    Uls3
      parameter data prototype Val: sw-calibration-access=READ-WRITE, type=Uls9
