AUTOSAR XML (schema 4-0-3)
# COPYRIGHT
# Copyright(c) 2014-2016 Renesas Electronics Corporation
package /Renesas/EcucDefs_Dio
  ecuc definition collection RenesasParameterDefinition_Dio: module=Dio
  module definition Dio: refined-module-def=Dio, variants post-build  # Configuration of the DIO (Digital IO) module.
    container DioGeneral  # This container contains general DIO module configuration parameters.
      boolean DioDevErrorDetect: set at pre-compile, default-value=false  # This parameter switches the Development Error Detection and Notification ON or OFF. | true: Development Error Detection and Notification is enabled. false: Development Error Detection and Notification is disabled.
      boolean DioMaskedWritePortApi: set at pre-compile, origin=Renesas_v1.0.0, default-value=false  # Adds / removes the service Dio_MaskedWritePort() from the code. true: Adds the service Dio_MaskedWritePort() to the code. false: Removes the service Dio_MaskedWritePort() to the code.
      boolean DioFlipChannelApi: set at pre-compile, default-value=false  # This parameter adds / removes the service Dio_FlipChannel() from the code. | true: The service Dio_FlipChannel() from the code is added. false: The service Dio_FlipChannel() from the code is removed.
      boolean DioVersionInfoApi: set at pre-compile, default-value=false  # Adds / removes the service Dio_GetVersionInfo() from the code. | true: The service Dio_GetVersionInfo() from the code is added. false: The service Dio_GetVersionInfo() from the code is removed.
      boolean DioVersionCheckExternalModules: set at pre-compile, origin=Renesas_v1.0.0, default-value=true  # Enable / disable AUTOSAR Version check for inter-module dependencies. | true: AUTOSAR Version check for inter-module dependencies is enabled. false: AUTOSAR Version check for inter-module dependencies is disabled.
      boolean DioCriticalSectionProtection: set at pre-compile, origin=Renesas_v1.0.2, default-value=true  # This parameter specifies if the DIO driver CPU load can be reduced by disabling the enter/exit critical section functionality by adding a precompiled configuration parameter to the DIO driver configuration. | true: Enables the critical section functionality for the restricted area. false: Disables the critical section functionality for the restricted area.
      enumeration DioDeviceName: {R7F701304, R7F701305, R7F701312, R7F701313, R7F701320, R7F701321}, set at pre-compile, origin=Renesas_v1.0.0, default-value=R7F701312  # This parameter contains the supported device name to identify the device specific C header file through Translation XML File. | R7F701304, R7F701305, R7F701312, R7F701313, R7F701320 or R7F701321: This value should be child tag of TRANSLATION-FILE-PATH and DEVICE-FILE-PATH tag in Translation XML File.
      enumeration DioWriteVerify: {WV_DISABLE, WV_INIT_RUNTIME}, set at pre-compile, origin=Renesas_v1.0.5, default-value=WV_DISABLE  # This parameter enables selection and support of INIT_RUNTIME register read-back functionality of FACI and ECC registers. | WV_INIT_RUNTIME: Enable write verify for the selected peripheral/module for initialize and all other APIs. WV_DISABLE: Disable write verify feature.
      boolean DioUseWriteVerifyErrorInterface: set at pre-compile, origin=Renesas_v1.0.5, default-value=false  # This parameter specifies whether user can configure error notification interface instead of DEM error for Write-Verify functionality. | true: User can configure error notification interface via DioWriteVerifyErrorInterface parameter. false: Error notification for Write-Verify functionality shall be handled via DEM error.
      function name DioWriteVerifyErrorInterface [0..1]: set at post-build, origin=Renesas_v1.0.5, default-value=NULL, regular-expression=[a-zA-Z][a-zA-Z0-9_]*  # This parameter is used to configure the name of the error notification which shall be called with the ApiID and ErrorId when there is a Write Verify error.
    container DioConfig: multiple-configuration-container=true  # This container contains the configuration parameters and sub containers of the AUTOSAR DIO module. This container is a multiple configuration container, i.e. this container and its sub-containers exist once per configuration set.
      container DioPort [1..7]  # Configuration of individual DIO ports, consisting of channels and possible channel groups. | Note that this container definition does not explicitly define a symbolic name parameter. Instead, the container's short name will be used in the ECU Configuration Description to specify the symbolic name of the port.
        integer DioPortId: 0..4294967295, set at post-build, symbolic-name-value=true, default-value=0  # Numeric identifier of the DIO port. Not all MCU ports may be used for DIO, thus there may be "gaps" in the list of all IDs. This parameter is not used for implementation as new vendor specific parameter DioPortName is added to simplify configuration generation. | This value will be assigned to the DIO port symbolic name (i.e. the SHORT-NAME of the DioPort container).
        enumeration DioPortName: {PORTGROUP_0_BITS_0_TO_14, PORTGROUP_1_BITS_1_TO_4, PORTGROUP_2_BITS_0_TO_9, PORTGROUP_3_BITS_3_TO_14, PORTGROUP_4_BITS_0_TO_6, PORTGROUP_5_BITS_0_TO_15, PORTGROUPJTAG_0_BITS_0_TO_5}, set at post-build, origin=Renesas_v1.0.0, default-value=PORTGROUP_0_BITS_0_TO_14  # This parameter specifies the DIO port group for a DIO port. | This parameter contains the literals in "PORTGROUP_'Group Id'_BITS_'Start Bit'_TO_'End Bit'" format for numeric and alphanumeric port groups. E.g. PORTGROUP_0_BITS_0_TO_9 in case of port group 0, PORTGROUP_AL_BITS_0_TO_15 in case of port group AL. In case of JTAG related port group, this parameter contains the literal in "PORTGROUPJTAG_'Group Id'_BITS_'Start Bit'_TO_'End Bit'" format.
        container DioChannel [0..16]  # Configuration of an individual DIO channel. Besides a HW specific channel name which is typically fixed for a specific micro controller, additional symbolic names can be defined per channel. | Note that this container definition does not explicitly define a symbolic name parameter. Instead, the container's short name will be used in the ECU Configuration Description to specify the symbolic name of the channel.
          integer DioChannelId: 0..4294967295, set at post-build, symbolic-name-value=true, default-value=0  # Channel Id of the DIO channel. This value will be assigned to the symbolic names. This parameter is not used for implementation as new vendor specific parameter DioChannelBitPosition is added to simplify configuration generation.
          integer DioChannelBitPosition: 0..15, set at post-build, origin=Renesas_v1.0.0, default-value=0  # This parameter contains channel bit position of the DIO channel. | Note: Value of the parameter DioChannelBitPosition should be unique and must belong to the particular DIO port group selected for DioPortName parameter. Please refer the 'Start Bit' and 'End Bit' for the selected value of DioPortName parameter for possible valid values. The list of unavailable port pin for following port group is as follows: Port group 0: Pin 3, 4, 5, 6, 7, 8, 9, 11, 12 and 14 Port group 5: Pin 2, 3, 11, 12, 13 and 15 Hence for following DioPortName value: PORTGROUP_0_BITS_0_TO_14: Value of DioChannelBitPosition as 3, 4, 5, 6, 7, 8, 9, 11, 12 and 14 should not be configured. PORTGROUP_5_BITS_0_TO_15: Value of DioChannelBitPosition as 2, 3, 11, 12, 13 and 15 should not be configured.
        container DioChannelGroup [0..120]  # Definition and configuration of DIO channel groups. A channel group represents several adjoining DIO channels represented by a logical group. | Note that this container definition does not explicitly define a symbolic name parameter. Instead, the container's short name will be used in the ECU Configuration Description to specify the symbolic name of the channel group.
          string DioChannelGroupIdentification: set at pre-compile, symbolic-name-value=true, default-value=NULL, regular-expression=[a-zA-Z][a-zA-Z0-9_]*  # The DIO channel group is identified in DIO API by a pointer to a data structure (of type Dio_ChannelGroupType). That data structure contains the channel group information. This parameter is not used for implementation as new vendor specific parameters DioPortMask and DioPortOffset are added to simplify configuration generation to support channel group access. | This parameter contains the code fragment that has to be inserted in the API call of the calling module to get the address of the variable in memory which holds the channel group information. Example values are "&MyDioGroup1" or "&MyDioGroupArray[0]". This parameter is not used for implementation.
          integer DioPortMask: 0..65535, set at post-build, default-value=0  # This shall be the mask which defines the positions of the channel group. | The channels shall consist of adjoining bits in the same port. The data type depends on the port width.
          integer DioPortOffset: 0..15, set at post-build, default-value=0  # The position of the Channel Group on the port, counted from the LSB. This value can be derived from DioPortMask. | calculationFormula = Position of the first bit of DioPortMask which is set to '1' counted from LSB.
    container DioDemEventParameterRefs  # Container for the references to DemEventParameter elements which shall be invoked using the API Dem_ReportErrorStatus API in case the corresponding error occurs. The EventId is taken from the referenced DemEventParameter's DemEventId value. The standardized errors are provided in the container and can be extended by vendor specific error references.
      symbolic name reference DIO_E_REG_WRITE_VERIFY [0..1]: set at pre-compile, origin=Renesas_v1.0.5, destination=DemEventParameter  # Reference to the DemEventParameter which shall be issued when the error "Dio register write verification failed (HW)" has occurred.
