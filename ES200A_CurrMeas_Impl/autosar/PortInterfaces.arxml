AUTOSAR XML (schema 4-0-3)
package /Nexteer/Calibrations
  4 x parameter interface:
    float32_CalPortIf1
      parameter data prototype Val: sw-calibration-access=READ-WRITE, type=float32
    uint16_CalPortIf1
      parameter data prototype Val: sw-calibration-access=READ-WRITE, type=uint16
    uint32_CalPortIf1
      parameter data prototype Val: sw-calibration-access=READ-WRITE, type=uint32
    uint8_CalPortIf1
      parameter data prototype Val: sw-calibration-access=READ-WRITE, type=uint8
package /Nexteer/NvMProxy_swc/Interfaces
  client server interface NvMService_AC3_SRBS_Defs: is-service=true
    7 x operation, all with possible-error=NvMService_AC3_SRBS_Defs/E_NOT_OK:
      EraseBlock
      GetErrorStatus
        arg ErrorStatus: type=NvM_RequestResultType, direction=OUT
      InvalidateNvBlock
      ReadBlock
        arg DstPtr: type=dtRef_VOID, direction=IN
      RestoreBlockDefaults
        arg DstPtr: type=dtRef_VOID, direction=IN
      SetRamBlockStatus
        arg RamBlockStatus: type=Boolean, direction=IN
      WriteBlock
        arg SrcPtr: type=dtRef_const_VOID, direction=IN
    error E_NOT_OK: error-code=1
package /Nexteer/PortInterfaces
  10 x client server interface:
    CurrMeasEolGainReq_PortIf1
      operation Oper
    CurrMeasEolGainStReq_PortIf1
      operation Oper
        arg CurrMeasEolGainSt_Arg: type=uint8, direction=OUT
    CurrMeasEolOffsReq_PortIf1
      operation Oper
    CurrMeasEolOffsStReq_PortIf1
      operation Oper
        arg CurrMeasEolOffsSt_Arg: type=uint8, direction=OUT
    CurrMeasGainReadReq_PortIf1
      operation Oper
        6 x arg, all with type=float32, direction=OUT:
          CurrMeasMotCurrGainA_Arg
          CurrMeasMotCurrGainB_Arg
          CurrMeasMotCurrGainC_Arg
          CurrMeasMotCurrGainD_Arg
          CurrMeasMotCurrGainE_Arg
          CurrMeasMotCurrGainF_Arg
    CurrMeasGainWrReq_PortIf2
      operation Oper
        7 x arg:
          CurrMeasMotCurrGainA_Arg: type=float32, direction=IN
          CurrMeasMotCurrGainB_Arg: type=float32, direction=IN
          CurrMeasMotCurrGainC_Arg: type=float32, direction=IN
          CurrMeasMotCurrGainD_Arg: type=float32, direction=IN
          CurrMeasMotCurrGainE_Arg: type=float32, direction=IN
          CurrMeasMotCurrGainF_Arg: type=float32, direction=IN
          CurrMeasGainWrReqSts_Arg: type=uint8, direction=OUT
    CurrMeasOffsReadReq_PortIf2
      operation Oper
        13 x arg, all with type=float32, direction=OUT:
          CurrMeasEolOffsHiBrdgVltg_Arg
          CurrMeasMotCurrOffsDifA_Arg
          CurrMeasMotCurrOffsDifB_Arg
          CurrMeasMotCurrOffsDifC_Arg
          CurrMeasMotCurrOffsDifD_Arg
          CurrMeasMotCurrOffsDifE_Arg
          CurrMeasMotCurrOffsDifF_Arg
          CurrMeasMotCurrOffsLoAvrgA_Arg
          CurrMeasMotCurrOffsLoAvrgB_Arg
          CurrMeasMotCurrOffsLoAvrgC_Arg
          CurrMeasMotCurrOffsLoAvrgD_Arg
          CurrMeasMotCurrOffsLoAvrgE_Arg
          CurrMeasMotCurrOffsLoAvrgF_Arg
    CurrMeasOffsWrReq_PortIf3
      operation Oper
        14 x arg:
          CurrMeasEolOffsHiBrdgVltg_Arg: type=float32, direction=IN
          CurrMeasMotCurrOffsDifA_Arg: type=float32, direction=IN
          CurrMeasMotCurrOffsDifB_Arg: type=float32, direction=IN
          CurrMeasMotCurrOffsDifC_Arg: type=float32, direction=IN
          CurrMeasMotCurrOffsDifD_Arg: type=float32, direction=IN
          CurrMeasMotCurrOffsDifE_Arg: type=float32, direction=IN
          CurrMeasMotCurrOffsDifF_Arg: type=float32, direction=IN
          CurrMeasMotCurrOffsLoAvrgA_Arg: type=float32, direction=IN
          CurrMeasMotCurrOffsLoAvrgB_Arg: type=float32, direction=IN
          CurrMeasMotCurrOffsLoAvrgC_Arg: type=float32, direction=IN
          CurrMeasMotCurrOffsLoAvrgD_Arg: type=float32, direction=IN
          CurrMeasMotCurrOffsLoAvrgE_Arg: type=float32, direction=IN
          CurrMeasMotCurrOffsLoAvrgF_Arg: type=float32, direction=IN
          CurrMeasOffsWrReqSts_Arg: type=uint8, direction=OUT
    GetNtcQlfrSts_PortIf1
      operation Oper: possible-error=GetNtcQlfrSts_PortIf1/E_NOT_OK
        arg NtcNr_Arg: type=NtcNr1, direction=IN
        arg NtcQlfr_Arg: type=SigQlfr1, direction=OUT
      error E_NOT_OK: error-code=1
    SetNtcSts_PortIf1
      operation Oper: possible-error=SetNtcSts_PortIf1/E_NOT_OK
        4 x arg, all with direction=IN:
          NtcNr_Arg: type=NtcNr1
          NtcStInfo_Arg: type=uint8
          NtcSts_Arg: type=NtcSts1
          DebStep_Arg: type=uint16
      error E_NOT_OK: error-code=1
  7 x sender receiver interface:
    boolean_PortIf1: invalidation-policy{data-element=Logl, handle-invalid=DONT-INVALIDATE}
      data Logl: sw-calibration-access=READ-ONLY, type=boolean
    float32_PortIf1: invalidation-policy{data-element=float32_PortIf1/Val, handle-invalid=DONT-INVALIDATE}
      data Val: sw-calibration-access=READ-ONLY, type=float32
    MotCurrEolCalSt_PortIf1: invalidation-policy{data-element=MotCurrEolCalSt_PortIf1/Val, handle-invalid=DONT-INVALIDATE}
      data Val: sw-calibration-access=READ-ONLY, type=MotCurrEolCalSt2
    SigQlfr_PortIf1: invalidation-policy{data-element=SigQlfr_PortIf1/Val, handle-invalid=DONT-INVALIDATE}
      data Val: sw-calibration-access=READ-ONLY, type=SigQlfr1
    SysSt1_PortIf1: invalidation-policy{data-element=SysSt1_PortIf1/Val, handle-invalid=DONT-INVALIDATE}
      data Val: sw-calibration-access=READ-ONLY, type=SysSt1
    uint16_PortIf1: invalidation-policy{data-element=uint16_PortIf1/Val, handle-invalid=DONT-INVALIDATE}
      data Val: sw-calibration-access=READ-ONLY, type=uint16
    uint8_PortIf1: invalidation-policy{data-element=uint8_PortIf1/Val, handle-invalid=DONT-INVALIDATE}
      data Val: sw-calibration-access=READ-ONLY, type=uint8
