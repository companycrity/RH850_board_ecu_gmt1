AUTOSAR XML (schema 4-0-3)
standard types defined: float32_DataConstr, float64_DataConstr, sint16_DataConstr, sint32_DataConstr, sint8_DataConstr, uint16_DataConstr, uint32_DataConstr, uint8_DataConstr, boolean, float32, float64, sint16, sint32, sint8, uint16, uint32, uint8
package /Nexteer/DataTypes
  impl type HwAgTrajCmdSt1: compu {0=HWAGTRAJCMDST_WAIT, 1=HWAGTRAJCMDST_HWAGA, 2=HWAGTRAJCMDST_CONVEL, 3=HWAGTRAJCMDST_HWAGDECEL, 4=HWAGTRAJCMDST_HLD}, implementation-data-type=uint16, type-emitter=RTE
