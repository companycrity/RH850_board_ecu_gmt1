AUTOSAR XML (schema 4-0-3)
package /Nexteer/Calibrations
  parameter interface float32_CalPortIf1
    parameter data prototype Val: sw-calibration-access=READ-WRITE, type=float32
package /Nexteer/PortInterfaces
  client server interface SetTrajTarPrm_PortIf1
    operation Oper
      arg HwAgTrajGennHwAgTar_Arg: type=float32, direction=IN
      arg HwAgTrajGennHwVelTar_Arg: type=float32, direction=IN
      arg HwAgTrajGennHwATar_Arg: type=float32, direction=IN
  sender receiver interface boolean_PortIf1: invalidation-policy{data-element=Logl, handle-invalid=DONT-INVALIDATE}
    data Logl: sw-calibration-access=READ-ONLY, type=boolean
  sender receiver interface float32_PortIf1: invalidation-policy{data-element=Val, handle-invalid=DONT-INVALIDATE}
    data Val: sw-calibration-access=READ-ONLY, type=float32
