AUTOSAR XML (schema 4-0-3)
package /Nexteer/EcucDefs_SyncCrc
  ecuc definition collection NexteerParameterDefinition_SyncCrc: module=SyncCrc
  module definition SyncCrc [0..1]: category=VENDOR_SPECIFIC_MODULE_DEFINITION, refined-module-def=SyncCrc, variants pre-compile  # Settings for the synchronous CRC component
    container SyncCrcCommon  # Contains the common settings for SyncCrc.
      integer AvailableCRCHardwareUnits: 0..4, set at pre-compile, origin=NEXTEER, default-value=4  # Sets the number of CRC hardware units that are available to the application software components.
      enumeration AutosarWrapperEnable: {STD_OFF, STD_ON}, origin=NEXTEER, default-value=STD_OFF  # Sets the number of CRC hardware units that are available to the application software components.
      symbolic name reference CrcOsApplicationReference: destination=OsApplication  # CrC Os Application Reference | This defines the application in which the Crc component is integrated.
  bsw implementation SyncCrc_Impl: programming-language=C, sw-version=5.0.0, used-code-generator=cMICROSAR, vendor-id=30, ar-release-version=4.2.0, preconfigured-configuration=SyncCrc_Pre, recommended-configuration=SyncCrc_Rec, vendor-specific-module-def=SyncCrc
  module config SyncCrc_Pre: definition=SyncCrc
    SyncCrcCommon: AvailableCRCHardwareUnits=4
  module config SyncCrc_Rec: definition=SyncCrc
