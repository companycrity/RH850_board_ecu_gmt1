AUTOSAR XML (schema 4-0-3)
standard types defined: float32_DataConstr, float64_DataConstr, sint16_DataConstr, sint32_DataConstr, sint8_DataConstr, uint16_DataConstr, uint32_DataConstr, uint8_DataConstr, boolean, float32, float64, sint16, sint32, sint8, uint16, uint32, uint8, Boolean, dtRef_const_VOID, dtRef_VOID
package /Nexteer/DataTypes
  10 x impl type:
    Ary1D_f32_3: category=ARRAY, sw-calibration-access=READ-ONLY, type-emitter=RTE
      element Element: array-size=3, array-size-semantics=FIXED-SIZE, implementation-data-type=float32
    Ary1D_f32_72: category=ARRAY, sw-calibration-access=READ-ONLY, type-emitter=RTE
      element Element: array-size=72, array-size-semantics=FIXED-SIZE, implementation-data-type=float32
    Ary2D_f32_3_3: category=ARRAY, sw-calibration-access=READ-ONLY, type-emitter=RTE
      element Element: array-size=3, array-size-semantics=FIXED-SIZE, implementation-data-type=Ary1D_f32_3
    FilLpRec1: category=STRUCTURE, sw-calibration-access=READ-ONLY, type-emitter=NxtrFil
      element FilSt: implementation-data-type=float32
      element FilGain: implementation-data-type=float32
      symbol props FilLpRec1
    s10p5: implementation-data-type=sint16, type-emitter=RTE
    s11p4: implementation-data-type=sint16, type-emitter=RTE
    s3p12: implementation-data-type=sint16, type-emitter=RTE
    s5p10: implementation-data-type=sint16, type-emitter=RTE
    s6p9: implementation-data-type=sint16, type-emitter=RTE
    SnsrLrndOffsRec1: category=STRUCTURE, sw-calibration-access=READ-ONLY, type-emitter=RTE
      15 x element, all with category=TYPE_REFERENCE:
        HwAgLrndTi: implementation-data-type=float32
        YawRateElpdTi: implementation-data-type=float32
        HwTqLrngCovariMtrx: implementation-data-type=Ary2D_f32_3_3
        HwTqLrngEstimnVect: implementation-data-type=Ary1D_f32_3
        YawRateOffs: implementation-data-type=s6p9
        HwAgOffs: implementation-data-type=s5p10
        HwTqOffs: implementation-data-type=s3p12
        HwAgLrngYawOffsRef: implementation-data-type=s6p9
        HwAgLrngHwAgFilSt: implementation-data-type=s11p4
        HwAgLrngSysTqFilSt: implementation-data-type=s10p5
        HwTqLrngHwAgRef: implementation-data-type=s11p4
        HwTqLrngSampleCntNeg: implementation-data-type=uint16
        HwTqLrngSampleCntPos: implementation-data-type=uint16
        HwTqLrngSts: implementation-data-type=uint8
        YawRateOffsVld: implementation-data-type=boolean
package /Nexteer/NvMProxy_swc/DataTypes
  impl type NvM_RequestResultType: category=VALUE, base-type=NvM_RequestResultType, compu {0=NVM_REQ_OK, 1=NVM_REQ_NOT_OK, 2=NVM_REQ_PENDING, 3=NVM_REQ_INTEGRITY_FAILED, 4=NVM_REQ_BLOCK_SKIPPED, 5=NVM_REQ_NV_INVALIDATED, 6=NVM_REQ_CANCELED, 7=NVM_REQ_REDUNDANCY_FAILED, 8=NVM_REQ_RESTORED_FROM_ROM}
package /Nexteer/NvMProxy_swc/DataTypes/BaseTypes
  base type NvM_RequestResultType: category=FIXED_LENGTH, base-type-size=8, base-type-encoding=NONE, native-declaration=uint8
