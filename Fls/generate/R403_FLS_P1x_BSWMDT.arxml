AUTOSAR XML (schema 4-0-3)
# COPYRIGHT
# Copyright(c) 2013-2015 Renesas Electronics Corporation
package /Renesas/EcucDefs_Fls
  bsw implementation Fls_Impl: programming-language=C, sw-version=1.3.1, vendor-id=59, ar-release-version=4.0.3, behavior=BswInternalBehavior_0, vendor-api-infix=Renesas, vendor-specific-module-def=Fls
  bsw module description Fls: module-id=92
    bsw internal behavior BswInternalBehavior_0
      exclusive area DRIVERSTATE_DATA_PROTECTION
      bsw interrupt entity BswInterruptEntity_0: implemented-entry=FLS_FLENDNM_ISR, interrupt-category=CAT-1, interrupt-source=INTFLENDNM
      bsw interrupt entity BswInterruptEntity_1: implemented-entry=FLS_FLENDNM_CAT2_ISR, interrupt-category=CAT-2, interrupt-source=INTFLENDNM
      bsw schedulable entity BswSchedulableEntity_0: minimum-start-interval=0.00000085, implemented-entry=Fls_MainFunction
  bsw module entry Fls_MainFunction: service-id=11, call-type=SCHEDULED, execution-context=TASK, sw-service-impl-policy=STANDARD
  bsw module entry FLS_FLENDNM_ISR: is-reentrant=false, is-synchronous=false, call-type=INTERRUPT, execution-context=INTERRUPT-CAT-1, sw-service-impl-policy=STANDARD
  bsw module entry FLS_FLENDNM_CAT2_ISR: is-reentrant=false, is-synchronous=false, call-type=INTERRUPT, execution-context=INTERRUPT-CAT-2, sw-service-impl-policy=STANDARD
