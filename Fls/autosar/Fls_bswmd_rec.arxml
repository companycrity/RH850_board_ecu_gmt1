AUTOSAR XML (schema 4-0-3)
package /Renesas/EcucDefs_Fls
  module config Fls_Rec: definition=Fls
  bsw implementation Fls_Impl: programming-language=C, behavior=FlsBehavior, recommended-configuration=Fls_Rec, vendor-specific-module-def=Fls
