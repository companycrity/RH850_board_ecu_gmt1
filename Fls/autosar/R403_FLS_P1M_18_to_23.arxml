AUTOSAR XML (schema 4-0-3)
# COPYRIGHT
# Copyright(c) 2014-2015 Renesas Electronics Corporation
package /Renesas/EcucDefs_Fls
  ecuc definition collection RenesasParameterDefinition_Fls: module=Fls
  module definition Fls: refined-module-def=Fls, variants post-build  # Configuration of the Fls (internal or external flash driver) module.
    container FlsGeneral  # Container for general parameters of the flash driver. These parameters are always pre-compile.
      boolean FlsDevErrorDetect: set at pre-compile, default-value=false  # This parameter is used to enable and disable development error detection. | true: Development error detection enabled. false: Development error detection disabled.
      enumeration FlsAccess: {FLS_DATAFLASH_ACCESS, FLS_CODEFLASH_ACCESS, FLS_DATA_CODE_FLASH_ACCESS}, set at pre-compile, origin=Renesas_v1.0.0, default-value=FLS_DATAFLASH_ACCESS  # This parameter specifies the FLS shall support either the Data flash, Code flash or both Data and Code Flash. If the user configures this parameter as "FLS_DATAFLASH_ACCESS", then user should configure "FLS_DF_SECTOR" in FlsSector container. If the user configures this parameter as "FLS_CODEFLASH_ACCESS", then user should configure both "FLS_CF_SMALL_BLK_SECTOR" and "FLS_CF_NORMAL_BLK_SECTOR" in FlsSector container. If the user configures this parameter as "FLS_DATA_CODE_FLASH_ACCESS", then user should configure "FLS_DF_SECTOR", "FLS_CF_SMALL_BLK_SECTOR" and "FLS_CF_NORMAL_BLK_SECTOR" in FlsSector container. | FLS_DATAFLASH_ACCESS: enables the Data Flash. FLS_CODEFLASH_ACCESS: enables the Code Flash. FLS_DATA_CODE_FLASH_ACCESS: enables the both Data Flash and Code Flash.
      boolean FlsAcLoadOnJobStart: set at pre-compile, default-value=false  # This parameter specifies the flash driver shall load the flash access code to RAM whenever an erase or write job is started and unload (overwrite) it after that job has been finished or cancelled. This parameter is not used for the implementation. | true: Flash access code loaded on job start / unloaded on job end or error. false: Flash access code not loaded to / unloaded from RAM at all.
      boolean FlsCancelApi: set at pre-compile, default-value=false  # This parameter is used to enable and disable the Fls_Cancel function. | true: API supported / function is provided. false: API supported / function not provided.
      boolean FlsCompareApi: set at pre-compile, default-value=false  # This parameter is used to enable and disable the Fls_Compare function. | true: API supported / function is provided. false: API supported / function not provided.
      integer FlsDriverIndex: 0..254, set at pre-compile, symbolic-name-value=true, default-value=0  # This parameter specifies index of the driver, used by FEE. This parameter is not used for implementation.
      boolean FlsGetJobResultApi: set at pre-compile, default-value=false  # This parameter is used to enable and disable the Fls_GetJobResult function. | true: API supported / function is provided. false: API supported / function not provided.
      boolean FlsGetStatusApi: set at pre-compile, default-value=false  # This parameter is used to enable and disable the Fls_GetStatus function. | true: API supported / function provided. false: API not supported / function not provided.
      boolean FlsSetModeApi: set at pre-compile, default-value=false  # This parameter is used to enable and disable the Fls_SetMode function. | true: API supported / function provided. false: API not supported / function not provided.
      boolean FlsUseInterrupts: set at pre-compile, default-value=false  # This parameter specifies job processing triggered by hardware interrupt. | true: Job processing triggered by interrupt (hardware controlled). false: Job processing not triggered by interrupt (software controlled).
      boolean FlsVersionInfoApi: set at pre-compile, default-value=false  # This parameter is used to enable / disable the API to read out the modules version information. | true: Version info API enabled. false: Version info API disabled.
      boolean FlsVersionCheckExternalModules: set at pre-compile, origin=Renesas_v1.0.0, default-value=true  # Enable / disable AUTOSAR Version check for inter-module dependencies. | true: AUTOSAR Version check for inter-module dependencies is enabled. false: AUTOSAR Version check for inter-module dependencies is disabled.
      boolean FlsCriticalSectionProtection: set at pre-compile, origin=Renesas_v1.0.0, default-value=true  # This parameter specifies if the FLS driver CPU load can be reduced by disabling the enter/exit critical section functionality by adding a precompiled configuration parameter to the FLS driver configuration. | true: Enables the critical section functionality for the restricted area. false: Disables the critical section functionality for the restricted area.
      integer FlsVirtualBoundaryAddress: 65536..65536, set at pre-compile, origin=Renesas_v1.0.0, default-value=65536  # This parameter specifies the virtual boundary address for Data Flash and CodeFlash. This parameter is used only for the validation purpose of virtual address range of Data Flash and Code Flash. | Virtual Address range for Data Flash: 0 - 65535(64K - 1). Virtual Address range for Code Flash Small Sector: 65536(64K) - 131071(64K + 64K - 1). Virtual Address range for Code Flash Normal Sector: 131072(64K + 64K) - 2162687(64K + 2MB - 1).
      enumeration FlsDeviceName: {R7F701318, R7F701319, R7F701320, R7F701321, R7F701322, R7F701323}, set at pre-compile, origin=Renesas_v1.0.0, default-value=R7F701323  # This parameter contains the supported device name to identify the device specific C header file through Translation XML File. | R7F701318, R7F701319, R7F701320, R7F701321, R7F701322 or R7F701323 : This value should be child tag of TRANSLATION-FILE-PATH and DEVICE-FILE-PATH tag in Translation XML File.
      integer FlsBaseAddress: 0..4294967295, set at pre-compile, default-value=0  # This parameter specifies the flash memory start address. This parameter is not used for implementation, since both data flash and code flash to be supported and the base address of data flash and code flash are not same. | Configure FlsCFSmallBlockBaseAddress, FlsCFNormalBlockBaseAddress or FlsDFBaseAddress instead of this parameter.
      integer FlsTotalSize: 64..2162688, set at pre-compile, default-value=64  # This parameter specifies the total amount of flash memory in bytes. The value of parameter should be configured as 64 to 65536 (64K), if the parameter FlsAccess in FlsGeneral container is configured as "FLS_DATAFLASH_ACCESS". It is calculated as (FlsNumberOfSectors * FlsSectorSize). The value of parameter should be configured as 2097152 (2MB), if the parameter FlsAccess in FlsGeneral container is configured as "FLS_CODEFLASH_ACCESS". The value of parameter should be configured as 2162688 (64K + 2MB), if the parameter FlsAccess in FlsGeneral container is configured as "FLS_DATA_CODE_FLASH_ACCESS". This parameter is not used for implementation but it may be referenced by upper layers. | Configure FlsCFTotalSize or FlsDFTotalSize instead of this parameter.
      boolean FlsTimeoutMonitoring: set at pre-compile, origin=Renesas_v1.0.0, default-value=false  # This Parameter compiles switch to enable or disable the FlsTimeout Supervision. true: This Parameter compiles switch to enable the FlsTimeout Supervision. false: This Parameter compiles switch to disable the FlsTimeout Supervision.
      container FlsDataFlash [0..1]  # This container contains the configuration parameters related for the Data Flash(FDL i.e. if the parameter FlsAccess in FlsGeneral container is configured as "FLS_DATAFLASH_ACCESS"). This container and its parameters should be configured, if the parameter FlsAccess in FlsGeneral container is configured as "FLS_DATAFLASH_ACCESS". This container and its parameters are not applicable, if the parameter FlsAccess in FlsGeneral container is configured as "FLS_CODEFLASH_ACCESS".
        enumeration FlsBlankCheck: {FDL_NOT_SUPPORTED, FDL_SUPPORTED}, set at pre-compile, origin=Renesas_v1.0.0, default-value=FDL_NOT_SUPPORTED  # This parameter if enabled, blank check function will be performed on whole block after Erase completion. This parameter is applicable only for Data flash. | FDL_NOT_SUPPORTED: Blank check is disabled. FDL_SUPPORTED: Blank check is enabled.
        integer FlsDFBaseAddress: 4280287232..4280287232, set at pre-compile, origin=Renesas_v1.0.0, default-value=4280287232  # This parameter specifies the data flash memory start address. This parameter is applicable only for Data flash.
        integer FlsDFBlockSize: 64..64, set at pre-compile, origin=Renesas_v1.0.0, default-value=64  # This parameter specifies the block size of data flash memory in bytes. This parameter is applicable only for Data flash.
        integer FlsDFTotalBlocks: 1024..1024, set at pre-compile, origin=Renesas_v1.0.0, default-value=1024  # This parameter specifies the total number of data flash blocks. There are 1024 64-Byte physical blocks in Data Flash. This parameter is applicable only for Data flash.
        function name FlsEccSedNotification [0..1]: set at post-build, origin=Renesas_v1.0.0, default-value=NULL, regular-expression=[a-zA-Z][a-zA-Z0-9_]*  # This parameter mapped to Single-bit error (SED) notification routine provided by some upper layer module.
        function name FlsEccDedNotification [0..1]: set at post-build, origin=Renesas_v1.0.0, default-value=NULL, regular-expression=[a-zA-Z][a-zA-Z0-9_]*  # This parameter mapped to Double-bit error (DED) notification routine provided by some upper layer module.
        integer FlsDFTotalSize: 65536..65536, set at pre-compile, origin=Renesas_v1.0.0, default-value=65536  # This parameter specifies the total amount of data flash memory in bytes. This parameter is applicable only for Data flash.
        boolean FlsBlankCheckApi: set at pre-compile, origin=Renesas_v1.1.0, default-value=false  # This parameter compiles switch to enable and disable the FlsBlankCheckApi function. | true: API supported / function is provided. false: API supported / function not provided.
        boolean FlsReadImmediateApi: set at pre-compile, origin=Renesas_v1.1.0, default-value=false  # This parameter compiles switch to enable and disable the FlsReadImmediateApi function. | true: API supported / function is provided. false: API supported / function not provided.
        boolean FlsSuspendApi: set at pre-compile, origin=Renesas_v1.1.0, default-value=false  # This parameter compiles switch to enable and disable the Fls_Suspend function. | true: API supported / function is provided. false: API supported / function not provided.
        boolean FlsResumeApi: set at pre-compile, origin=Renesas_v1.1.0, default-value=false  # This parameter compiles switch to enable and disable the Fls_Resume function. | true: API supported / function is provided. false: API supported / function not provided.
        reference FlsFdlCpuFrequency: set at pre-compile, origin=Renesas_v1.0.0, destination=McuClockSettingConfig  # Reference to the CPU subsystem frequency configuration, which is set in the MCU driver configuration. This reference from MCU informs the programming HW frequency to the programming Firmware. The clock value in MCU must be according to the clock supply setting of the CPU Subsystem. Please make sure to set the correct clock value in MCU configuration to avoid damage to the flash hardware.
      container FlsCodeFlash [0..1]  # This container contains the configuration parameters related for the Code Flash(FCL i.e. if the parameter FlsAccess in FlsGeneral container is configured as "FLS_CODEFLASH_ACCESS"). This container and its parameters should be configured, if the parameter FlsAccess in FlsGeneral container is configured as "FLS_CODEFLASH_ACCESS". This container and its parameters are not applicable, if the parameter FlsAccess in FlsGeneral container is configured as "FLS_DATAFLASH_ACCESS".
        integer FlsCFTotalSize: 2097152..2097152, set at pre-compile, origin=Renesas_v1.0.0, default-value=2097152  # This parameter specifies the total amount of code flash memory in bytes. This parameter is applicable only for Code flash.
        integer FlsCFSmallBlockBaseAddress: 0..0, set at pre-compile, origin=Renesas_v1.0.0, default-value=0  # This parameter specifies the code flash memory start address of small blocks. This parameter is applicable only for Code flash.
        integer FlsCFNormalBlockBaseAddress: 65536..65536, set at pre-compile, origin=Renesas_v1.0.0, default-value=65536  # This parameter specifies the code flash memory start address of normal blocks. This parameter is applicable only for Code flash.
        integer FlsCFSmallBlockSize: 8192..8192, set at pre-compile, origin=Renesas_v1.0.0, default-value=8192  # This parameter specifies the small block size of code flash memory in bytes. This parameter is applicable only for Code flash.
        integer FlsCFNormalBlockSize: 32768..32768, set at pre-compile, origin=Renesas_v1.0.0, default-value=32768  # This parameter specifies the normal block size of code flash memory in bytes. This parameter is applicable only for Code flash.
        integer FlsCFTotalSmallBlocks: 8..8, set at pre-compile, origin=Renesas_v1.0.0, default-value=8  # This parameter specifies the total number of code flash small blocks. This parameter is applicable only for Code flash.
        float FlsCFEraseTime: 0.0075..0.0075, set at published-information, origin=Renesas_v1.0.0, default-value=0.0075  # Maximum time (in seconds) to erase one complete code flash block.
        float FlsCFWriteTime: 0.0013..0.0013, set at published-information, origin=Renesas_v1.0.0, default-value=0.0013  # Maximum time (in seconds) to write one code flash chunk (each block consists of 256 bytes).
        float FlsCFReadTime: 0.0000017..0.0000017, set at published-information, origin=Renesas_v1.0.0, default-value=0.0000017  # Maximum time (in seconds) to read one byte of code flash.
        float FlsCFCancelTime: 0.000060..0.000060, set at published-information, origin=Renesas_v1.0.1, default-value=0.000060  # Maximum time (in seconds) to do cancel of on going job for code flash.
        integer FlsMaxCFReadNormalMode: 1..1024, set at pre-compile, origin=Renesas_v1.0.0, default-value=256  # This parameter specifies the maximum number of bytes to read or compare in one cycle of the flash driver's job processing function in normal mode. This parameter is applicable for code flash.
        integer FlsMaxCFWriteNormalMode: 256..8192, set at pre-compile, origin=Renesas_v1.0.0, default-value=256  # This parameter specifies the maximum number of bytes to write in one cycle of the flash driver's job processing function in normal mode. This parameter is applicable for code flash.
        integer FlsMaxCFEraseNormalMode: 32768..32768, set at pre-compile, origin=Renesas_v1.0.0, default-value=32768  # This parameter specifies the normal code flash block size and is used for calculation of timeout value for erase operation. This parameter is applicable only for Code Flash.
        integer FlsCFTotalNormalBlocks: 62..62, set at pre-compile, origin=Renesas_v1.0.0, default-value=62  # This parameter specifies the total number of code flash normal blocks.
        integer FlsFclRamAddress: 4275961856..4276091958, set at pre-compile, origin=Renesas_v1.0.0, default-value=4275961856  # This parameter specifies RAM address range blocked for FCL. This parameter is applicable only for Code flash.
        enumeration FlsCommandExecutionMode: {R_FCL_HANDLER_CALL_USER}, set at pre-compile, origin=Renesas_v1.0.0, default-value=R_FCL_HANDLER_CALL_USER  # This parameter defines whether the status check should be performed by the firmware or by the user to allow execution of user code in between the status checks. This parameter must be set to User Mode which is in-line with FCLconfiguration. This parameter is applicable only for code flash. | R_FCL_HANDLER_CALL_USER: Flash operations are initiated and executed in background, other user task can be executed in parallel as calling Fls_MainFunction will only be used to check if the flash operation is completed.
        reference FlsFclCpuFrequency: set at pre-compile, origin=Renesas_v1.0.0, destination=McuClockSettingConfig  # Reference to the CPU subsystem frequency configuration, which is set in the MCU driver configuration. This reference from MCU informs the programming HW frequency to the programming Firmware. The clock value in MCU must be according to the clock supply setting of the CPU Subsystem. Please make sure to set the correct clock value in MCU configuration to avoid damage to the flash hardware.
    container FlsPublishedInformation  # This container holding all Fls specific published information parameters. | Note that these parameters do not have any configuration class setting, since they are published information.
      integer FlsAcLocationErase: 0..4294967295, set at published-information, default-value=0  # Position in RAM, to which the erase flash access code has to be loaded. This parameter is not used for implementation, since FLS is using underlying library and complete library code is placed in the specified location of RAM memory hence location of Erase code is position dependent. | Only relevant if the erase flash access code is not position independent. If this information is not provided it is assumed that the erase flash access code is position independent and that therefore the RAM position can be freely configured.
      integer FlsAcLocationWrite: 0..4294967295, set at published-information, default-value=0  # Position in RAM, to which the write flash access code has to be loaded. This parameter is not used for implementation, since FLS is using underlying library and complete library code is placed in the specified location of RAM memory hence location of Write code is position dependent. | Only relevant if the write flash access code is not position independent. If this information is not provided it is assumed that the write flash access code is position independent and that therefore the RAM position can be freely configured.
      integer FlsAcSizeErase: 0..4294967295, set at published-information, default-value=0  # Number of bytes in RAM needed for the erase flash access code. This parameter is not used for implementation, since FLS is using underlying library and complete library code is placed in the specified location of RAM memory hence need not have a parameter to hold the information about size of Erase code.
      integer FlsAcSizeWrite: 0..4294967295, set at published-information, default-value=0  # Number of bytes in RAM needed for the write flash access code. This parameter is not used for implementation, since FLS is using underlying library and complete library code is placed in the specified location of RAM memory hence need not have a parameter to hold the information about size of Write code.
      float FlsEraseTime: 0.01..0.01, set at published-information, default-value=0.01  # Maximum time (in seconds) to erase one complete data flash block when fPCLK >= 20MHz. This parameter is not used for implementation.
      integer FlsErasedValue: 4294967295..4294967295, set at published-information, default-value=4294967295  # The contents of an erased flash memory cell.
      string FlsExpectedHwId: set at published-information, default-value=NULL  # Unique identifier of the hardware device that is expected by this driver (the device for which this driver has been implemented). This parameter is not used for the implementation. | Only relevant for external flash drivers.
      integer FlsSpecifiedEraseCycles: 125000..125000, set at published-information, default-value=125000  # Number of erase cycles specified for the flash device. This parameter is not used for implementation but it may be referenced by upper layers. | FLS198: If the number of specified erase cycles depends on the operating environment (temperature, voltage, ...) during reprogramming of the flash device, the minimum number for which a data retention of at least 20 years under average temperature of 85 degree Celsius can be guaranteed shall be given. Note: If there are different numbers of specified erase cycles for different flash sectors of the device this parameter has to be extended to a parameter list (similar to the sector list above). This parameter value is applicable for Data flash only. For code flash erase cycles value please refer to device data sheet.
      float FlsReadTime: 0.000050..0.000050, set at published-information, origin=Renesas_v1.0.0, default-value=0.000050  # Maximum time (in seconds) to read one data flash word without blank check.
      float FlsWriteTime: 0.0017..0.0017, set at published-information, default-value=0.0017  # Maximum time (in seconds) to program one complete word when fPCLK >= 20MHz. This parameter is not used for implementation.
      float FlsBlankCheckTime: 0.000213..0.000213, set at published-information, origin=Renesas_v1.0.0, default-value=0.000213  # Maximum time (in seconds) to do blank check before read for one data flash word.
      float FlsSuspendTime: 0.0003..0.0003, set at published-information, origin=Renesas_v1.1.0, default-value=0.0003  # Maximum time (in seconds) to perform suspend operation.
      float FlsCancelTime: 0.000050..0.000050, set at published-information, origin=Renesas_v1.0.1, default-value=0.000050  # Maximum time (in seconds) to do cancel of on going job for data flash.
    container FlsConfigSet: multiple-configuration-container=true  # Container for runtime configuration parameters of the flash driver. | Implementation Type: Fls_ConfigType.
      integer FlsAcErase: 0..4294967295, set at post-build, default-value=0  # This parameter specifies address offset in RAM to which the erase flash access code shall be loaded. Used as function pointer to access the erase flash access code. This parameter is not used for implementation, since FLS is using underlying library and complete library code is placed in the specified location of RAM memory and Erase function is handled using function pointer hence need not have a parameter to specifies address offset in RAM Erase code.
      integer FlsAcWrite: 0..4294967295, set at post-build, default-value=0  # This parameter specifies address offset in RAM to which the write flash access code shall be loaded. Used as function pointer to access the write flash access code. This parameter is not used for implementation, since FLS is using underlying library and complete library code is placed in the specified location of RAM memory and Write function is handled using function pointer hence need not have a parameter to specifies address offset in RAM Erase code.
      float FlsCallCycle: 0..1, set at post-build, default-value=0  # This parameter specifies the cycle time of calls of the flash driver's main function. The value is calculated for 80Mhz frequency. This parameter is not used for implementation, since main function cycle time is not considered for Timeout calculation.
      enumeration FlsDefaultMode: {MEMIF_MODE_FAST, MEMIF_MODE_SLOW}, set at post-build, default-value=MEMIF_MODE_SLOW  # This parameter is the default FLS device mode after initialization. This parameter is not used for implementation.
      function name FlsJobEndNotification [0..1]: set at post-build, default-value=NULL, regular-expression=[a-zA-Z][a-zA-Z0-9_]*  # This parameter mapped to the job end notification routine provided by some upper layer module, typically the Fee module.
      function name FlsJobErrorNotification [0..1]: set at post-build, default-value=NULL, regular-expression=[a-zA-Z][a-zA-Z0-9_]*  # This parameter mapped to the job error notification routine provided by some upper layer module, typically the Fee module.
      integer FlsMaxReadFastMode: 0..4294967295, set at post-build, default-value=0  # This parameter specifies the maximum number of bytes to read or compare in one cycle of the flash driver's job processing function in fast mode. This parameter is not used for implementation, since fast mode is not supported by underlying library.
      integer FlsMaxReadNormalMode: 4..8192, set at post-build, default-value=256  # This parameter specifies the maximum number of bytes to read or compare in one cycle of the flash driver's job processing function in normal mode. This parameter is applicable for data flash.
      integer FlsMaxWriteFastMode: 0..4294967295, set at post-build, default-value=0  # This parameter specifies the maximum number of bytes to write in one cycle of the flash driver's job processing function in fast mode. This parameter is not used for implementation, since fast mode is not supported by underlying library.
      integer FlsMaxWriteNormalMode: 4..4, set at post-build, default-value=4  # This parameter specifies the maximum number of bytes to write in one cycle of the flash driver's job processing function in normal mode. This parameter is applicable for data flash.
      integer FlsMaxEraseNormalMode: 64..64, set at post-build, origin=Renesas_v1.0.0, default-value=64  # This parameter specifies the maximum number of bytes to erase in one cycle of the flash driver's job processing function in normal mode. This value should be multiple of 64 bytes. This parameter is applicable only for Data Flash.
      integer FlsProtection: 0..4294967295, set at post-build, default-value=0  # This parameter uses the erase/write protection settings. (Only relevant if supported by hardware). This parameter is not used for implementation, since it is not supported by hardware.
      container FlsDemEventParameterRefs  # Container for the references to DemEventParameter elements which shall be invoked using the Dem_ReportErrorStatus API in case the corresponding error occurs. The EventId is taken from the referenced DemEventParameter's DemEventId value. The standardized errors are provided in the container and can be extended by vendor specific error references.
        symbolic name reference FLS_E_COMPARE_FAILED: set at post-build, destination=DemEventParameter  # Reference to the DemEventParameter which shall be issued when the error "Flash compare failed (HW)" has occurred.
        symbolic name reference FLS_E_ERASE_FAILED: set at post-build, destination=DemEventParameter  # Reference to the DemEventParameter which shall be issued when the error "Flash erase failed (HW)" has occurred.
        symbolic name reference FLS_E_READ_FAILED: set at post-build, destination=DemEventParameter  # Reference to the DemEventParameter which shall be issued when the error "Flash read failed (HW)" has occurred.
        symbolic name reference FLS_E_UNEXPECTED_FLASH_ID [0..1]: set at post-build, destination=DemEventParameter  # Reference to the DemEventParameter which shall be issued when the error "Expected hardware ID not matched" has occurred. This parameter is not used for implementation.
        symbolic name reference FLS_E_WRITE_FAILED: set at post-build, destination=DemEventParameter  # Reference to the DemEventParameter which shall be issued when the error "Flash write failed (HW)" has occurred.
        symbolic name reference FLS_E_READ_FAILED_DED: set at post-build, origin=Renesas_v1.0.0, destination=DemEventParameter  # Reference to the DemEventParameter which shall be issued when the error "Flash read failed (HW) due to double bit ECC error" has occurred.
      container FlsExternalDriver [0..1]  # This container is present for external Flash drivers only. Internal Flash drivers do not use the parameter listed in this container, hence its multiplicity is 0 for internal drivers. This container is not used for implementation.
        symbolic name reference FlsSpiReference [1..*]: set at pre-compile, destination=SpiSequence  # Reference to SPI sequence (required for external Flash drivers). This parameter is not used for implementation.
      container FlsSectorList  # This container specifies the list of flashable sectors and pages.
        container FlsSector [1..*]  # This container specifies the configuration description of a flashable sector.
          integer FlsSectorIndex: 0..2, set at pre-compile, origin=Renesas_v1.0.0, default-value=0  # This parameter specifies unique index value for each sectors. The value of this parameter should be unique for each sector.
          enumeration FlsSectorOption: {FLS_DF_SECTOR, FLS_CF_SMALL_BLK_SECTOR, FLS_CF_NORMAL_BLK_SECTOR}, set at pre-compile, origin=Renesas_v1.0.0, default-value=FLS_DF_SECTOR  # This parameter defines individual sectors. | FLS_DF_SECTOR: Data Flash Sector. FLS_CF_SMALL_BLK_SECTOR: Code Flash small block sector. FLS_CF_NORMAL_BLK_SECTOR: Code Flash normal block sector.
          integer FlsNumberOfSectors: 1..1024, set at pre-compile, default-value=1  # This parameter specifies number of continuous sectors with identical values for FlsSectorSize and FlsPageSize. | If FlsSectorOption is selected as FLS_DF_SECTOR then FlsNumberOfSectors should be configured as 1 to 1024. FLS_CF_SMALL_BLK_SECTOR then FlsNumberOfSectors should be configured as 8. FLS_CF_NORMAL_BLK_SECTOR then FlsNumberOfSectors should be configured as 62.
          integer FlsPageSize: 4..4, set at pre-compile, default-value=4  # This parameter specifies size of one page of this sector. | Implementation Type: Fls_LengthType.
          integer FlsSectorSize: 64..32768, set at pre-compile, default-value=64  # This parameter specifies size of this sector in bytes. | If FlsSectorOption is selected as FLS_DF_SECTOR then FlsSectorSize should be configured as 64. FLS_CF_SMALL_BLK_SECTOR then FlsSectorSize should be configured as 8192. FLS_CF_NORMAL_BLK_SECTOR then FlsSectorSize should be configured as 32768.
          integer FlsSectorStartaddress: 0..2162687, set at pre-compile, default-value=0  # This parameter specifies the start address of this sector. This parameter specifies the virtual start address. Implementation Type: Fls_AddressType. | Virtual Address range for Data Flash: 0 - 65535(64K - 1). Virtual Address range for Code Flash Small Sector: 65536(64K) - 131071(64K + 64K - 1). Virtual Address range for Code Flash Normal Sector: 131072(64K + 64K) - 2162687(64K + 2MB - 1).
