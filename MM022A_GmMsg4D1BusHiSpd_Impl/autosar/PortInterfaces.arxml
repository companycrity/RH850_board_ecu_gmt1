AUTOSAR XML (schema 4-0-3)
package /Nexteer/Calibrations
  parameter interface float32_CalPortIf1
    parameter data prototype Val: sw-calibration-access=READ-WRITE, type=float32
  parameter interface uint16_CalPortIf1
    parameter data prototype Val: sw-calibration-access=READ-WRITE, type=uint16
package /Nexteer/PortInterfaces
  client server interface GetRefTmr100MicroSec32bit1
    operation Oper
      arg RefTmr: type=uint32, direction=OUT
  client server interface GetTiSpan100MicroSec32bit1
    operation Oper
      arg RefTmr: type=uint32, direction=IN
      arg TiSpan: type=uint32, direction=OUT
  client server interface SetNtcSts1
    operation Oper: possible-error=E_NOT_OK
      4 x arg, all with direction=IN:
        NtcNr: type=NtcNr1
        NtcStInfo: type=uint8
        NtcSts: type=NtcSts1
        DebStep: type=uint16
    error E_NOT_OK: error-code=1
  sender receiver interface float32_PortIf1: invalidation-policy{data-element=float32_PortIf1/Val, handle-invalid=DONT-INVALIDATE}
    data Val: sw-calibration-access=READ-ONLY, type=float32
  sender receiver interface uint32_PortIf1: invalidation-policy{data-element=uint32_PortIf1/Val, handle-invalid=DONT-INVALIDATE}
    data Val: type=uint32
  sender receiver interface uint8_PortIf1: invalidation-policy{data-element=uint8_PortIf1/Val, handle-invalid=DONT-INVALIDATE}
    data Val: sw-calibration-access=READ-ONLY, type=uint8
