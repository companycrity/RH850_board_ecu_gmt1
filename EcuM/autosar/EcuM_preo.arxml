AUTOSAR XML (schema 4-0-3)
# COPYRIGHT
# Copyright (c) 2013 by Vector Informatik GmbH. All rights reserved.
# This software is copyright protected and proprietary to Vector Informatik GmbH.
# Vector Informatik GmbH grants to you only those rights as set out in the license conditions.
package /MICROSAR  # EcuM Preconfiguration
  module config EcuM_Pre: definition=EcuM, implementation-config-variant=VARIANT-PRE-COMPILE
  module config EcuM_Rec: definition=EcuM
    EcuMFlexGeneral: EcuMAlarmClockPresent=0, EcuMResetLoopDetection=0, EcuMEnableDefBehaviour=0
    EcuMGeneral: EcuMDevErrorDetect=1, EcuMIncludeDem=1, EcuMIncludeDet=1, EcuMProductionError=1, EcuMVersionInfoApi=0
