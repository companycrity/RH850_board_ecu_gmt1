AUTOSAR XML (schema 4-0-3)
standard types defined: float32_DataConstr, float64_DataConstr, sint16_DataConstr, sint32_DataConstr, sint8_DataConstr, uint16_DataConstr, uint32_DataConstr, uint8_DataConstr, boolean, float32, float64, sint16, sint32, sint8, uint16, uint32, uint8
package /Nexteer/DataConstrs
  range n1pt0e7_p1pt0e5: phys -100000..100000, raw 0
  range n2pt35e7_p2pt35e7: phys -23500000..23500000
  range p0pt0_0pt006: phys 0..0.006
  range p0pt0_n8pt8: phys 0..8.8
  range p0pt0_p0pt0045: phys 0..0.0045
  range p0pt0_p1000pt0: phys 0..1000
  range p0pt0_p255pt0: phys 0..255
  range p0pt0_p2pt8: phys 0..2.8
  range p0pt0_p360pt0: phys 0..360
  range p0pt0_p6pt25: phys 0..6.25
  range p0pt0_p8pt8: phys 0..8.8
  range p0pt00003_p0pt00041: phys 3e-05..0.00041
  range p0pt005_p0pt12565: phys 0.005..0.12565
  range p0pt025_p0pt075: phys 0.025..0.075
package /Nexteer/DataTypeMappingSets
  data type mapping set Nexteer
    data-type-maps:
      application-data-type=Cnt10, implementation-data-type=uint16
      application-data-type=Rate1, implementation-data-type=float32
      application-data-type=Volt2, implementation-data-type=float32
      application-data-type=Volt1, implementation-data-type=float32
      application-data-type=Curr3, implementation-data-type=float32
      application-data-type=Volt9, implementation-data-type=float32
      application-data-type=VoltTi2, implementation-data-type=uint32
      application-data-type=Volt8, implementation-data-type=float32
      application-data-type=Cnt4, implementation-data-type=uint16
      application-data-type=Cnt14, implementation-data-type=uint8
      application-data-type=T3, implementation-data-type=float32
      application-data-type=T2, implementation-data-type=float32
      application-data-type=Cnt8, implementation-data-type=uint32
      application-data-type=Volt3, implementation-data-type=float32
      application-data-type=Cnt6, implementation-data-type=uint8
      application-data-type=Volt12, implementation-data-type=float32
      application-data-type=Cnt5, implementation-data-type=uint16
      application-data-type=T4, implementation-data-type=float32
      application-data-type=Volt7, implementation-data-type=float32
      application-data-type=Cnt7, implementation-data-type=uint8
      application-data-type=Cnt12, implementation-data-type=uint8
      application-data-type=Ti1, implementation-data-type=uint32
      application-data-type=Volt14, implementation-data-type=float32
      application-data-type=Ti3, implementation-data-type=uint32
      application-data-type=VoltTi1, implementation-data-type=uint32
      application-data-type=Vel2, implementation-data-type=float32
      application-data-type=Volt13, implementation-data-type=float32
      application-data-type=Volt15, implementation-data-type=float32
      application-data-type=Frq1, implementation-data-type=float32
      application-data-type=Ti6, implementation-data-type=uint32
      application-data-type=Volt10, implementation-data-type=float32
      application-data-type=Cnt11, implementation-data-type=uint16
      application-data-type=Volt4, implementation-data-type=float32
      application-data-type=Vel1, implementation-data-type=float32
      application-data-type=Cnt1, implementation-data-type=uint8
      application-data-type=VoltGain1, implementation-data-type=float32
      application-data-type=Uls2, implementation-data-type=float32
      application-data-type=Gain3, implementation-data-type=float32
      application-data-type=Volt5, implementation-data-type=float32
      application-data-type=Volt6, implementation-data-type=float32
      application-data-type=Ti4, implementation-data-type=uint32
      application-data-type=Gain2, implementation-data-type=float32
      application-data-type=Tq1, implementation-data-type=float32
      application-data-type=Cnt13, implementation-data-type=uint8
      application-data-type=Volt11, implementation-data-type=float32
      application-data-type=Spd1, implementation-data-type=float32
      application-data-type=Cnt2, implementation-data-type=sint8
      application-data-type=Uls1, implementation-data-type=float32
      application-data-type=Curr1, implementation-data-type=float32
      application-data-type=Gain1, implementation-data-type=float32
      application-data-type=Ti2, implementation-data-type=uint32
      application-data-type=Cnt3, implementation-data-type=uint16
      application-data-type=T1, implementation-data-type=float32
      application-data-type=Cnt9, implementation-data-type=uint16
      application-data-type=Curr2, implementation-data-type=float32
      application-data-type=Gain4, implementation-data-type=float32
      application-data-type=Tq2, implementation-data-type=float32
      application-data-type=Ti5, implementation-data-type=uint32
package /Nexteer/DataTypes
  58 x app type, all with category=VALUE, sw-calibration-access=READ-ONLY:
    Cnt1: range phys 1..4, unit=Cnt
    Cnt10: range phys 1..10000, unit=Cnt
    Cnt11: range phys 0..10000, unit=Cnt
    Cnt12: range phys 0..3, unit=Cnt
    Cnt13: range phys 0..3, unit=Cnt
    Cnt14: range phys 2..12, unit=Cnt
    Cnt2: range phys -1..1, unit=Cnt
    Cnt3: range phys 0..1, unit=Cnt
    Cnt4: range phys 0..31, unit=Cnt
    Cnt5: range phys 0..32767, unit=Cnt
    Cnt6: range phys 0..63, unit=Cnt
    Cnt7: range phys 20..160, unit=Cnt
    Cnt8: range phys 0..1800, unit=Cnt
    Cnt9: range phys 1..1000, unit=Cnt
    Curr1: range phys -145..145, unit=Amp
    Curr2: range phys 0..50, unit=Amp
    Curr3: range phys 10..100, unit=Amp
    Frq1: range phys 0.1..10, unit=Hz
    Gain1: range phys 0..200, unit=degC/Volt
    Gain2: range phys 70..76, unit=Amp/V
    Gain3: range phys 56..60, unit=Amp/V
    Gain4: range phys 0..76, unit=Amp/V
    Rate1: range phys 0.1..500, unit=Uls/S
    Spd1: range phys 0..511, unit=kph
    T1: range phys -50..150, unit=degC
    T2: range phys -50..200, unit=degC
    T3: range phys -50..300, unit=degC
    T4: range phys -100..150, unit=degC
    Ti1: range phys 0..25000, unit=nS
    Ti2: range phys 1..1000, unit=nS
    Ti3: range phys 0..71429, unit=nS
    Ti4: range phys 55555..71429, unit=nS
    Ti5: range phys 6666..8572, unit=nS
    Ti6: range phys 0..30000, unit=nS
    Tq1: range phys -8.8..8.8, unit=MotNm
    Tq2: range phys -10..10, unit=HwNm
    Uls1: range phys 0.5..1, unit=Uls
    Uls2: range phys 0..1, unit=Uls
    Vel1: range phys -1350..1350, unit=MotRad/s
    Vel2: range phys 0..1350, unit=MotRad/s
    Volt1: range phys 6..26.5, unit=V
    Volt10: range phys 2.5..4.8, unit=V
    Volt11: range phys 0.3..2.5, unit=V
    Volt12: range phys 2.5..3, unit=V
    Volt13: range phys 2..2.5, unit=V
    Volt14: range phys 0..4800, unit=V
    Volt15: range phys 0..48000, unit=V
    Volt2: range phys 6..16, unit=V
    Volt3: range phys 0..5, unit=V
    Volt4: range phys 0..26.5, unit=V
    Volt5: range phys 0..16, unit=V
    Volt6: range phys 0..40, unit=V
    Volt7: range phys 0.3..4.8, unit=V
    Volt8: range phys 2.8..3, unit=V
    Volt9: range phys 2..2.3, unit=V
    VoltGain1: range phys -1..1, unit=VoltPerVoltNanoSec
    VoltTi1: range phys 0..1040000, unit=VnS
    VoltTi2: range phys 233330..1325008, unit=VnS
  15 x impl type:
    Ary1D_NtcFltInfoRec1_20: category=ARRAY, sw-calibration-access=READ-ONLY, type-emitter=RTE
      element Element: array-size=20, array-size-semantics=FIXED-SIZE, implementation-data-type=NtcFltInfoRec1
    Ary1D_NtcInfoRec1_512: category=ARRAY, sw-calibration-access=READ-ONLY, type-emitter=RTE
      element Element: array-size=512, array-size-semantics=FIXED-SIZE, implementation-data-type=NtcInfoRec1
    Ary1D_u32_512: category=ARRAY, sw-calibration-access=READ-ONLY, type-emitter=RTE
      element Element: array-size=512, array-size-semantics=VARIABLE-SIZE, implementation-data-type=uint32
    BattSwdVltgCorrlnSts1: compu {0=BSVCS_NOFLT, 1=BSVCS_BATTVLTGSWD2FLT, 2=BSVCS_BATTVLTGSWD1FLT, 3=BSVCS_BATTVLTGFLT, 4=BSVCS_NOCORRLN}, implementation-data-type=uint8, type-emitter=RTE
    EOLGainOffs1: category=STRUCTURE, sw-calibration-access=READ-ONLY, type-emitter=RTE
      19 x element, all with category=TYPE_REFERENCE, implementation-data-type=float32:
        CurrMeasEolOffsHiBrdgVltg
        CurrMeasMotCurrEolGainA
        CurrMeasMotCurrEolGainB
        CurrMeasMotCurrEolGainC
        CurrMeasMotCurrEolGainD
        CurrMeasMotCurrEolGainE
        CurrMeasMotCurrEolGainF
        CurrMeasMotCurrEolOffsDifA
        CurrMeasMotCurrEolOffsDifB
        CurrMeasMotCurrEolOffsDifC
        CurrMeasMotCurrEolOffsDifD
        CurrMeasMotCurrEolOffsDifE
        CurrMeasMotCurrEolOffsDifF
        CurrMeasMotCurrOffsLoAvrgA
        CurrMeasMotCurrOffsLoAvrgB
        CurrMeasMotCurrOffsLoAvrgC
        CurrMeasMotCurrOffsLoAvrgD
        CurrMeasMotCurrOffsLoAvrgE
        CurrMeasMotCurrOffsLoAvrgF
      symbol props EOLGainOffs1
    FilLpRec1: category=STRUCTURE, sw-calibration-access=READ-ONLY, type-emitter=NxtrFil
      element FilSt: implementation-data-type=float32
      element FilGain: implementation-data-type=float32
      symbol props FilLpRec1
    MotCurrEolCalSt1: compu {1=MCECS_OFFSCMDHI, 2=MCECS_OFFSCMDLO, 3=MCECS_OFFSCMDZERO, 4=MCECS_OFFSCMDEND, 5=MCECS_GAINCMDAD, 6=MCECS_GAINCMDBE, 7=MCECS_GAINCMDCF, 8=MCECS_CMDSAFEST}, implementation-data-type=uint8, type-emitter=RTE
    MotCurrEolCalSt2: compu {0=MCECS_OFFSCMDSTRT, 1=MCECS_OFFSCMDHI, 2=MCECS_OFFSCMDLO, 3=MCECS_OFFSCMDZERO, 4=MCECS_OFFSCMDEND, 5=MCECS_GAINCMDAD, 6=MCECS_GAINCMDBE, 7=MCECS_GAINCMDCF, 8=MCECS_CMDSAFEST}, implementation-data-type=uint8, type-emitter=RTE
    NtcFltInfoRec1: category=STRUCTURE, sw-calibration-access=READ-ONLY, type-emitter=RTE
      4 x element, all with category=TYPE_REFERENCE:
        NtcNr: implementation-data-type=uint16
        AgiCntr: implementation-data-type=uint8
        Sts: implementation-data-type=uint8
        NtcStInfo: implementation-data-type=uint8
    NtcInfoRec1: category=STRUCTURE, sw-calibration-access=READ-ONLY, type-emitter=RTE
      element AgiCntr: implementation-data-type=uint8
      element Sts: implementation-data-type=uint8
      element NtcStInfo: implementation-data-type=uint8
    NtcNr1: compu {1..511=NTCNR_0X001..NTCNR_0X1FF}, implementation-data-type=uint16, type-emitter=RTE
    NtcSts1: compu {0=NTCSTS_PASSD, 1=NTCSTS_FAILD, 2=NTCSTS_PREPASSD, 3=NTCSTS_PREFAILD}, implementation-data-type=uint8, type-emitter=RTE
    SigQlfr1: compu {0=SIGQLFR_NORES, 1=SIGQLFR_PASSD, 2=SIGQLFR_FAILD}, implementation-data-type=uint8, type-emitter=RTE
    StrtUpSt1: compu {1=STRTUPST_PWRDISCNCTATESTCMPL, 2=STRTUPST_PWRDISCNCTBTESTCMPL, 3=STRTUPST_TMPLMONININTESTCMPL, 4=STRTUPST_MOTDRVRININCMPL, 5=STRTUPST_CURRMEASWRMININTESTCMPL, 6=STRTUPST_WARMININCMPL, 7=STRTUPST_RUN, 8=STRTUPST_DISABLE}, implementation-data-type=uint8, type-emitter=RTE
    SysSt1: compu {0=SYSST_DI, 1=SYSST_OFF, 2=SYSST_ENA, 3=SYSST_WRMININ}, implementation-data-type=uint8, type-emitter=RTE
package /Nexteer/Units
  64 x unit, all with factor-si-to-unit=1, offset-si-to-unit=0:
    Ampr: display-name=Amp
    AmprPerVolt: display-name=Amp/V
    AmprSqd: display-name=Amp^2
    Bar: display-name=bar
    Cnt: display-name=Cnt
    CntPerNanoSec: display-name=Cnt/nS
    DegCgrd: display-name=degC
    DegCgrdPerSec: display-name=degC/s
    DegCgrdPerVolt: display-name=degC/Volt
    DegCgrdPerWatt: display-name=degC/Watt
    Henry: display-name=H
    HwDeg: display-name=HwDeg
    HwDegPerSec: display-name=HwDeg/s
    HwDegPerVolt: display-name=HwDeg/volt
    HwNwtMtr: display-name=HwNm
    HwNwtMtrPerHwDeg: display-name=HwNm/HwDeg
    HwNwtMtrPerMotNwtMtr: display-name=HwNm/MotNm
    HwRad: display-name=HwRad
    HwRadPerSec: display-name=HwRad/s
    Hz: display-name=Hz
    IvsHwNwtMtr: display-name=1/HwNm
    KiloGrMtrSqd: display-name=kgm^2
    KiloHz: display-name=kHz
    KiloMtrPerHr: display-name=KpH
    Kph: display-name=kph
    KphPerSecSqd: display-name=kph/s^2
    MicroSec: display-name=uS
    MilliSec: display-name=mS
    MotDeg: display-name=MotDeg
    MotDegElec: display-name=MotDegElec
    MotDegPerHwDeg: display-name=MotDeg/HwDeg
    MotDegPerSec: display-name=MotDeg/s
    MotNwtMtr: display-name=MotNm
    MotNwtMtrPerHwDegSec: display-name=MotNm/HwDegS
    MotNwtMtrPerHwNwtMtr: display-name=MotNm/HwNm
    MotNwtMtrPerMotDeg: display-name=MotNm/MotDeg
    MotNwtMtrPerMotRadPerSec: display-name=MotNm/MotRad/S
    MotNwtMtrPerRadPerSec: display-name=MotNM/Rad/s
    MotNwtMtrPerSec: display-name=MotNm/S
    MotRad: display-name=MotRad
    MotRadPerSec: display-name=MotRad/s
    MotRev: display-name=MotRev
    MotRevElec: display-name=MotRevElec
    Mtr: display-name=m
    MtrPerSec: display-name=m/s
    MtrPerSecSqd: display-name=m/s^2
    NanoSec: display-name=nS
    Ohm: display-name=ohm
    OhmPerDegCgrd: display-name=ohm/degC
    Rad: display-name=Radians  # Motor Positions
    Rec: display-name=rec
    Sec: display-name=sec
    TrsmNwtMtr: display-name=TrsmNm
    Uls: display-name=Uls
    UlsPerMilliSec: display-name=Uls/mS
    UlsPerSec: display-name=Uls/S
    Volt: display-name=V
    VoltNanoSec: display-name=VnS
    VoltPerCnt: display-name=Volt/Cnt
    VoltPerRadPerSec: display-name=V/Rad/s
    VoltPerRadPerSecPerDegCgrd: display-name=(V/Rad/S)/degC
    VoltPerSec: display-name=V/s
    VoltPerVoltNanoSec
    WattPerAmprSqd: display-name=Watt/A^2
