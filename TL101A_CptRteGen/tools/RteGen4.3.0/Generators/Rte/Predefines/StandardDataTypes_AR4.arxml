AUTOSAR XML (schema 4-0-3)
standard types defined: boolean, sint16, sint32, sint8, uint16, uint32, uint8, float64, float32, sint16_DataConstr, sint32_DataConstr, sint8_DataConstr, uint16_DataConstr, uint32_DataConstr, uint8_DataConstr, float64_DataConstr, float32_DataConstr
