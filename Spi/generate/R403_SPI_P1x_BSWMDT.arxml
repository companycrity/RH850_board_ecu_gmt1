AUTOSAR XML (schema 4-0-3)
# COPYRIGHT
# Copyright(c) 2013-2015 Renesas Electronics Corporation
package /Renesas/EcucDefs_Spi
  bsw implementation Spi_Impl: programming-language=C, sw-version=1.6.0, vendor-id=59, ar-release-version=4.0.3, behavior=BswInternalBehavior_0, vendor-api-infix=Renesas, vendor-specific-module-def=Spi
  bsw module description Spi: module-id=83
    bsw internal behavior BswInternalBehavior_0
      exclusive area CHIP_SELECT_PROTECTION
      exclusive area RAM_DATA_PROTECTION
      70 x bsw interrupt entity:
        BswInterruptEntity_0: implemented-entry=SPI_CSIG0_TIRE_ISR, interrupt-category=CAT-1, interrupt-source=INTCSIG0IRE
        BswInterruptEntity_1: implemented-entry=SPI_CSIG0_TIRE_CAT2_ISR, interrupt-category=CAT-2, interrupt-source=INTCSIG0IRE
        BswInterruptEntity_2: implemented-entry=SPI_CSIG0_TIR_ISR, interrupt-category=CAT-1, interrupt-source=INTCSIG0IR
        BswInterruptEntity_3: implemented-entry=SPI_CSIG0_TIR_CAT2_ISR, interrupt-category=CAT-1, interrupt-source=INTCSIG0IR
        BswInterruptEntity_4: implemented-entry=SPI_CSIG0_TIC_ISR, interrupt-category=CAT-1, interrupt-source=INTCSIG0IC
        BswInterruptEntity_5: implemented-entry=SPI_CSIG0_TIC_CAT2_ISR, interrupt-category=CAT-2, interrupt-source=INTCSIG0IC
        BswInterruptEntity_6: implemented-entry=SPI_CSIH3_TIRE_ISR, interrupt-category=CAT-1, interrupt-source=INTCSIH3IRE
        BswInterruptEntity_7: implemented-entry=SPI_CSIH3_TIRE_CAT2_ISR, interrupt-category=CAT-2, interrupt-source=INTCSIH3IRE
        BswInterruptEntity_8: implemented-entry=SPI_CSIH3_TIR_ISR, interrupt-category=CAT-1, interrupt-source=INTCSIH3IR
        BswInterruptEntity_9: implemented-entry=SPI_CSIH3_TIR_CAT2_ISR, interrupt-category=CAT-2, interrupt-source=INTCSIH3IR
        BswInterruptEntity_10: implemented-entry=SPI_CSIH3_TIC_ISR, interrupt-category=CAT-1, interrupt-source=INTCSIH3IC
        BswInterruptEntity_11: implemented-entry=SPI_CSIH3_TIC_CAT2_ISR, interrupt-category=CAT-2, interrupt-source=INTCSIH3IC
        BswInterruptEntity_12: implemented-entry=SPI_CSIH3_TIJC_ISR, interrupt-category=CAT-1, interrupt-source=INTCSIH3IJC
        BswInterruptEntity_13: implemented-entry=SPI_CSIH3_TIJC_CAT2_ISR, interrupt-category=CAT-2, interrupt-source=INTCSIH3IJC
        BswInterruptEntity_19: implemented-entry=SPI_CSIH0_TIRE_ISR, interrupt-category=CAT-1, interrupt-source=INTCSIH0IRE
        BswInterruptEntity_20: implemented-entry=SPI_CSIH0_TIRE_CAT2_ISR, interrupt-category=CAT-2, interrupt-source=INTCSIH0IRE
        BswInterruptEntity_21: implemented-entry=SPI_CSIH0_TIR_ISR, interrupt-category=CAT-1, interrupt-source=INTCSIH0IR
        BswInterruptEntity_22: implemented-entry=SPI_CSIH0_TIR_CAT2_ISR, interrupt-category=CAT-2, interrupt-source=INTCSIH0IR
        BswInterruptEntity_23: implemented-entry=SPI_CSIH0_TIC_ISR, interrupt-category=CAT-1, interrupt-source=INTCSIH0IC
        BswInterruptEntity_24: implemented-entry=SPI_CSIH0_TIC_CAT2_ISR, interrupt-category=CAT-2, interrupt-source=INTCSIH0IC
        BswInterruptEntity_25: implemented-entry=SPI_CSIH0_TIJC_ISR, interrupt-category=CAT-1, interrupt-source=INTCSIH0IJC
        BswInterruptEntity_26: implemented-entry=SPI_CSIH0_TIJC_CAT2_ISR, interrupt-category=CAT-2, interrupt-source=INTCSIH0IJC
        BswInterruptEntity_27: implemented-entry=SPI_CSIH1_TIRE_ISR, interrupt-category=CAT-1, interrupt-source=INTCSIH1IRE
        BswInterruptEntity_28: implemented-entry=SPI_CSIH1_TIRE_CAT2_ISR, interrupt-category=CAT-2, interrupt-source=INTCSIH1IRE
        BswInterruptEntity_29: implemented-entry=SPI_CSIH1_TIR_ISR, interrupt-category=CAT-1, interrupt-source=INTCSIH1IR
        BswInterruptEntity_30: implemented-entry=SPI_CSIH1_TIR_CAT2_ISR, interrupt-category=CAT-2, interrupt-source=INTCSIH1IR
        BswInterruptEntity_31: implemented-entry=SPI_CSIH1_TIC_ISR, interrupt-category=CAT-1, interrupt-source=INTCSIH1IC
        BswInterruptEntity_32: implemented-entry=SPI_CSIH1_TIC_CAT2_ISR, interrupt-category=CAT-2, interrupt-source=INTCSIH1IC
        BswInterruptEntity_33: implemented-entry=SPI_CSIH1_TIJC_ISR, interrupt-category=CAT-1, interrupt-source=INTCSIH1IJC
        BswInterruptEntity_34: implemented-entry=SPI_CSIH1_TIJC_CAT2_ISR, interrupt-category=CAT-2, interrupt-source=INTCSIH1IJC
        BswInterruptEntity_35: implemented-entry=SPI_DMA00_ISR, interrupt-category=CAT-1, interrupt-source=INTDMA0
        BswInterruptEntity_36: implemented-entry=SPI_DMA00_CAT2_ISR, interrupt-category=CAT-2, interrupt-source=INTDMA0
        BswInterruptEntity_37: implemented-entry=SPI_DMA01_ISR, interrupt-category=CAT-1, interrupt-source=INTDMA1
        BswInterruptEntity_38: implemented-entry=SPI_DMA01_CAT2_ISR, interrupt-category=CAT-2, interrupt-source=INTDMA1
        BswInterruptEntity_41: implemented-entry=SPI_DMA02_ISR, interrupt-category=CAT-1, interrupt-source=INTDMA2
        BswInterruptEntity_42: implemented-entry=SPI_DMA02_CAT2_ISR, interrupt-category=CAT-2, interrupt-source=INTDMA2
        BswInterruptEntity_43: implemented-entry=SPI_DMA03_ISR, interrupt-category=CAT-1, interrupt-source=INTDMA3
        BswInterruptEntity_44: implemented-entry=SPI_DMA03_CAT2_ISR, interrupt-category=CAT-2, interrupt-source=INTDMA3
        BswInterruptEntity_45: implemented-entry=SPI_DMA04_ISR, interrupt-category=CAT-1, interrupt-source=INTDMA4
        BswInterruptEntity_46: implemented-entry=SPI_DMA04_ISR, interrupt-category=CAT-2, interrupt-source=INTDMA4
        BswInterruptEntity_47: implemented-entry=SPI_DMA05_ISR, interrupt-category=CAT-1, interrupt-source=INTDMA5
        BswInterruptEntity_48: implemented-entry=SPI_DMA05_CAT2_ISR, interrupt-category=CAT-2, interrupt-source=INTDMA5
        BswInterruptEntity_49: implemented-entry=SPI_DMA06_ISR, interrupt-category=CAT-1, interrupt-source=INTDMA6
        BswInterruptEntity_50: implemented-entry=SPI_DMA06_CAT2_ISR, interrupt-category=CAT-2, interrupt-source=INTDMA6
        BswInterruptEntity_51: implemented-entry=SPI_DMA07_ISR, interrupt-category=CAT-1, interrupt-source=INTDMA7
        BswInterruptEntity_52: implemented-entry=SPI_DMA07_CAT2_ISR, interrupt-category=CAT-2, interrupt-source=INTDMA7
        BswInterruptEntity_65: implemented-entry=SPI_DMA08_ISR, interrupt-category=CAT-1, interrupt-source=INTDMA8
        BswInterruptEntity_67: implemented-entry=SPI_DMA08_CAT2_ISR, interrupt-category=CAT-2, interrupt-source=INTDMA8
        BswInterruptEntity_68: implemented-entry=SPI_DMA09_ISR, interrupt-category=CAT-1, interrupt-source=INTDMA9
        BswInterruptEntity_69: implemented-entry=SPI_DMA09_CAT2_ISR, interrupt-category=CAT-2, interrupt-source=INTDMA9
        BswInterruptEntity_70: implemented-entry=SPI_DMA10_ISR, interrupt-category=CAT-1, interrupt-source=INTDMA10
        BswInterruptEntity_71: implemented-entry=SPI_DMA10_CAT2_ISR, interrupt-category=CAT-2, interrupt-source=INTDMA10
        BswInterruptEntity_72: implemented-entry=SPI_DMA11_ISR, interrupt-category=CAT-1, interrupt-source=INTDMA11
        BswInterruptEntity_73: implemented-entry=SPI_DMA11_CAT2_ISR, interrupt-category=CAT-2, interrupt-source=INTDMA11
        BswInterruptEntity_74: implemented-entry=SPI_DMA12_ISR, interrupt-category=CAT-1, interrupt-source=INTDMA12
        BswInterruptEntity_75: implemented-entry=SPI_DMA12_CAT2_ISR, interrupt-category=CAT-2, interrupt-source=INTDMA12
        BswInterruptEntity_76: implemented-entry=SPI_DMA13_ISR, interrupt-category=CAT-1, interrupt-source=INTDMA13
        BswInterruptEntity_78: implemented-entry=SPI_DMA13_CAT2_ISR, interrupt-category=CAT-2, interrupt-source=INTDMA13
        BswInterruptEntity_79: implemented-entry=SPI_DMA14_ISR, interrupt-category=CAT-1, interrupt-source=INTDMA14
        BswInterruptEntity_80: implemented-entry=SPI_DMA14_CAT2_ISR, interrupt-category=CAT-2, interrupt-source=INTDMA14
        BswInterruptEntity_81: implemented-entry=SPI_DMA15_ISR, interrupt-category=CAT-1, interrupt-source=INTDMA15
        BswInterruptEntity_82: implemented-entry=SPI_DMA15_CAT2_ISR, interrupt-category=CAT-2, interrupt-source=INTDMA15
        BswInterruptEntity_53: implemented-entry=SPI_CSIH2_TIRE_ISR, interrupt-category=CAT-1, interrupt-source=INTCSIH2IRE
        BswInterruptEntity_54: implemented-entry=SPI_CSIH2_TIR_ISR, interrupt-category=CAT-1, interrupt-source=INTCSIH2IR
        BswInterruptEntity_55: implemented-entry=SPI_CSIH2_TIC_ISR, interrupt-category=CAT-1, interrupt-source=INTCSIH2IC
        BswInterruptEntity_56: implemented-entry=SPI_CSIH2_TIJC_ISR, interrupt-category=CAT-1, interrupt-source=INTCSIH2IJC
        BswInterruptEntity_61: implemented-entry=SPI_CSIH2_TIRE_CAT2_ISR, interrupt-category=CAT-2, interrupt-source=INTCSIH2IRE
        BswInterruptEntity_62: implemented-entry=SPI_CSIH2_TIR_CAT2_ISR, interrupt-category=CAT-2, interrupt-source=INTCSIH2IR
        BswInterruptEntity_63: implemented-entry=SPI_CSIH2_TIC_CAT2_ISR, interrupt-category=CAT-2, interrupt-source=INTCSIH2IC
        BswInterruptEntity_64: implemented-entry=SPI_CSIH2_TIJC_CAT2_ISR, interrupt-category=CAT-2, interrupt-source=INTCSIH2IJC
      bsw schedulable entity Spi_MainFunction_Handling: minimum-start-interval=0.0000035
  71 x bsw module entry, all with sw-service-impl-policy=STANDARD:
    SPI_CSIG0_TIRE_ISR: is-reentrant=true, is-synchronous=true, call-type=INTERRUPT, execution-context=INTERRUPT-CAT-1
    SPI_CSIG0_TIRE_CAT2_ISR: is-reentrant=true, is-synchronous=true, call-type=INTERRUPT, execution-context=INTERRUPT-CAT-2
    SPI_CSIG0_TIR_ISR: is-reentrant=true, is-synchronous=true, call-type=INTERRUPT, execution-context=INTERRUPT-CAT-1
    SPI_CSIG0_TIR_CAT2_ISR: is-reentrant=true, is-synchronous=true, call-type=INTERRUPT, execution-context=INTERRUPT-CAT-2
    SPI_CSIG0_TIC_ISR: is-reentrant=true, is-synchronous=true, call-type=INTERRUPT, execution-context=INTERRUPT-CAT-1
    SPI_CSIG0_TIC_CAT2_ISR: is-reentrant=true, is-synchronous=true, call-type=INTERRUPT, execution-context=INTERRUPT-CAT-2
    SPI_CSIH2_TIRE_ISR: is-reentrant=true, is-synchronous=true, call-type=INTERRUPT, execution-context=INTERRUPT-CAT-1
    SPI_CSIH2_TIRE_CAT2_ISR: is-reentrant=true, is-synchronous=true, call-type=INTERRUPT, execution-context=INTERRUPT-CAT-2
    SPI_CSIH2_TIR_ISR: is-reentrant=true, is-synchronous=true, call-type=INTERRUPT, execution-context=INTERRUPT-CAT-1
    SPI_CSIH2_TIR_CAT2_ISR: is-reentrant=true, is-synchronous=true, call-type=INTERRUPT, execution-context=INTERRUPT-CAT-2
    SPI_CSIH2_TIC_ISR: is-reentrant=true, is-synchronous=true, call-type=INTERRUPT, execution-context=INTERRUPT-CAT-1
    SPI_CSIH2_TIC_CAT2_ISR: is-reentrant=true, is-synchronous=true, call-type=INTERRUPT, execution-context=INTERRUPT-CAT-2
    SPI_CSIH2_TIJC_ISR: is-reentrant=true, is-synchronous=true, call-type=INTERRUPT, execution-context=INTERRUPT-CAT-1
    SPI_CSIH2_TIJC_CAT2_ISR: is-reentrant=true, is-synchronous=true, call-type=INTERRUPT, execution-context=INTERRUPT-CAT-2
    SPI_CSIH3_TIRE_ISR: is-reentrant=true, is-synchronous=true, call-type=INTERRUPT, execution-context=INTERRUPT-CAT-1
    SPI_CSIH3_TIRE_CAT2_ISR: is-reentrant=true, is-synchronous=true, call-type=INTERRUPT, execution-context=INTERRUPT-CAT-2
    SPI_CSIH3_TIR_ISR: is-reentrant=true, is-synchronous=true, call-type=INTERRUPT, execution-context=INTERRUPT-CAT-1
    SPI_CSIH3_TIR_CAT2_ISR: is-reentrant=true, is-synchronous=true, call-type=INTERRUPT, execution-context=INTERRUPT-CAT-2
    SPI_CSIH3_TIC_ISR: is-reentrant=true, is-synchronous=true, call-type=INTERRUPT, execution-context=INTERRUPT-CAT-1
    SPI_CSIH3_TIC_CAT2_ISR: is-reentrant=true, is-synchronous=true, call-type=INTERRUPT, execution-context=INTERRUPT-CAT-2
    SPI_CSIH3_TIJC_ISR: is-reentrant=true, is-synchronous=true, call-type=INTERRUPT, execution-context=INTERRUPT-CAT-1
    SPI_CSIH3_TIJC_CAT2_ISR: is-reentrant=true, is-synchronous=true, call-type=INTERRUPT, execution-context=INTERRUPT-CAT-2
    SPI_CSIH0_TIRE_ISR: is-reentrant=true, is-synchronous=true, call-type=INTERRUPT, execution-context=INTERRUPT-CAT-1
    SPI_CSIH0_TIRE_CAT2_ISR: is-reentrant=true, is-synchronous=true, call-type=INTERRUPT, execution-context=INTERRUPT-CAT-2
    SPI_CSIH0_TIR_ISR: is-reentrant=true, is-synchronous=true, call-type=INTERRUPT, execution-context=INTERRUPT-CAT-1
    SPI_CSIH0_TIR_CAT2_ISR: is-reentrant=true, is-synchronous=true, call-type=INTERRUPT, execution-context=INTERRUPT-CAT-2
    SPI_CSIH0_TIC_ISR: is-reentrant=true, is-synchronous=true, call-type=INTERRUPT, execution-context=INTERRUPT-CAT-1
    SPI_CSIH0_TIC_CAT2_ISR: is-reentrant=true, is-synchronous=true, call-type=INTERRUPT, execution-context=INTERRUPT-CAT-2
    SPI_CSIH0_TIJC_ISR: is-reentrant=true, is-synchronous=true, call-type=INTERRUPT, execution-context=INTERRUPT-CAT-1
    SPI_CSIH0_TIJC_CAT2_ISR: is-reentrant=true, is-synchronous=true, call-type=INTERRUPT, execution-context=INTERRUPT-CAT-2
    SPI_CSIH1_TIRE_ISR: is-reentrant=true, is-synchronous=true, call-type=INTERRUPT, execution-context=INTERRUPT-CAT-1
    SPI_CSIH1_TIRE_CAT2_ISR: is-reentrant=true, is-synchronous=true, call-type=INTERRUPT, execution-context=INTERRUPT-CAT-2
    SPI_CSIH1_TIR_ISR: is-reentrant=true, is-synchronous=true, call-type=INTERRUPT, execution-context=INTERRUPT-CAT-1
    SPI_CSIH1_TIR_CAT2_ISR: is-reentrant=true, is-synchronous=true, call-type=INTERRUPT, execution-context=INTERRUPT-CAT-2
    SPI_CSIH1_TIC_ISR: is-reentrant=true, is-synchronous=true, call-type=INTERRUPT, execution-context=INTERRUPT-CAT-1
    SPI_CSIH1_TIC_CAT2_ISR: is-reentrant=true, is-synchronous=true, call-type=INTERRUPT, execution-context=INTERRUPT-CAT-2
    SPI_CSIH1_TIJC_ISR: is-reentrant=true, is-synchronous=true, call-type=INTERRUPT, execution-context=INTERRUPT-CAT-1
    SPI_CSIH1_TIJC_CAT2_ISR: is-reentrant=true, is-synchronous=true, call-type=INTERRUPT, execution-context=INTERRUPT-CAT-2
    SPI_DMA00_ISR: is-reentrant=true, is-synchronous=true, call-type=INTERRUPT, execution-context=INTERRUPT-CAT-1
    SPI_DMA00_CAT2_ISR: is-reentrant=true, is-synchronous=true, call-type=INTERRUPT, execution-context=INTERRUPT-CAT-2
    SPI_DMA01_ISR: is-reentrant=true, is-synchronous=true, call-type=INTERRUPT, execution-context=INTERRUPT-CAT-1
    SPI_DMA01_CAT2_ISR: is-reentrant=true, is-synchronous=true, call-type=INTERRUPT, execution-context=INTERRUPT-CAT-2
    SPI_DMA02_ISR: is-reentrant=true, is-synchronous=true, call-type=INTERRUPT, execution-context=INTERRUPT-CAT-1
    SPI_DMA02_CAT2_ISR: is-reentrant=true, is-synchronous=true, call-type=INTERRUPT, execution-context=INTERRUPT-CAT-2
    SPI_DMA03_ISR: is-reentrant=true, is-synchronous=true, call-type=INTERRUPT, execution-context=INTERRUPT-CAT-1
    SPI_DMA03_CAT2_ISR: is-reentrant=true, is-synchronous=true, call-type=INTERRUPT, execution-context=INTERRUPT-CAT-2
    SPI_DMA04_ISR: is-reentrant=true, is-synchronous=true, call-type=INTERRUPT, execution-context=INTERRUPT-CAT-1
    SPI_DMA04_CAT2_ISR: is-reentrant=true, is-synchronous=true, call-type=INTERRUPT, execution-context=INTERRUPT-CAT-2
    SPI_DMA05_ISR: is-reentrant=true, is-synchronous=true, call-type=INTERRUPT, execution-context=INTERRUPT-CAT-1
    SPI_DMA05_CAT2_ISR: is-reentrant=true, is-synchronous=true, call-type=INTERRUPT, execution-context=INTERRUPT-CAT-2
    SPI_DMA06_ISR: is-reentrant=true, is-synchronous=true, call-type=INTERRUPT, execution-context=INTERRUPT-CAT-1
    SPI_DMA06_CAT2_ISR: is-reentrant=true, is-synchronous=true, call-type=INTERRUPT, execution-context=INTERRUPT-CAT-2
    SPI_DMA07_ISR: is-reentrant=true, is-synchronous=true, call-type=INTERRUPT, execution-context=INTERRUPT-CAT-1
    SPI_DMA07_CAT2_ISR: is-reentrant=true, is-synchronous=true, call-type=INTERRUPT, execution-context=INTERRUPT-CAT-2
    SPI_DMA08_ISR: is-reentrant=true, is-synchronous=true, call-type=INTERRUPT, execution-context=INTERRUPT-CAT-1
    SPI_DMA08_CAT2_ISR: is-reentrant=true, is-synchronous=true, call-type=INTERRUPT, execution-context=INTERRUPT-CAT-2
    SPI_DMA09_ISR: is-reentrant=true, is-synchronous=true, call-type=INTERRUPT, execution-context=INTERRUPT-CAT-1
    SPI_DMA09_CAT2_ISR: is-reentrant=true, is-synchronous=true, call-type=INTERRUPT, execution-context=INTERRUPT-CAT-2
    SPI_DMA10_ISR: is-reentrant=true, is-synchronous=true, call-type=INTERRUPT, execution-context=INTERRUPT-CAT-1
    SPI_DMA10_CAT2_ISR: is-reentrant=true, is-synchronous=true, call-type=INTERRUPT, execution-context=INTERRUPT-CAT-2
    SPI_DMA11_ISR: is-reentrant=true, is-synchronous=true, call-type=INTERRUPT, execution-context=INTERRUPT-CAT-1
    SPI_DMA11_CAT2_ISR: is-reentrant=true, is-synchronous=true, call-type=INTERRUPT, execution-context=INTERRUPT-CAT-2
    SPI_DMA12_ISR: is-reentrant=true, is-synchronous=true, call-type=INTERRUPT, execution-context=INTERRUPT-CAT-1
    SPI_DMA12_CAT2_ISR: is-reentrant=true, is-synchronous=true, call-type=INTERRUPT, execution-context=INTERRUPT-CAT-2
    SPI_DMA13_ISR: is-reentrant=true, is-synchronous=true, call-type=INTERRUPT, execution-context=INTERRUPT-CAT-1
    SPI_DMA13_CAT2_ISR: is-reentrant=true, is-synchronous=true, call-type=INTERRUPT, execution-context=INTERRUPT-CAT-2
    SPI_DMA14_ISR: is-reentrant=true, is-synchronous=true, call-type=INTERRUPT, execution-context=INTERRUPT-CAT-1
    SPI_DMA14_CAT2_ISR: is-reentrant=true, is-synchronous=true, call-type=INTERRUPT, execution-context=INTERRUPT-CAT-2
    SPI_DMA15_ISR: is-reentrant=true, is-synchronous=true, call-type=INTERRUPT, execution-context=INTERRUPT-CAT-1
    SPI_DMA15_CAT2_ISR: is-reentrant=true, is-synchronous=true, call-type=INTERRUPT, execution-context=INTERRUPT-CAT-2
    Spi_MainFunction_Handling: service-id=10, call-type=SCHEDULED, execution-context=TASK
