AUTOSAR XML (schema 4-0-3)
package /ActiveEcuC
  module config NxtrMfgSrv: implementation-config-variant=VARIANT-PRE-COMPILE
    34 x ProgramSpecificService:
      SrvSessionDflt: ServiceType=Session - 0x10, RequestLength=0, ResponseLength=0, SubFunction=1
        AccessControls: NexteerSession=false, SecurityAccess=false
      SrvFED0Rd: ServiceType=Read - 0x22, RequestLength=0, ResponseLength=6, ServiceId=65232
        AccessControls: NexteerSession=true, SecurityAccess=false
      SrvFED0Wr: ServiceType=Write - 0x2E, RequestLength=6, ResponseLength=0, ServiceId=65232
        AccessControls: NexteerSession=true, SecurityAccess=true
      SrvFED1Rd: ServiceType=Read - 0x22, RequestLength=0, ResponseLength=6, ServiceId=65233
        AccessControls: NexteerSession=true, SecurityAccess=false
      SrvFED1Wr: ServiceType=Write - 0x2E, RequestLength=6, ResponseLength=0, ServiceId=65233
        AccessControls: NexteerSession=true, SecurityAccess=true
      SrvFED2Rd: ServiceType=Read - 0x22, RequestLength=0, ResponseLength=20, ServiceId=65234
        AccessControls: NexteerSession=true, SecurityAccess=false
      SrvFED2Wr: ServiceType=Write - 0x2E, RequestLength=20, ResponseLength=0, ServiceId=65234
        AccessControls: NexteerSession=true, SecurityAccess=true
      SrvFED3Rd: ServiceType=Read - 0x22, RequestLength=0, ResponseLength=2, ServiceId=65235
        AccessControls: NexteerSession=true, SecurityAccess=false
      SrvFED3Wr: ServiceType=Write - 0x2E, RequestLength=2, ResponseLength=0, ServiceId=65235
        AccessControls: NexteerSession=true, SecurityAccess=true
      SrvFED4Rd: ServiceType=Read - 0x22, RequestLength=0, ResponseLength=6, ServiceId=65236
        AccessControls: NexteerSession=true, SecurityAccess=false
      SrvFED4Wr: ServiceType=Write - 0x2E, RequestLength=6, ResponseLength=0, ServiceId=65236
        AccessControls: NexteerSession=true, SecurityAccess=true
      SrvFED5Rd: ServiceType=Read - 0x22, RequestLength=0, ResponseLength=9, ServiceId=65237
        AccessControls: NexteerSession=true, SecurityAccess=false
      SrvFED5Wr: ServiceType=Write - 0x2E, RequestLength=9, ResponseLength=0, ServiceId=65237
        AccessControls: NexteerSession=true, SecurityAccess=true
      SrvFED6Rd: ServiceType=Read - 0x22, RequestLength=0, ResponseLength=1, ServiceId=65238
        AccessControls: NexteerSession=true, SecurityAccess=false
      SrvFED6Wr: ServiceType=Write - 0x2E, RequestLength=1, ResponseLength=0, ServiceId=65238
        AccessControls: NexteerSession=true, SecurityAccess=true
      SrvFED7Rd: ServiceType=Read - 0x22, RequestLength=0, ResponseLength=4, ServiceId=65239
        AccessControls: NexteerSession=true, SecurityAccess=false
      SrvFED7Wr: ServiceType=Write - 0x2E, RequestLength=4, ResponseLength=0, ServiceId=65239
        AccessControls: NexteerSession=true, SecurityAccess=true
      SrvFED8Rd: ServiceType=Read - 0x22, RequestLength=0, ResponseLength=20, ServiceId=65240
        AccessControls: NexteerSession=true, SecurityAccess=false
      SrvFED8Wr: ServiceType=Write - 0x2E, RequestLength=20, ResponseLength=0, ServiceId=65240
        AccessControls: NexteerSession=true, SecurityAccess=true
      SrvFED9Rd: ServiceType=Read - 0x22, RequestLength=0, ResponseLength=17, ServiceId=65241
        AccessControls: NexteerSession=true, SecurityAccess=false
      SrvFED9Wr: ServiceType=Write - 0x2E, RequestLength=17, ResponseLength=0, ServiceId=65241
        AccessControls: NexteerSession=true, SecurityAccess=true
      SrvFEDARd: ServiceType=Read - 0x22, RequestLength=0, ResponseLength=9, ServiceId=65242
        AccessControls: NexteerSession=true, SecurityAccess=false
      SrvFEDAWr: ServiceType=Write - 0x2E, RequestLength=9, ResponseLength=0, ServiceId=65242
        AccessControls: NexteerSession=true, SecurityAccess=true
      SrvFEDBRd: ServiceType=Read - 0x22, RequestLength=0, ResponseLength=16, ServiceId=65243
        AccessControls: NexteerSession=true, SecurityAccess=false
      SrvFEDBWr: ServiceType=Write - 0x2E, RequestLength=16, ResponseLength=0, ServiceId=65243
        AccessControls: NexteerSession=true, SecurityAccess=true
      SrvFEDCRd: ServiceType=Read - 0x22, RequestLength=0, ResponseLength=822, ServiceId=65244
        AccessControls: NexteerSession=true, SecurityAccess=false
      SrvFEDCWr: ServiceType=Write - 0x2E, RequestLength=822, ResponseLength=0, ServiceId=65244
        AccessControls: NexteerSession=true, SecurityAccess=true
      SrvFEE4Rd: ServiceType=Read - 0x22, RequestLength=0, ResponseLength=2, ServiceId=65252
        AccessControls: NexteerSession=true, SecurityAccess=false
      SrvFEE4Wr: ServiceType=Write - 0x2E, RequestLength=2, ResponseLength=0, ServiceId=65252
        AccessControls: NexteerSession=true, SecurityAccess=true
      SrvFEE0Rd: ServiceType=Read - 0x22, RequestLength=0, ResponseLength=10, ServiceId=65248
        AccessControls: NexteerSession=true, SecurityAccess=false
      SrvFEE0Wr: ServiceType=Write - 0x2E, RequestLength=10, ResponseLength=0, ServiceId=65248
        AccessControls: NexteerSession=true, SecurityAccess=true
      SrvFEE1Rd: ServiceType=Read - 0x22, RequestLength=0, ResponseLength=10, ServiceId=65249
        AccessControls: NexteerSession=true, SecurityAccess=false
      SrvFEE1Wr: ServiceType=Write - 0x2E, RequestLength=10, ResponseLength=0, ServiceId=65249
        AccessControls: NexteerSession=true, SecurityAccess=true
      SrvTesterPresent_Send: ServiceType=TesterPresent - 0x3E, RequestLength=0, ResponseLength=0, SubFunction=0
        AccessControls: NexteerSession=false, SecurityAccess=false
