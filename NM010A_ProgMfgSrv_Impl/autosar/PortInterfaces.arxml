AUTOSAR XML (schema 4-0-3)
package /Nexteer/PortInterfaces
  34 x client server interface:
    GetGmLoaIgnCntr_PortIf1
      operation Oper
        arg GmLoaIgnCntr_Arg: type=uint16, direction=OUT, server-argument-impl-policy=USE-ARGUMENT-TYPE
    PartNrBasMdlPartNrAlphaCodRd_PortIf1
      operation Oper
        arg BasMdlPartNrAlphaCod: type=Ary1D_u8_2, direction=OUT, server-argument-impl-policy=USE-ARGUMENT-TYPE
    PartNrBasMdlPartNrAlphaCodWr_PortIf1
      operation Oper
        arg BasMdlPartNrAlphaCod: type=Ary1D_u8_2, direction=IN, server-argument-impl-policy=USE-ARGUMENT-TYPE
    PartNrBasMdlPartNrRd_PortIf1
      operation Oper
        arg BasMdlPartNr: type=Ary1D_u8_4, direction=OUT, server-argument-impl-policy=USE-ARGUMENT-TYPE
    PartNrBasMdlPartNrWr_PortIf1
      operation Oper
        arg BasMdlPartNr: type=Ary1D_u8_4, direction=IN, server-argument-impl-policy=USE-ARGUMENT-TYPE
    PartNrCcaMfgTrakgRd_PortIf1
      operation Oper
        arg CcaMfgTrakg: type=Ary1D_u8_9, direction=OUT, server-argument-impl-policy=USE-ARGUMENT-TYPE
    PartNrCcaMfgTrakgWr_PortIf1
      operation Oper
        arg CcaMfgTrakg: type=Ary1D_u8_9, direction=IN, server-argument-impl-policy=USE-ARGUMENT-TYPE
    PartNrCtrlPidSeedKeyWr_PortIf1
      operation Oper
        arg CtrlPidSeedKey: type=Ary1D_u8_10, direction=IN, server-argument-impl-policy=USE-ARGUMENT-TYPE
    PartNrCustMfgEnaCntrRd_PortIf1
      operation Oper
        arg CustMfgEnaCntr: type=uint8, direction=OUT, server-argument-impl-policy=USE-ARGUMENT-TYPE
    PartNrCustMfgEnaCntrWr_PortIf1
      operation Oper: possible-error=CustMfgEnaCntrZero
        arg CustMfgEnaCntr: type=uint8, direction=IN, server-argument-impl-policy=USE-ARGUMENT-TYPE
      error CustMfgEnaCntrZero: error-code=1
    PartNrDataUniversalNrSysIdRd_PortIf1
      operation Oper
        arg DataUniversalNrSysId: type=Ary1D_u8_9, direction=OUT, server-argument-impl-policy=USE-ARGUMENT-TYPE
    PartNrDataUniversalNrSysIdWr_PortIf1
      operation Oper
        arg DataUniversalNrSysId: type=Ary1D_u8_9, direction=IN, server-argument-impl-policy=USE-ARGUMENT-TYPE
    PartNrEcuIdRd_PortIf1
      operation Oper
        arg EcuId_Arg: type=Ary1D_u8_16, direction=OUT, server-argument-impl-policy=USE-ARGUMENT-TYPE
    PartNrEcuIdWr_PortIf1
      operation Oper
        arg EcuId_Arg: type=Ary1D_u8_16, direction=IN, server-argument-impl-policy=USE-ARGUMENT-TYPE
    PartNrEndMdlPartNrAlphaCodRd_PortIf1
      operation Oper
        arg EndMdlPartNrAlphaCod: type=Ary1D_u8_2, direction=OUT, server-argument-impl-policy=USE-ARGUMENT-TYPE
    PartNrEndMdlPartNrAlphaCodWr_PortIf1
      operation Oper
        arg EndMdlPartNrAlphaCod: type=Ary1D_u8_2, direction=IN, server-argument-impl-policy=USE-ARGUMENT-TYPE
    PartNrEndMdlPartNrRd_PortIf1
      operation Oper
        arg EndMdlPartNr: type=Ary1D_u8_4, direction=OUT, server-argument-impl-policy=USE-ARGUMENT-TYPE
    PartNrEndMdlPartNrWr_PortIf1
      operation Oper
        arg EndMdlPartNr: type=Ary1D_u8_4, direction=IN, server-argument-impl-policy=USE-ARGUMENT-TYPE
    PartNrNxtrMfgTrakgRd_PortIf1
      operation Oper
        arg NxtrMfgTrakg: type=Ary1D_u8_7, direction=OUT, server-argument-impl-policy=USE-ARGUMENT-TYPE
    PartNrNxtrMfgTrakgWr_PortIf1
      operation Oper
        arg NxtrMfgTrakg: type=Ary1D_u8_7, direction=IN, server-argument-impl-policy=USE-ARGUMENT-TYPE
    PartNrProgmDateRd_PortIf1
      operation Oper
        arg ProgmDate: type=Ary1D_u8_4, direction=OUT, server-argument-impl-policy=USE-ARGUMENT-TYPE
    PartNrProgmDateWr_PortIf1
      operation Oper: possible-error=OutOfRange
        arg ProgmDate: type=Ary1D_u8_4, direction=IN, server-argument-impl-policy=USE-ARGUMENT-TYPE
      error OutOfRange: error-code=1
    PartNrProgmSessionSeedKeyWr_PortIf1
      operation Oper
        arg ProgmSessionSeedKey: type=Ary1D_u8_10, direction=IN, server-argument-impl-policy=USE-ARGUMENT-TYPE
    PartNrRepairShopCodRd_PortIf1
      operation Oper
        arg RepairShopCod: type=Ary1D_u8_20, direction=OUT, server-argument-impl-policy=USE-ARGUMENT-TYPE
    PartNrRepairShopCodWr_PortIf1
      operation Oper
        arg RepairShopCod: type=Ary1D_u8_10, direction=IN, server-argument-impl-policy=USE-ARGUMENT-TYPE
    PartNrSecuBypAuthnRd_PortIf1
      operation Oper
        arg SecuBypAuthn_Arg: type=Ary1D_u8_822, direction=OUT, server-argument-impl-policy=USE-ARGUMENT-TYPE
    PartNrSecuBypAuthnWr_PortIf1
      operation Oper
        arg SecuBypAuthn_Arg: type=Ary1D_u8_822, direction=IN, server-argument-impl-policy=USE-ARGUMENT-TYPE
    PartNrSysCodVersNrRd_PortIf1
      operation Oper
        arg SysCodVersNr: type=Ary1D_u8_2, direction=OUT, server-argument-impl-policy=USE-ARGUMENT-TYPE
    PartNrSysCodVersNrWr_PortIf1
      operation Oper
        arg SysCodVersNr: type=Ary1D_u8_2, direction=IN, server-argument-impl-policy=USE-ARGUMENT-TYPE
    PartNrSysNameRd_PortIf1
      operation Oper
        arg SysName: type=Ary1D_u8_20, direction=OUT, server-argument-impl-policy=USE-ARGUMENT-TYPE
    PartNrSysNameWr_PortIf1
      operation Oper
        arg SysName: type=Ary1D_u8_20, direction=IN, server-argument-impl-policy=USE-ARGUMENT-TYPE
    PartNrVinDataRd_PortIf1
      operation Oper
        arg VinData: type=Ary1D_u8_17, direction=OUT, server-argument-impl-policy=USE-ARGUMENT-TYPE
    PartNrVinDataWr_PortIf1
      operation Oper
        arg VinData: type=Ary1D_u8_17, direction=IN, server-argument-impl-policy=USE-ARGUMENT-TYPE
    SetGmLoaIgnCntr_PortIf1
      operation Oper
        arg GmLoaIgnCntr_Arg: type=uint16, direction=IN, server-argument-impl-policy=USE-ARGUMENT-TYPE
